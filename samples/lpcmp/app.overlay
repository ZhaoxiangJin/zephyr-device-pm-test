/*
 * Copyright 2026 NXP
 * SPDX-License-Identifier: Apache-2.0
 *
 * LPCMP setup for the device-PM test on FRDM-MCXN947.
 *
 * Positive input is CMP0_IN0 (PIO1_0, J2-17), negative input is the internal 8-bit
 * DAC at mid-scale of VREFH1. This mirrors
 * tests/drivers/comparator/gpio_loopback/boards/frdm_mcxn947_mcxn947_cpu0.overlay so
 * that the optional loopback layer uses already-documented wiring.
 *
 * Setting &lpcmp0 to "okay" is what makes boards/nxp/frdm_mcxn947/board.c attach
 * FRO12M to CMP0F and call SPC_EnableActiveModeAnalogModules(SPC0, kSPC_controlCmp0 |
 * kSPC_controlCmp0Dac), so the application needs no clock or SPC setup of its own.
 *
 * NOTE: pinctrl-0 is inert here -- drivers/comparator/comparator_nxp_lpcmp.c never
 * calls pinctrl_apply_state(), even though its binding includes pinctrl-device.yaml.
 * It is kept to express intent. The practical consequence is that IN0 gets no
 * bias-pull-up, so its level is indeterminate unless something drives it; that is why
 * no layer asserts on the comparator's output *value* unless the GPIO loopback layer
 * is enabled.
 */

#include <zephyr/dt-bindings/gpio/gpio.h>

/ {
	aliases {
		test-comp = &lpcmp0;
	};

	zephyr,user {
		/* Only used when CONFIG_PM_TEST_LPCMP_LOOPBACK=y: FRDM-MCXN947 J2-11. */
		test-gpios = <&gpio1 12 GPIO_ACTIVE_HIGH>;
	};
};

&lpcmp0 {
	status = "okay";
	pinctrl-0 = <&pinmux_lpcmp0>;
	pinctrl-names = "default";
	positive-mux-input = "IN0";	/* PIO1_0, J2-17 */
	negative-mux-input = "DAC";
	dac-value = <127>;		/* mid-scale of VREFH1 */
	dac-vref-source = "VREFH1";
};
