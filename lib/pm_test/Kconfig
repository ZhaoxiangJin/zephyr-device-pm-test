## tests/vref/testcase.yaml
```yaml
# Copyright 2026 NXP
# SPDX-License-Identifier: Apache-2.0

common:
  tags:
    - pm
    - regulator
    - drivers
  harness: ztest
  platform_allow:
    - frdm_mcxn947/mcxn947/cpu0
    - frdm_mcxn947/mcxn947/cpu0/qspi
    - frdm_mcxn236
    - mcx_n9xx_evk/mcxn947/cpu0
    - mcx_n9xx_evk/mcxn947/cpu0/qspi
    - mcx_n5xx_evk/mcxn547/cpu0
    - frdm_mcxa577

tests:
  drivers.pm.vref.baseline: {}

  drivers.pm.vref.device:
    required_snippets:
      - pm-device

  drivers.pm.vref.runtime:
    required_snippets:
      - pm-runtime

  drivers.pm.vref.system:
    required_snippets:
      - pm-system
    extra_args:
      - EXTRA_DTC_OVERLAY_FILE=constraints.overlay

  drivers.pm.vref.sysmanaged:
    required_snippets:
      - pm-sysmanaged

  drivers.pm.vref.dpd:
    required_snippets:
      - pm-dpd
```

## west.yml
```yaml
# SPDX-FileCopyrightText: Copyright 2026 NXP
# SPDX-License-Identifier: Apache-2.0

manifest:
  projects:
    - name: zephyr
      url: https://github.com/nxp-upstream/zephyr.git
      revision: 458b0a56e7f9d8e517a348affb9192c27f2b72a5
      path: zephyr
      import: true
  self:
    path: zephyr-device-pm-test
```
