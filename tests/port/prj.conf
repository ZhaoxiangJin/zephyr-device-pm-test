## CMakeLists.txt
```
# Copyright 2026 NXP
# SPDX-License-Identifier: Apache-2.0

cmake_minimum_required(VERSION 3.20.0)

# Pulls in this repository as a Zephyr module, which is what makes lib/pm_test,
# include/pm_test and the snippets/pm-* snippets available. Nothing has to be
# passed on the command line: `-S pm-<layer>` is the whole interface.
list(APPEND EXTRA_ZEPHYR_MODULES ${CMAKE_CURRENT_LIST_DIR}/../..)

find_package(Zephyr REQUIRED HINTS $ENV{ZEPHYR_BASE})
project(port_device_pm)

# The suite, the shared pin-mux plumbing, and the control test every layer runs.
target_sources(app PRIVATE src/main.c src/port.c src/test_control.c)

# One file per layer. A layer's file is the only place that layer's claims live,
# so a build for a layer contains no code belonging to any other.
target_sources_ifdef(CONFIG_PM_TEST_LAYER_DEVICE     app PRIVATE src/test_device.c)
target_sources_ifdef(CONFIG_PM_TEST_LAYER_RUNTIME    app PRIVATE src/test_runtime.c)
target_sources_ifdef(CONFIG_PM_TEST_LAYER_SYSTEM     app PRIVATE src/test_system.c)
target_sources_ifdef(CONFIG_PM_TEST_LAYER_SYSMANAGED app PRIVATE src/test_lowpower.c)
target_sources_ifdef(CONFIG_PM_TEST_LAYER_DPD        app PRIVATE src/test_lowpower.c)
```

## prj.conf
```kconfig
# Copyright 2026 NXP
# SPDX-License-Identifier: Apache-2.0
#
# Layer-independent configuration only. The PM symbols come from the layer, which
# comes from the pm-* snippet; see lib/pm_test/Kconfig and docs/pm-layers.md.
#
# There is no CONFIG_PINCTRL_NXP_PORT to set here: the SoC selects it, and the
# devices exist on every MCXN and MCXA board because everything that mentions a pin
# depends on them. src/port.c fails the build if it is somehow off.

CONFIG_ZTEST=y
CONFIG_PM_TEST=y

# Driver logging at info level, immediate: the run ends with interrupts locked so
# that the core cannot park in WFI, and a deferred log would never be flushed.
# include/pm_test/layer.h asserts this pairing.
CONFIG_LOG=y
CONFIG_LOG_MODE_IMMEDIATE=y
CONFIG_PINCTRL_LOG_LEVEL_INF=y
```

## overlay-pm-device.conf
```kconfig
# Layer 1: manual device PM.
# The driver's pinctrl_mcux_pm_action() is exercised directly through
# pm_device_action_run(). No runtime PM, so every pin-mux inits ACTIVE.
#
# The only legal sequence from ACTIVE is SUSPEND -> TURN_OFF -> TURN_ON ->
# RESUME: pm_device_action_run() checks the current state against
# action_expected_state[] and returns -ENOTSUP for anything else.

CONFIG_PM_DEVICE=y
```

## overlay-pm-sysmanaged.conf
```kconfig
# Layer 4: system PM with the system-managed device sweep.
#
# CONFIG_PM_DEVICE_SYSTEM_MANAGED and CONFIG_PM_DEVICE_RUNTIME are mutually
# exclusive suspend paths, and they exercise different driver code:
#
#   - runtime PM   the consumer's own get/put drives SUSPEND/RESUME.
#   - system sweep pm_suspend_devices() walks every device in reverse init order
#                  on the way into a low-power state and resumes them on the way
#                  out.
#
# For a pin-mux both are meant to be no-ops. What matters here is the third
# actor this layer brings in: the SoC's core_domain. It is a device like any
# other, so the sweep suspends and resumes it, and that is what makes it hand
# every child that names it in power-domains a TURN_OFF/TURN_ON pair around a
# state listed in its onoff-power-states. Under runtime PM the domain is never
# swept and its children never see those actions.
#
# Stacked with dpd-mcxn.overlay or dpd-mcxa.overlay this reaches Deep Power Down,
# which is the only state that actually closes the pin-mux clock gates.

CONFIG_PM=y
CONFIG_PM_DEVICE=y
CONFIG_PM_DEVICE_SYSTEM_MANAGED=y

# Wakeup: LPTMR0 through the counter alarm API, the same arrangement the
# samples/boards/nxp/mcxn_a/s2ram sample uses.
CONFIG_WUC=y
CONFIG_COUNTER=y
CONFIG_COUNTER_MCUX_LPTMR_ALARM=y
```

## overlay-pm-system.conf
```kconfig
# Layer 3: system PM + per-device power-state constraints.
#
# With CONFIG_PM and CONFIG_PM_POLICY_DEVICE_CONSTRAINTS, a device whose node
# lists zephyr,disabling-power-states (see constraints.overlay) can block those
# states while it needs the hardware. The pin-mux driver never takes such a lock,
# and should not -- a pad configuration is not an operation in flight -- so this
# layer checks that nothing ends up holding one on its behalf.

CONFIG_PM=y
CONFIG_PM_DEVICE=y
CONFIG_PM_DEVICE_RUNTIME=y
CONFIG_PM_DEVICE_RUNTIME_DEFAULT_ENABLE=y
CONFIG_PM_POLICY_DEVICE_CONSTRAINTS=y
```

## constraints.overlay
```dts
/*
 * Copyright 2026 NXP
 * SPDX-License-Identifier: Apache-2.0
 *
 * System-PM constraint layer: mark which SoC power state stops the pin-mux from
 * holding its configuration. Stacked on top of whatever else the board pulls in
 * for the system phase (via EXTRA_DTC_OVERLAY_FILE, so the automatic boards/
 * lookup still happens).
 *
 * The state named here is the one the SoC devicetree already names in
 * core_domain's onoff-power-states, which is where the reference-manual answer
 * for "which state takes the CORE domain down" lives: Deep Power Down. Plain
 * sleep and deep sleep only gate clocks, and the pad configuration survives
 * both.
 *
 * Only porta..portd are listed. Every MCXN and MCXA part has those four, while
 * porte is missing on MCXA153 and portf only exists on some parts, so a
 * family-wide file cannot name them without breaking the boards that lack the
 * label. That is no loss here: the property is per node, but what the phase
 * checks -- that no policy lock is held on the pin-mux's behalf -- is global.
 */

&porta {
	zephyr,disabling-power-states = <&deeppowerdown>;
};

&portb {
	zephyr,disabling-power-states = <&deeppowerdown>;
};

&portc {
	zephyr,disabling-power-states = <&deeppowerdown>;
};

&portd {
	zephyr,disabling-power-states = <&deeppowerdown>;
};
```

## dpd-mcxn.overlay
```dts
/*
 * Copyright 2026 NXP
 * SPDX-License-Identifier: Apache-2.0
 *
 * Deep Power Down layer, MCXN. Stacks on overlay-pm-sysmanaged.conf: it needs no
 * Kconfig of its own, because CONFIG_PM_S2RAM has no prompt -- it is derived from
 * whether a suspend-to-ram power state is enabled in the devicetree, which is
 * exactly what this file does.
 *
 * Suspend-to-RAM is opt-in in the SoC DTS, so the application has to enable it;
 * enabling it is also what arms the SoC's core_domain, whose onoff-power-states
 * list names this state and nothing else. That domain is what hands every pin-mux
 * instance the TURN_ON it needs to re-open a clock gate that came back closed.
 *
 * On MCXN only SRAMA survives Deep Power Down (the VBAT RAM LDO keeps it alive),
 * so the whole retained working set has to live there. Constrain zephyr,sram to
 * RAMA1-RAMA3, 24 KB at 0x20002000, which keeps it clear of the boot ROM
 * scratch at the bottom of SRAMA -- the same window
 * samples/boards/nxp/mcxn_a/s2ram uses.
 */

&deeppowerdown {
	status = "okay";
};

&sram0 {
	reg = <0x20002000 0x6000>;
};
```

## src/main.c
```c
/*
 * Copyright 2026 NXP
 * SPDX-License-Identifier: Apache-2.0
 */

/**
 * @file
 * @brief PORT pin-mux device-PM suite: the suite hooks, and nothing else.
 *
 * Which layer this build tests, and therefore which src/test_*.c is compiled in,
 * is decided by the pm-* snippet on the command line. See docs/pm-layers.md.
 */

#include <zephyr/ztest.h>

#include <pm_test/layer.h>

#include "port.h"

static void *port_pm_setup(void)
{
	(void)pm_test_setup();

	TC_PRINT("%u pin-mux instance(s) under test\n", (unsigned)PORT_CASE_COUNT);
	for (size_t i = 0U; i < PORT_CASE_COUNT; i++) {
		TC_PRINT("%s = PORT%u\n", port_cases[i].dev->name, port_cases[i].index);
	}

	return NULL;
}

static void port_pm_before(void *fixture)
{
	ARG_UNUSED(fixture);

	for (size_t i = 0U; i < PORT_CASE_COUNT; i++) {
		zassert_true(device_is_ready(port_cases[i].dev), "%s is not ready",
			     port_cases[i].dev->name);
	}
}

ZTEST_SUITE(port_pm, NULL, port_pm_setup, port_pm_before, NULL, NULL);
```

## src/port.c
```c
/*
 * Copyright 2026 NXP
 * SPDX-License-Identifier: Apache-2.0
 */

/**
 * @file
 * @brief PORT pin-mux plumbing shared by every layer of this case.
 */

#include <zephyr/devicetree.h>
#include <zephyr/sys/util.h>
#include <zephyr/tc_util.h>

#include <zephyr/dt-bindings/clock/mcux_lpc_syscon_clock.h>
#include <fsl_clock.h>

#include "port.h"

#if !DT_HAS_COMPAT_STATUS_OKAY(nxp_port_pinmux)
#error "No nxp,port-pinmux node is enabled on this board"
#endif

#if !defined(CONFIG_PINCTRL_NXP_PORT)
#error "CONFIG_PINCTRL_NXP_PORT is not enabled, so there is no driver to test"
#endif

/*
 * Every PORT instance on MCXN and MCXA takes its clock from the syscon node with a
 * single MCUX_PORTn_CLK cell, so the instance number is the distance from
 * MCUX_PORT0_CLK. The Kinetis, MCXC, MCXE and MCXL parts wire the same driver to a
 * sim/pcc/root-clock controller instead and would need a different mapping.
 */
#define PORT_ASSERT_SYSCON_CLOCK(node_id)                                                          \
	BUILD_ASSERT(DT_NODE_HAS_COMPAT(DT_CLOCKS_CTLR(node_id), nxp_lpc_syscon),                  \
		     "this case reads the PORT clock gate out of the MCX clock controller and "     \
		     "only fits SoCs whose pin-mux clocks come from nxp,lpc-syscon");

DT_FOREACH_STATUS_OKAY(nxp_port_pinmux, PORT_ASSERT_SYSCON_CLOCK)

#define PORT_ENTRY(node_id)                                                                        \
	{                                                                                          \
		.dev = DEVICE_DT_GET(node_id),                                                     \
		.index = (uint8_t)(DT_CLOCKS_CELL(node_id, name) - MCUX_PORT0_CLK),                \
	},

const struct port_case port_cases[PORT_CASE_COUNT] = {
	DT_FOREACH_STATUS_OKAY(nxp_port_pinmux, PORT_ENTRY)
};

static bool port_gate_of(uint8_t index, clock_ip_name_t *gate)
{
#if defined(CONFIG_SOC_FAMILY_MCXA)
	/* Same instances, and the same guard, as the syscon clock driver's own PORT
	 * cases in clock_control_mcux_syscon.c.
	 */
	switch (index) {
	case 0:
		*gate = kCLOCK_GatePORT0;
		break;
	case 1:
		*gate = kCLOCK_GatePORT1;
		break;
	case 2:
		*gate = kCLOCK_GatePORT2;
		break;
	case 3:
		*gate = kCLOCK_GatePORT3;
		break;
#if defined(FSL_FEATURE_SOC_PORT_COUNT) && (FSL_FEATURE_SOC_PORT_COUNT > 4)
	case 4:
		*gate = kCLOCK_GatePORT4;
		break;
#endif
#if defined(FSL_FEATURE_SOC_PORT_COUNT) && (FSL_FEATURE_SOC_PORT_COUNT > 5)
	case 5:
		*gate = kCLOCK_GatePORT5;
		break;
#endif
	default:
		return false;
	}

	return *gate != kCLOCK_GateNotAvail;
#else
	switch (index) {
	case 0:
		*gate = kCLOCK_Port0;
		break;
	case 1:
		*gate = kCLOCK_Port1;
		break;
	case 2:
		*gate = kCLOCK_Port2;
		break;
	case 3:
		*gate = kCLOCK_Port3;
		break;
	case 4:
		*gate = kCLOCK_Port4;
		break;
	default:
		return false;
	}

	return *gate != kCLOCK_None;
#endif
}

bool port_gate_observable(const struct port_case *p)
{
	clock_ip_name_t gate;

	return port_gate_of(p->index, &gate);
}

/*
 * CLOCK_EnableClock()/CLOCK_DisableClock() write through the write-only SET/CLR
 * aliases, so the readable register is the one at the head of each group:
 * SYSCON->AHBCLKCTRL0..3 on MCXN (contiguous from 0x200), MRCC0->MRCC_GLB_CCn on
 * MCXA (group stride 0x10, which is what the HAL's CLK_GATE_REG_OFFSET() encodes).
 */
bool port_gate_is_open(const struct port_case *p)
{
	clock_ip_name_t gate;

	if (!port_gate_of(p->index, &gate)) {
		return false;
	}

#if defined(CONFIG_SOC_FAMILY_MCXA)
	const volatile uint32_t *reg =
		(const volatile uint32_t *)((uintptr_t)&MRCC0->MRCC_GLB_CC0 +
					    CLK_GATE_REG_OFFSET(gate));

	return (*reg & BIT(CLK_GATE_BIT_SHIFT(gate))) != 0U;
#else
	const volatile uint32_t *reg = &(&SYSCON->AHBCLKCTRL0)[CLK_GATE_ABSTRACT_REG_OFFSET(gate)];

	return (*reg & BIT(CLK_GATE_ABSTRACT_BITS_SHIFT(gate))) != 0U;
#endif
}

void port_gate_open(const struct port_case *p)
{
	clock_ip_name_t gate;

	if (port_gate_of(p->index, &gate)) {
		CLOCK_EnableClock(gate);
	}
}

void port_gate_close(const struct port_case *p)
{
	clock_ip_name_t gate;

	if (port_gate_of(p->index, &gate)) {
		CLOCK_DisableClock(gate);
	}
}

void port_report_gate(const struct port_case *p, const char *when)
{
	if (!port_gate_observable(p)) {
		TC_PRINT("gate(%s, %s) not observable on this SoC\n", when, p->dev->name);
		return;
	}

	TC_PRINT("gate(%s, %s) PORT%u = %u\n", when, p->dev->name, p->index,
		 port_gate_is_open(p) ? 1U : 0U);
}
```

## src/port.h
```c
/*
 * Copyright 2026 NXP
 * SPDX-License-Identifier: Apache-2.0
 */

/**
 * @file
 * @brief What every layer of the PORT case needs from the hardware.
 *
 * The driver's PM callback has exactly one hardware effect: TURN_ON asks
 * clock_control_on() to re-open the instance's pin-mux clock gate. Nothing else in
 * the callback touches a register, so the gate bit is the only hardware truth this
 * case can assert on.
 *
 * It is read out of the clock controller, never out of the PORT block: a PCR only
 * answers while the block is clocked, so reading one is exactly what must not be
 * done to decide whether the clock is on. No file in this case touches a PCR.
 */

#ifndef PORT_PM_H_
#define PORT_PM_H_

#include <stdbool.h>
#include <stdint.h>
#include <zephyr/device.h>
#include <zephyr/devicetree.h>

/** One enabled nxp,port-pinmux instance, and which PORTn it is. */
struct port_case {
	const struct device *dev;
	uint8_t index;
};

#define PORT_COUNT_ONE(node_id) 1 +

/** How many pin-mux instances this board enables; usable as an array bound. */
#define PORT_CASE_COUNT (DT_FOREACH_STATUS_OKAY(nxp_port_pinmux, PORT_COUNT_ONE) 0)

/** Every enabled instance, in devicetree order. */
extern const struct port_case port_cases[PORT_CASE_COUNT];

/**
 * @brief Does this instance have a clock gate the test can read back?
 *
 * Not every one does. On MCXN the HAL defines kCLOCK_Port0..Port4 only, even on
 * parts whose FSL_FEATURE_SOC_PORT_COUNT is 6: portf sits outside the address
 * window the other five share and has no gate of its own. On MCXA there is a
 * constant for every instance the part actually has. Where there is no constant
 * there is nothing to check, and a layer says so rather than quietly passing.
 */
bool port_gate_observable(const struct port_case *p);

/** @brief Is this instance's pin-mux clock gate open? */
bool port_gate_is_open(const struct port_case *p);

/**
 * @brief Open the gate behind the driver's back.
 *
 * Used only to leave the board usable after a layer found the gate closed.
 */
void port_gate_open(const struct port_case *p);

/**
 * @brief Close the gate behind the driver's back.
 *
 * Nothing in a build without a real power loss can close a gate, so this stands in
 * for the reset state the block comes back in. clock_control_off() would not do:
 * the syscon clock driver has no PORT case in its .off handler at all and just
 * returns 0.
 */
void port_gate_close(const struct port_case *p);

/** @brief Note an instance's gate in the log without judging it. */
void port_report_gate(const struct port_case *p, const char *when);

#endif /* PORT_PM_H_ */
```

## src/test_control.c
```c
/*
 * Copyright 2026 NXP
 * SPDX-License-Identifier: Apache-2.0
 */

/**
 * @file
 * @brief The control: every pin-mux instance is clocked, whatever PM thinks.
 *
 * Compiled into every layer, and in this case it is more than a control.
 * pinctrl_mcux_init() opens the gate itself, before handing over to PM, and every
 * driver that applies a pin state from its own init writes a PCR through that gate.
 * So this has to hold in every layer -- including the ones where PM reports the
 * pin-mux SUSPENDED or OFF. If it ever stops holding, those drivers fault on an
 * unclocked block.
 */

#include <zephyr/ztest.h>

#include "port.h"

ZTEST(port_pm, test_control_gate_open_at_init)
{
	for (size_t i = 0U; i < PORT_CASE_COUNT; i++) {
		const struct port_case *p = &port_cases[i];

		port_report_gate(p, "init");

		if (!port_gate_observable(p)) {
			continue;
		}

		zassert_true(port_gate_is_open(p), "%s (PORT%u) clock gate closed at init",
			     p->dev->name, p->index);
	}
}
```

## src/test_device.c
```c
/*
 * Copyright 2026 NXP
 * SPDX-License-Identifier: Apache-2.0
 */

/**
 * @file
 * @brief The device layer: the driver's PM callbacks, driven directly.
 *
 * SUSPEND and TURN_OFF are no-ops by design -- a pad configuration is state, not
 * activity, and it has to hold for as long as the block is powered -- so what this
 * layer really tests is TURN_ON: the one action with a hardware effect, and the only
 * thing standing between a pin-mux that lost power and a driver that re-applies its
 * pin state through a closed clock gate.
 */

#include <zephyr/pm/device.h>
#include <zephyr/ztest.h>

#include <pm_test/state.h>

#include "port.h"

static void port_device_cycle(const struct port_case *p)
{
	bool observable = port_gate_observable(p);
	bool closed_by_hand = false;
	bool open_after_turn_on = false;
	int turn_on_rc;

	/* No runtime PM in this layer, so pm_device_driver_init() resumed it. */
	zassert_pm_state(p->dev, PM_DEVICE_STATE_ACTIVE);

	zassert_ok(pm_device_action_run(p->dev, PM_DEVICE_ACTION_SUSPEND),
		   "%s: SUSPEND rejected", p->dev->name);
	if (observable) {
		zassert_true(port_gate_is_open(p), "%s: gate closed by SUSPEND", p->dev->name);
	}

	zassert_ok(pm_device_action_run(p->dev, PM_DEVICE_ACTION_TURN_OFF),
		   "%s: TURN_OFF rejected", p->dev->name);
	if (observable) {
		zassert_true(port_gate_is_open(p), "%s: gate closed by TURN_OFF", p->dev->name);
	}

	/*
	 * Nothing in this build can take power away, so close the gate by hand to
	 * stand in for the reset state the block comes back in, and let TURN_ON find
	 * it that way. Nothing is printed and nothing is asserted inside the window:
	 * the console's own pin-mux may be this very instance. The PCR contents are
	 * held by the block rather than by the gate, so the pads keep their function
	 * while it is closed -- and if they did not, a garbled character here would
	 * itself be the finding.
	 */
	if (observable) {
		port_gate_close(p);
		closed_by_hand = !port_gate_is_open(p);
		turn_on_rc = pm_device_action_run(p->dev, PM_DEVICE_ACTION_TURN_ON);
		open_after_turn_on = port_gate_is_open(p);
		if (!open_after_turn_on) {
			/* Leave the board usable for the rest of the run, whatever the
			 * driver did, before any of this is judged.
			 */
			port_gate_open(p);
		}

		zassert_true(closed_by_hand, "%s: gate still reads open after being gated by hand",
			     p->dev->name);
		zassert_true(open_after_turn_on, "%s (PORT%u): TURN_ON did not re-open the clock "
			     "gate", p->dev->name, p->index);
	} else {
		turn_on_rc = pm_device_action_run(p->dev, PM_DEVICE_ACTION_TURN_ON);
	}

	zassert_ok(turn_on_rc, "%s: TURN_ON rejected", p->dev->name);

	zassert_ok(pm_device_action_run(p->dev, PM_DEVICE_ACTION_RESUME), "%s: RESUME rejected",
		   p->dev->name);
	zassert_pm_state(p->dev, PM_DEVICE_STATE_ACTIVE);
}

ZTEST(port_pm, test_device_turn_on_reopens_the_gate)
{
	for (size_t i = 0U; i < PORT_CASE_COUNT; i++) {
		port_device_cycle(&port_cases[i]);
	}
}
```

## src/test_lowpower.c
```c
/*
 * Copyright 2026 NXP
 * SPDX-License-Identifier: Apache-2.0
 */

/**
 * @file
 * @brief The sysmanaged and dpd layers: the device sweep across one transition.
 *
 * One file for two layers, because the sequence is identical and only the state
 * being entered differs -- and that difference is the whole point. Deep Sleep only
 * gates clocks, so the pin-mux comes back untouched. Deep Power Down takes the CORE
 * domain down, which is the only thing that actually closes a pin-mux clock gate and
 * therefore the only thing that reaches the driver's TURN_ON.
 *
 * On a board whose SoC has a portf the dpd layer is expected to fail: the driver asks
 * clock_control_on() to re-open the gate and clock_control_mcux_syscon.c has no
 * MCUX_PORT5_CLK case in either family branch -- port5-clock-gate-never-reopened in
 * docs/findings.md.
 */

#include <zephyr/pm/device.h>
#include <zephyr/ztest.h>

#include <pm_test/lowpower.h>
#include <pm_test/state.h>

#include "port.h"

static bool gate_open_after[PORT_CASE_COUNT];
static bool observable[PORT_CASE_COUNT];

/*
 * Sample every gate and re-open by hand any the transition left closed. Runs before
 * the console is touched, and prints nothing: the console's own pin-mux may be one of
 * the instances that came back gated, and reviving the LPUART re-applies its pin
 * state, which writes a PCR through that gate.
 */
static void sample_and_reopen_gates(void)
{
	for (size_t i = 0U; i < PORT_CASE_COUNT; i++) {
		const struct port_case *p = &port_cases[i];

		observable[i] = port_gate_observable(p);
		if (!observable[i]) {
			continue;
		}

		gate_open_after[i] = port_gate_is_open(p);
		if (!gate_open_after[i]) {
			port_gate_open(p);
		}
	}
}

ZTEST(port_pm, test_sweep_across_transition)
{
	/* No runtime PM in these layers, so the sweep is the only thing that will
	 * suspend the pin-mux instances.
	 */
	for (size_t i = 0U; i < PORT_CASE_COUNT; i++) {
		zassert_pm_state(port_cases[i].dev, PM_DEVICE_STATE_ACTIVE);
		port_report_gate(&port_cases[i], "before");
	}

	pm_test_enter_transition();
	sample_and_reopen_gates();

	/*
	 * Zero flags: the pin-mux instances are deliberately not re-initialised, which
	 * is the whole point of this case. Everything the console needs from them has
	 * to have been put back by the domain's TURN_ON and the loop above -- and
	 * surviving console output from here on is itself part of the evidence.
	 */
	pm_test_console_resume(0U);
	TC_PRINT("resumed from %s\n", PM_TEST_TRANSITION_NAME);

	for (size_t i = 0U; i < PORT_CASE_COUNT; i++) {
		const struct port_case *p = &port_cases[i];

		zassert_pm_state(p->dev, PM_DEVICE_STATE_ACTIVE);

		if (!observable[i]) {
			TC_PRINT("%s (PORT%u) has no observable gate on this SoC\n", p->dev->name,
				 p->index);
			continue;
		}

		zassert_true(gate_open_after[i],
			     "%s (PORT%u): clock gate closed after the transition", p->dev->name,
			     p->index);
	}
}
```

## src/test_runtime.c
```c
/*
 * Copyright 2026 NXP
 * SPDX-License-Identifier: Apache-2.0
 */

/**
 * @file
 * @brief The runtime layer: a pin-mux PM calls suspended is still usable.
 *
 * That is the interesting claim here, not the reference counting. A pin-mux whose
 * gate depended on a RESUME would be unusable for most of a boot, because every
 * driver that applies a pin state does so from its own init -- long before anything
 * takes a runtime reference, and in the layers below a TURN_ON that may never arrive
 * at all.
 */

#include <zephyr/pm/device.h>
#include <zephyr/pm/device_runtime.h>
#include <zephyr/ztest.h>

#include <pm_test/state.h>

#include "port.h"

static void port_runtime_cycle(const struct port_case *p)
{
	enum pm_device_state state;

	/*
	 * Two boot states are legal. A node with no power domain lands in SUSPENDED:
	 * pm_device_driver_init() ran TURN_ON and then stopped short of RESUME because
	 * runtime PM is about to take over. A node that names a domain lands in OFF,
	 * because the domain device is itself runtime enabled -- it is suspended right
	 * after its own init, so by the time the pin-mux initialises at PRE_KERNEL_1
	 * pm_device_is_powered() is already false and TURN_ON is skipped. With
	 * power-domain-soc-state-change that TURN_ON never arrives later either; see
	 * pd-soc-state-change-no-turn-on-under-runtime-pm in docs/findings.md.
	 */
	zassert_ok(pm_device_state_get(p->dev, &state), "%s: state query failed", p->dev->name);
	zassert_true(state == PM_DEVICE_STATE_SUSPENDED || state == PM_DEVICE_STATE_OFF,
		     "%s: boots %s under runtime PM, want suspended or off", p->dev->name,
		     pm_device_state_str(state));

	if (port_gate_observable(p)) {
		zassert_true(port_gate_is_open(p), "%s (PORT%u): gate closed while PM reports %s",
			     p->dev->name, p->index, pm_device_state_str(state));
	}

	zassert_ok(pm_device_runtime_get(p->dev), "%s: runtime_get rejected", p->dev->name);
	zassert_pm_state(p->dev, PM_DEVICE_STATE_ACTIVE);

	zassert_ok(pm_device_runtime_put(p->dev), "%s: runtime_put rejected", p->dev->name);
	zassert_pm_state(p->dev, PM_DEVICE_STATE_SUSPENDED);

	/* And the gate outlives the reference, for the same reason it predated it. */
	if (port_gate_observable(p)) {
		zassert_true(port_gate_is_open(p), "%s (PORT%u): gate closed by runtime_put",
			     p->dev->name, p->index);
	}
	port_report_gate(p, "after-put");
}

ZTEST(port_pm, test_runtime_gate_outlives_the_reference)
{
	for (size_t i = 0U; i < PORT_CASE_COUNT; i++) {
		port_runtime_cycle(&port_cases[i]);
	}
}
```

## src/test_system.c
```c
/*
 * Copyright 2026 NXP
 * SPDX-License-Identifier: Apache-2.0
 */

/**
 * @file
 * @brief The system layer: nothing holds a constraint on the pin-mux's behalf.
 *
 * The pin-mux driver never calls pm_policy_device_power_lock_get(), and should not:
 * a pad configuration is not an operation in flight, so there is no window to
 * protect. Declaring the state the block does not survive is still meaningful --
 * that is what an application would consult to decide whether it has to re-apply pin
 * state -- but nothing may end up *holding* a lock, because a pin-mux is alive for
 * the whole run and a leaked lock here would block the state for ever.
 */

#include <zephyr/pm/policy.h>
#include <zephyr/pm/state.h>
#include <zephyr/ztest.h>

#include <pm_test/lowpower.h>

#include "port.h"

ZTEST(port_pm, test_system_no_constraint_held_for_the_pinmux)
{
	pm_test_console_quiesce();

	/*
	 * Every state, not just the one constraints.overlay names: the claim is that
	 * the pin-mux costs the policy nothing, and a lock on any state would be a
	 * cost. States the devicetree does not declare simply read as unlocked.
	 */
	for (enum pm_state state = PM_STATE_ACTIVE; state < PM_STATE_COUNT; state++) {
		zassert_false(pm_policy_state_lock_is_active(state, 0),
			      "power state %d is locked, but nothing should hold a constraint on "
			      "the pin-mux's behalf", state);
	}

	for (size_t i = 0U; i < PORT_CASE_COUNT; i++) {
		port_report_gate(&port_cases[i], "constraints");
	}
}
```
