## CMakeLists.txt
```
# Copyright 2026 NXP
# SPDX-License-Identifier: Apache-2.0

cmake_minimum_required(VERSION 3.20.0)

# Pulls in this repository as a Zephyr module, which is what makes lib/pm_test,
# include/pm_test and the snippets/pm-* snippets available. Nothing has to be
# passed on the command line: `-S pm-<layer>` is the whole interface.
list(APPEND EXTRA_ZEPHYR_MODULES ${CMAKE_CURRENT_LIST_DIR}/../..)

find_package(Zephyr REQUIRED HINTS $ENV{ZEPHYR_BASE})
project(lpcmp_device_pm)

# The suite, the shared LPCMP plumbing, and the control test that every layer runs.
target_sources(app PRIVATE src/main.c src/lpcmp.c src/test_control.c)

# One file per layer. A layer's file is the only place that layer's claims live,
# so a build for a layer contains no code belonging to any other.
target_sources_ifdef(CONFIG_PM_TEST_LAYER_DEVICE  app PRIVATE src/test_device.c)
target_sources_ifdef(CONFIG_PM_TEST_LAYER_RUNTIME app PRIVATE src/test_runtime.c)
target_sources_ifdef(CONFIG_PM_TEST_LAYER_SYSTEM  app PRIVATE src/test_system.c)
```

## Kconfig
```
# Copyright 2026 NXP
# SPDX-License-Identifier: Apache-2.0

config PM_TEST_LPCMP_LOOPBACK
	bool "GPIO loopback functional layer"
	select GPIO
	help
	  Drive the comparator's positive input from a GPIO and assert on the
	  comparator's actual output, instead of only inspecting CCR0.CMP_EN.

	  This is the only layer that proves a SUSPEND really stopped the analog
	  comparison rather than merely flipping a register bit, but it needs a
	  jumper wire on FRDM-MCXN947 between:

	      J2-11 (PIO1_12, gpio1 pin 12)  ->  J2-17 (PIO1_0, CMP0_IN0)

	  Same wiring as tests/drivers/comparator/gpio_loopback. Off by default so
	  that every other layer runs with no external wiring at all.

source "Kconfig.zephyr"
```

## prj.conf
```kconfig
# Copyright 2026 NXP
# SPDX-License-Identifier: Apache-2.0
#
# Layer-independent configuration only. The PM symbols come from the layer, which
# comes from the pm-* snippet; see lib/pm_test/Kconfig and docs/pm-layers.md.

CONFIG_ZTEST=y
CONFIG_PM_TEST=y

CONFIG_COMPARATOR=y

# Driver logging at info level, immediate: the run ends with interrupts locked so
# that the core cannot park in WFI, and a deferred log would never be flushed.
# include/pm_test/layer.h asserts this pairing.
CONFIG_LOG=y
CONFIG_LOG_MODE_IMMEDIATE=y
CONFIG_COMPARATOR_LOG_LEVEL_INF=y
```

## overlay-loopback.conf
```kconfig
# Optional functional layer: stack this onto any layer's snippet.
#
#   west build -b $BOARD . -S pm-device -- -DEXTRA_CONF_FILE=overlay-loopback.conf
#
# Requires a jumper wire; the two pins are named in boards/<board_target>.overlay and
# in README.md. Without it the run fails immediately with an explicit wiring message.

CONFIG_PM_TEST_LPCMP_LOOPBACK=y
CONFIG_GPIO=y
```

## overlay-pm-device.conf
```kconfig
# Layer 1: manual device PM.
# nxp_lpcmp_pm_callback() (SUSPEND/RESUME) is driven directly through
# pm_device_action_run(). No runtime PM, so pm_device_driver_init() resumes the
# device and it boots ACTIVE.

CONFIG_PM_DEVICE=y
```

## overlay-pm-system.conf
```kconfig
# Layer 3: system PM + per-device power-state constraints.
# With CONFIG_PM and CONFIG_PM_POLICY_DEVICE_CONSTRAINTS the power states listed in
# the node's zephyr,disabling-power-states (see constraints.overlay) can be blocked
# by pm_policy_device_power_lock_get() while the comparator must keep comparing.
#
# NOTE: the LPCMP driver never takes such a lock itself -- unlike the LPADC driver,
# which locks around each conversion. So this layer exercises that the constraint
# metadata builds and does not disturb the device, and documents that any
# lock/unlock has to come from the application.

CONFIG_PM=y
CONFIG_PM_DEVICE=y
CONFIG_PM_DEVICE_RUNTIME=y
CONFIG_PM_DEVICE_RUNTIME_DEFAULT_ENABLE=y
CONFIG_PM_POLICY_DEVICE_CONSTRAINTS=y
```

## boards/frdm_mcxa153.overlay
```dts
/*
 * Copyright 2026 NXP
 * SPDX-License-Identifier: Apache-2.0
 *
 * LPCMP setup for the device-PM test on FRDM-MCXA153.
 *
 * Positive input is CMP0_IN0 (FRDM-MCXA153 J2-9), negative input is the internal 8-bit DAC at
 * 127/255 of VREFH1. Copied from
 * tests/drivers/comparator/gpio_loopback/boards/frdm_mcxa153.overlay so the
 * optional loopback layer uses already-documented wiring.
 *
 * Setting &lpcmp0 to "okay" is what makes the board's board.c attach a function clock
 * to CMP0 and call SPC_EnableActiveModeAnalogModules() for the comparator and its DAC,
 * so the application needs no clock or SPC setup of its own.
 *
 * NOTE: pinctrl-0 is inert here -- drivers/comparator/comparator_nxp_lpcmp.c never
 * calls pinctrl_apply_state(), even though its binding includes pinctrl-device.yaml.
 * It is kept to express intent. The practical consequence is that the positive input
 * gets no bias-pull, so its level is indeterminate unless something drives it; that is
 * why no layer asserts on the comparator's output *value* unless the GPIO loopback
 * layer is enabled.
 */

#include <zephyr/dt-bindings/gpio/gpio.h>

/ {
	aliases {
		test-comp = &lpcmp0;
	};

	zephyr,user {
		/* Only used when CONFIG_PM_TEST_LPCMP_LOOPBACK=y: FRDM-MCXA153 J2-3. */
		test-gpios = <&gpio1 5 GPIO_ACTIVE_HIGH>;
	};
};

&lpcmp0 {
	status = "okay";
	pinctrl-0 = <&pinmux_lpcmp0>;
	pinctrl-names = "default";
	positive-mux-input = "IN0";	/* FRDM-MCXA153 J2-9 */
	negative-mux-input = "DAC";
	dac-value = <127>;
	dac-vref-source = "VREFH1";
};
```

## boards/frdm_mcxa156.overlay
```dts
/*
 * Copyright 2026 NXP
 * SPDX-License-Identifier: Apache-2.0
 *
 * LPCMP setup for the device-PM test on FRDM-MCXA156.
 *
 * Positive input is CMP0_IN0 (FRDM-MCXA156 J2-9), negative input is the internal 8-bit DAC at
 * 127/255 of VREFH1. Copied from
 * tests/drivers/comparator/gpio_loopback/boards/frdm_mcxa156.overlay so the
 * optional loopback layer uses already-documented wiring.
 *
 * Setting &lpcmp0 to "okay" is what makes the board's board.c attach a function clock
 * to CMP0 and call SPC_EnableActiveModeAnalogModules() for the comparator and its DAC,
 * so the application needs no clock or SPC setup of its own.
 *
 * NOTE: pinctrl-0 is inert here -- drivers/comparator/comparator_nxp_lpcmp.c never
 * calls pinctrl_apply_state(), even though its binding includes pinctrl-device.yaml.
 * It is kept to express intent. The practical consequence is that the positive input
 * gets no bias-pull, so its level is indeterminate unless something drives it; that is
 * why no layer asserts on the comparator's output *value* unless the GPIO loopback
 * layer is enabled.
 */

#include <zephyr/dt-bindings/gpio/gpio.h>

/ {
	aliases {
		test-comp = &lpcmp0;
	};

	zephyr,user {
		/* Only used when CONFIG_PM_TEST_LPCMP_LOOPBACK=y: FRDM-MCXA156 J2-1. */
		test-gpios = <&gpio1 4 GPIO_ACTIVE_HIGH>;
	};
};

&lpcmp0 {
	status = "okay";
	pinctrl-0 = <&pinmux_lpcmp0>;
	pinctrl-names = "default";
	positive-mux-input = "IN0";	/* FRDM-MCXA156 J2-9 */
	negative-mux-input = "DAC";
	dac-value = <127>;
	dac-vref-source = "VREFH1";
};
```

## boards/frdm_mcxa344.overlay
```dts
/*
 * Copyright 2026 NXP
 * SPDX-License-Identifier: Apache-2.0
 *
 * LPCMP setup for the device-PM test on FRDM-MCXA344.
 *
 * Positive input is CMP0_IN1 (FRDM-MCXA344 J2-17), negative input is the internal 8-bit DAC at
 * 127/255 of VREFH1. Copied from
 * tests/drivers/comparator/gpio_loopback/boards/frdm_mcxa344.overlay so the
 * optional loopback layer uses already-documented wiring.
 *
 * Setting &lpcmp0 to "okay" is what makes the board's board.c attach a function clock
 * to CMP0 and call SPC_EnableActiveModeAnalogModules() for the comparator and its DAC,
 * so the application needs no clock or SPC setup of its own.
 *
 * NOTE: pinctrl-0 is inert here -- drivers/comparator/comparator_nxp_lpcmp.c never
 * calls pinctrl_apply_state(), even though its binding includes pinctrl-device.yaml.
 * It is kept to express intent. The practical consequence is that the positive input
 * gets no bias-pull, so its level is indeterminate unless something drives it; that is
 * why no layer asserts on the comparator's output *value* unless the GPIO loopback
 * layer is enabled.
 */

#include <zephyr/dt-bindings/gpio/gpio.h>

/ {
	aliases {
		test-comp = &lpcmp0;
	};

	zephyr,user {
		/* Only used when CONFIG_PM_TEST_LPCMP_LOOPBACK=y: FRDM-MCXA344 J2-7. */
		test-gpios = <&gpio1 4 GPIO_ACTIVE_HIGH>;
	};
};

&lpcmp0 {
	status = "okay";
	pinctrl-0 = <&pinmux_lpcmp0>;
	pinctrl-names = "default";
	positive-mux-input = "IN1";	/* FRDM-MCXA344 J2-17 */
	negative-mux-input = "DAC";
	dac-value = <127>;
	dac-vref-source = "VREFH1";
};
```

## boards/frdm_mcxa366.overlay
```dts
/*
 * Copyright 2026 NXP
 * SPDX-License-Identifier: Apache-2.0
 *
 * LPCMP setup for the device-PM test on FRDM-MCXA366.
 *
 * Positive input is CMP0_IN1 (FRDM-MCXA366 J2-17), negative input is the internal 8-bit DAC at
 * 127/255 of VREFH1. Copied from
 * tests/drivers/comparator/gpio_loopback/boards/frdm_mcxa366.overlay so the
 * optional loopback layer uses already-documented wiring.
 *
 * Setting &lpcmp0 to "okay" is what makes the board's board.c attach a function clock
 * to CMP0 and call SPC_EnableActiveModeAnalogModules() for the comparator and its DAC,
 * so the application needs no clock or SPC setup of its own.
 *
 * NOTE: pinctrl-0 is inert here -- drivers/comparator/comparator_nxp_lpcmp.c never
 * calls pinctrl_apply_state(), even though its binding includes pinctrl-device.yaml.
 * It is kept to express intent. The practical consequence is that the positive input
 * gets no bias-pull, so its level is indeterminate unless something drives it; that is
 * why no layer asserts on the comparator's output *value* unless the GPIO loopback
 * layer is enabled.
 */

#include <zephyr/dt-bindings/gpio/gpio.h>

/ {
	aliases {
		test-comp = &lpcmp0;
	};

	zephyr,user {
		/* Only used when CONFIG_PM_TEST_LPCMP_LOOPBACK=y: FRDM-MCXA366 J2-7. */
		test-gpios = <&gpio1 4 GPIO_ACTIVE_HIGH>;
	};
};

&lpcmp0 {
	status = "okay";
	pinctrl-0 = <&pinmux_lpcmp0>;
	pinctrl-names = "default";
	positive-mux-input = "IN1";	/* FRDM-MCXA366 J2-17 */
	negative-mux-input = "DAC";
	dac-value = <127>;
	dac-vref-source = "VREFH1";
};
```

## boards/frdm_mcxa577.overlay
```dts
/*
 * Copyright 2026 NXP
 * SPDX-License-Identifier: Apache-2.0
 *
 * LPCMP setup for the device-PM test on FRDM-MCXA577.
 *
 * Positive input is CMP0_IN2 (FRDM-MCXA577 P1_4, R132), negative input is the internal 8-bit DAC at
 * 160/255 of VREFH0. Copied from
 * tests/drivers/comparator/gpio_loopback/boards/frdm_mcxa577.overlay so the
 * optional loopback layer uses already-documented wiring.
 *
 * Setting &lpcmp0 to "okay" is what makes the board's board.c attach a function clock
 * to CMP0 and call SPC_EnableActiveModeAnalogModules() for the comparator and its DAC,
 * so the application needs no clock or SPC setup of its own.
 *
 * NOTE: pinctrl-0 is inert here -- drivers/comparator/comparator_nxp_lpcmp.c never
 * calls pinctrl_apply_state(), even though its binding includes pinctrl-device.yaml.
 * It is kept to express intent. The practical consequence is that the positive input
 * gets no bias-pull, so its level is indeterminate unless something drives it; that is
 * why no layer asserts on the comparator's output *value* unless the GPIO loopback
 * layer is enabled.
 */

#include <zephyr/dt-bindings/gpio/gpio.h>

/ {
	aliases {
		test-comp = &lpcmp0;
	};

	zephyr,user {
		/* Only used when CONFIG_PM_TEST_LPCMP_LOOPBACK=y: FRDM-MCXA577 P0_19, J6-1. */
		test-gpios = <&gpio0 19 GPIO_ACTIVE_HIGH>;
	};
};

&lpcmp0 {
	status = "okay";
	pinctrl-0 = <&pinmux_lpcmp0>;
	pinctrl-names = "default";
	positive-mux-input = "IN2";	/* FRDM-MCXA577 P1_4, R132 */
	negative-mux-input = "DAC";
	dac-value = <160>;
	dac-vref-source = "VREFH0";
};
```

## boards/frdm_mcxn236.overlay
```dts
/*
 * Copyright 2026 NXP
 * SPDX-License-Identifier: Apache-2.0
 *
 * LPCMP setup for the device-PM test on FRDM-MCXN236.
 *
 * Positive input is CMP0_IN0 (FRDM-MCXN236 J2-8), negative input is the internal 8-bit DAC at
 * 127/255 of VREFH1. Copied from
 * tests/drivers/comparator/gpio_loopback/boards/frdm_mcxn236.overlay so the
 * optional loopback layer uses already-documented wiring.
 *
 * Setting &lpcmp0 to "okay" is what makes the board's board.c attach a function clock
 * to CMP0 and call SPC_EnableActiveModeAnalogModules() for the comparator and its DAC,
 * so the application needs no clock or SPC setup of its own.
 *
 * NOTE: pinctrl-0 is inert here -- drivers/comparator/comparator_nxp_lpcmp.c never
 * calls pinctrl_apply_state(), even though its binding includes pinctrl-device.yaml.
 * It is kept to express intent. The practical consequence is that the positive input
 * gets no bias-pull, so its level is indeterminate unless something drives it; that is
 * why no layer asserts on the comparator's output *value* unless the GPIO loopback
 * layer is enabled.
 */

#include <zephyr/dt-bindings/gpio/gpio.h>

/ {
	aliases {
		test-comp = &lpcmp0;
	};

	zephyr,user {
		/* Only used when CONFIG_PM_TEST_LPCMP_LOOPBACK=y: FRDM-MCXN236 J2-10. */
		test-gpios = <&gpio1 2 GPIO_ACTIVE_HIGH>;
	};
};

&lpcmp0 {
	status = "okay";
	pinctrl-0 = <&pinmux_lpcmp0>;
	pinctrl-names = "default";
	positive-mux-input = "IN0";	/* FRDM-MCXN236 J2-8 */
	negative-mux-input = "DAC";
	dac-value = <127>;
	dac-vref-source = "VREFH1";
};
```

## src/main.c
```c
/*
 * Copyright 2026 NXP
 * SPDX-License-Identifier: Apache-2.0
 */

/**
 * @file
 * @brief LPCMP device-PM suite: the suite hooks, and nothing else.
 *
 * Which layer this build tests, and therefore which src/test_*.c is compiled in,
 * is decided by the pm-* snippet on the command line. See docs/pm-layers.md.
 */

#include <zephyr/ztest.h>

#include <pm_test/layer.h>

#include "lpcmp.h"

#if defined(CONFIG_PM_TEST_LPCMP_LOOPBACK)
static int loopback_rc = -EBUSY;
#endif

static void *lpcmp_pm_setup(void)
{
	(void)pm_test_setup();
#if defined(CONFIG_PM_TEST_LPCMP_LOOPBACK)
	loopback_rc = lpcmp_loopback_init();
#endif
	return NULL;
}

static void lpcmp_pm_before(void *fixture)
{
	ARG_UNUSED(fixture);

	zassert_true(device_is_ready(LPCMP_DEV), "%s is not ready", LPCMP_DEV->name);
#if defined(CONFIG_PM_TEST_LPCMP_LOOPBACK)
	/* Reported from before() because a setup() that fails has no way to fail the
	 * suite. The jumper is the usual reason, so name it rather than the errno.
	 */
	zassert_ok(loopback_rc,
		   "loopback GPIO unusable (%d); the layer needs a jumper, see README.md",
		   loopback_rc);
#endif
}

ZTEST_SUITE(lpcmp_pm, NULL, lpcmp_pm_setup, lpcmp_pm_before, NULL, NULL);
```

## src/lpcmp.c
```c
/*
 * Copyright 2026 NXP
 * SPDX-License-Identifier: Apache-2.0
 */

/**
 * @file
 * @brief LPCMP plumbing shared by every layer of this case.
 */

#include <zephyr/devicetree.h>
#include <zephyr/drivers/comparator.h>
#include <zephyr/kernel.h>

#include <soc.h> /* LPCMP_Type, LPCMP_CCR0_CMP_EN_MASK */

#include "lpcmp.h"

#if !DT_NODE_EXISTS(DT_ALIAS(test_comp))
#error "This board has no test-comp alias; see boards/<board_target>.overlay"
#endif

#define LPCMP_NODE DT_ALIAS(test_comp)

const struct device *const lpcmp_dev = DEVICE_DT_GET(LPCMP_NODE);

static const LPCMP_Type *lpcmp_regs(void)
{
	return (const LPCMP_Type *)DT_REG_ADDR(LPCMP_NODE);
}

bool lpcmp_cmp_en(void)
{
	return (lpcmp_regs()->CCR0 & LPCMP_CCR0_CMP_EN_MASK) != 0U;
}

uint32_t lpcmp_ccr2(void)
{
	return lpcmp_regs()->CCR2;
}

int lpcmp_output(void)
{
	return comparator_get_output(lpcmp_dev);
}

#if defined(CONFIG_PM_TEST_LPCMP_LOOPBACK)

#include <zephyr/drivers/gpio.h>

#if !DT_NODE_HAS_PROP(DT_PATH(zephyr_user), test_gpios)
#error "The loopback layer needs a zephyr,user test-gpios property"
#endif

static const struct gpio_dt_spec loopback_gpio =
	GPIO_DT_SPEC_GET(DT_PATH(zephyr_user), test_gpios);

/* Long enough for the comparator's filter and the pin itself to settle; a
 * comparator that is comparing at all follows within a millisecond or two.
 */
#define LOOPBACK_SETTLE_MS 50

static bool output_follows(int level)
{
	gpio_pin_set_dt(&loopback_gpio, level);

	for (int i = 0; i < LOOPBACK_SETTLE_MS; i++) {
		if (comparator_get_output(lpcmp_dev) == level) {
			return true;
		}
		k_msleep(1);
	}
	return false;
}

int lpcmp_loopback_init(void)
{
	if (!gpio_is_ready_dt(&loopback_gpio)) {
		return -ENODEV;
	}
	return gpio_pin_configure_dt(&loopback_gpio, GPIO_OUTPUT_INACTIVE);
}

bool lpcmp_loopback_tracks_input(void)
{
	bool high_ok = output_follows(1);
	bool low_ok = output_follows(0);

	return high_ok && low_ok;
}
#endif /* CONFIG_PM_TEST_LPCMP_LOOPBACK */
```

## src/lpcmp.h
```c
/*
 * Copyright 2026 NXP
 * SPDX-License-Identifier: Apache-2.0
 */

/**
 * @file
 * @brief What every layer of the LPCMP case needs from the hardware.
 *
 * The comparator API cannot see a suspended comparator: comparator_get_output()
 * returns the CSR.COUT latch, so against a disabled block it yields a stale level
 * rather than an error. CCR0.CMP_EN is therefore the observable -- it is the one
 * bit the driver's PM callback touches -- and the optional loopback layer is what
 * turns "the bit is clear" into "the analog comparison really stopped".
 */

#ifndef LPCMP_PM_H_
#define LPCMP_PM_H_

#include <stdbool.h>
#include <stdint.h>
#include <zephyr/device.h>

/** The comparator under test, named by the board overlay's test-comp alias. */
extern const struct device *const lpcmp_dev;

#define LPCMP_DEV lpcmp_dev

/**
 * @brief Is the comparator actually comparing?
 *
 * Read straight out of CCR0, not from the driver: a PM state machine that has
 * drifted away from the hardware is exactly what this case is looking for.
 */
bool lpcmp_cmp_en(void);

/**
 * @brief The input mux, hysteresis and power-mode configuration register.
 *
 * The driver has no save/restore of its own, so comparing CCR2 across a
 * suspend/resume round trip says whether the configuration survived unaided.
 */
uint32_t lpcmp_ccr2(void);

/** @brief One comparator output read, as an application would do it. */
int lpcmp_output(void);

#if defined(CONFIG_PM_TEST_LPCMP_LOOPBACK)
/**
 * @brief Configure the GPIO that drives the comparator's positive input.
 *
 * @return 0 on success, negative errno if the pin is not usable.
 */
int lpcmp_loopback_init(void);

/**
 * @brief Drive the input high and then low, and see whether the output follows.
 *
 * @return true only if the output tracked both edges, i.e. the comparator is
 *         comparing; false if it is disabled, which is what a suspended device
 *         must look like.
 */
bool lpcmp_loopback_tracks_input(void);
#endif /* CONFIG_PM_TEST_LPCMP_LOOPBACK */

#endif /* LPCMP_PM_H_ */
```

## src/test_control.c
```c
/*
 * Copyright 2026 NXP
 * SPDX-License-Identifier: Apache-2.0
 */

/**
 * @file
 * @brief The control: this case really does drive the comparator.
 *
 * Compiled into every layer. If this fails, no verdict from the layer under test
 * means anything -- which is the whole reason the baseline layer exists as a layer.
 */

#include <zephyr/drivers/comparator.h>
#include <zephyr/pm/device_runtime.h>
#include <zephyr/ztest.h>

#include "lpcmp.h"

ZTEST(lpcmp_pm, test_control_api)
{
	bool held = false;
	int out, both_edges, pending, none;
#if defined(CONFIG_PM_TEST_LPCMP_LOOPBACK)
	bool tracks;
#endif

	/* Where runtime PM owns the device it boots suspended, so the control has to
	 * ask for it explicitly; whether an unwrapped call resumes it is
	 * test_runtime.c's claim to judge, not a premise of the control.
	 */
	if (pm_device_runtime_is_enabled(LPCMP_DEV)) {
		zassert_ok(pm_device_runtime_get(LPCMP_DEV),
			   "could not resume the device for the control");
		held = true;
	}

	/* Collected before anything is asserted: an assertion here would leave the
	 * reference held for the rest of the run and every later test with it.
	 */
	out = lpcmp_output();
	both_edges = comparator_set_trigger(LPCMP_DEV, COMPARATOR_TRIGGER_BOTH_EDGES);
	pending = comparator_trigger_is_pending(LPCMP_DEV);
	none = comparator_set_trigger(LPCMP_DEV, COMPARATOR_TRIGGER_NONE);
#if defined(CONFIG_PM_TEST_LPCMP_LOOPBACK)
	tracks = lpcmp_loopback_tracks_input();
#endif
	TC_PRINT("control output=%d CCR0.CMP_EN=%u CCR2=0x%08x\n", out,
		 (unsigned)lpcmp_cmp_en(), lpcmp_ccr2());

	if (held) {
		(void)pm_device_runtime_put(LPCMP_DEV);
	}

	zassert_true(out == 0 || out == 1, "get_output returned %d, want a level", out);
	zassert_ok(both_edges, "set_trigger(BOTH_EDGES) rejected");
	zassert_true(pending >= 0, "trigger_is_pending errored (%d)", pending);
	zassert_ok(none, "set_trigger(NONE) rejected");
#if defined(CONFIG_PM_TEST_LPCMP_LOOPBACK)
	zassert_true(tracks, "output does not track the looped-back GPIO");
#endif
}
```

## src/test_device.c
```c
/*
 * Copyright 2026 NXP
 * SPDX-License-Identifier: Apache-2.0
 */

/**
 * @file
 * @brief The device layer: the driver's SUSPEND/RESUME callbacks, driven directly.
 *
 * Two tests. The round trip is one ordered sequence, because it starts from the
 * state the device booted in. The second is a defect this layer is the only one
 * that can see: an API call that re-enables the hardware behind PM's back.
 */

#include <zephyr/drivers/comparator.h>
#include <zephyr/pm/device.h>
#include <zephyr/ztest.h>

#include <pm_test/state.h>

#include "lpcmp.h"

ZTEST(lpcmp_pm, test_device_suspend_resume)
{
	uint32_t ccr2_before;
	int err;

	/* No runtime PM in this layer, so pm_device_driver_init() resumed it. */
	zassert_pm_state(LPCMP_DEV, PM_DEVICE_STATE_ACTIVE);
	zassert_true(lpcmp_cmp_en(), "CCR0.CMP_EN clear while PM reports ACTIVE");

	ccr2_before = lpcmp_ccr2();

	zassert_ok(pm_device_action_run(LPCMP_DEV, PM_DEVICE_ACTION_SUSPEND),
		   "SUSPEND action rejected");
	zassert_pm_state(LPCMP_DEV, PM_DEVICE_STATE_SUSPENDED);
	zassert_false(lpcmp_cmp_en(), "CCR0.CMP_EN still set after SUSPEND");

	/* Not an error path: the API reads CSR.COUT, so a suspended comparator
	 * yields a stale level. Worth having in the log; nothing to assert on.
	 */
	TC_PRINT("read while suspended: output=%d (stale CSR.COUT)\n", lpcmp_output());

#if defined(CONFIG_PM_TEST_LPCMP_LOOPBACK)
	zassert_false(lpcmp_loopback_tracks_input(),
		      "a SUSPENDED comparator still tracks its input");
#endif

	zassert_ok(pm_device_action_run(LPCMP_DEV, PM_DEVICE_ACTION_RESUME),
		   "RESUME action rejected");
	zassert_pm_state(LPCMP_DEV, PM_DEVICE_STATE_ACTIVE);
	zassert_true(lpcmp_cmp_en(), "CCR0.CMP_EN clear after RESUME");

	zassert_equal(lpcmp_ccr2(), ccr2_before,
		      "CCR2 changed across the round trip: 0x%08x -> 0x%08x", ccr2_before,
		      lpcmp_ccr2());

#if defined(CONFIG_PM_TEST_LPCMP_LOOPBACK)
	zassert_true(lpcmp_loopback_tracks_input(), "output does not track the input after RESUME");
#endif

	/* A redundant action must be refused, not obeyed and not fatal. */
	err = pm_device_action_run(LPCMP_DEV, PM_DEVICE_ACTION_RESUME);
	zassert_equal(err, -EALREADY, "second RESUME returned %d, want -EALREADY", err);

	/*
	 * TURN_ON/TURN_OFF are deliberately not exercised. The comparator is not in a
	 * power domain here, so the only caller would be this test, and pm_device
	 * forces the state to OFF even when the driver refuses the action -- which
	 * would leave every later test in the suite running against an OFF device and
	 * report a harness artefact as a driver defect.
	 */
}

ZTEST(lpcmp_pm, test_device_api_does_not_reenable_while_suspended)
{
	int cb_rc;
	bool reenabled;

	zassert_ok(pm_device_action_run(LPCMP_DEV, PM_DEVICE_ACTION_SUSPEND),
		   "SUSPEND action rejected");
	zassert_pm_state(LPCMP_DEV, PM_DEVICE_STATE_SUSPENDED);

	/*
	 * nxp_lpcmp_set_trigger_callback() clears CMP_EN, updates the callback, then
	 * sets CMP_EN again without consulting the PM state, so it powers the
	 * comparator back up while PM still reports SUSPENDED. Expected to fail until
	 * the driver is fixed -- lpcmp-set-trigger-callback-reenables in
	 * docs/findings.md.
	 */
	cb_rc = comparator_set_trigger_callback(LPCMP_DEV, NULL, NULL);
	reenabled = lpcmp_cmp_en();

	/* Restored before the assertion below, so that a failure here cannot hand the
	 * next test a suspended comparator and be reported twice.
	 */
	zassert_ok(pm_device_action_run(LPCMP_DEV, PM_DEVICE_ACTION_RESUME),
		   "RESUME action rejected");

	TC_PRINT("set_trigger_callback while suspended returned %d\n", cb_rc);
	zassert_false(reenabled, "set_trigger_callback re-enabled a SUSPENDED comparator");
}
```

## src/test_runtime.c
```c
/*
 * Copyright 2026 NXP
 * SPDX-License-Identifier: Apache-2.0
 */

/**
 * @file
 * @brief The runtime layer: pm_device_runtime_get()/put() reference counting.
 *
 * Two tests. The first is one ordered sequence, because what it claims starts from
 * the state the device booted in. The second only needs the device suspended,
 * which is true both at boot and after the first test's last put().
 */

#include <zephyr/pm/device.h>
#include <zephyr/pm/device_runtime.h>
#include <zephyr/ztest.h>

#include <pm_test/state.h>

#include "lpcmp.h"

ZTEST(lpcmp_pm, test_runtime_boots_suspended)
{
	/* With runtime PM, pm_device_driver_init() leaves the device SUSPENDED. */
	zassert_pm_state(LPCMP_DEV, PM_DEVICE_STATE_SUSPENDED);

	/*
	 * And the hardware has to agree. nxp_lpcmp_init() sets CCR0.CMP_EN before
	 * calling pm_device_driver_init(), which records SUSPENDED without running the
	 * SUSPEND callback, so the comparator is left comparing and drawing analog
	 * current that PM believes it has already saved. Expected to fail until the
	 * driver is fixed -- lpcmp-boots-enabled-while-suspended in docs/findings.md.
	 */
	zassert_false(lpcmp_cmp_en(), "CCR0.CMP_EN set at init while PM reports SUSPENDED");
}

ZTEST(lpcmp_pm, test_runtime_reference_counting)
{
	/*
	 * An unwrapped read is recorded, not asserted. The comparator API has no way
	 * to report a suspended device -- get_output() returns the CSR.COUT latch --
	 * and this driver takes no reference of its own, so the call neither resumes
	 * the device nor fails. There is no contract here to hold it to.
	 */
	TC_PRINT("unwrapped output=%d (stale CSR.COUT, no reference taken)\n", lpcmp_output());

	zassert_ok(pm_device_runtime_get(LPCMP_DEV), "runtime_get rejected");
	zassert_pm_state(LPCMP_DEV, PM_DEVICE_STATE_ACTIVE);
	zassert_true(lpcmp_cmp_en(), "CCR0.CMP_EN clear while PM reports ACTIVE");

	/* A second reference must not be a second resume, and releasing it must not
	 * suspend a device somebody else is still holding.
	 */
	zassert_ok(pm_device_runtime_get(LPCMP_DEV), "nested runtime_get rejected");
	zassert_ok(pm_device_runtime_put(LPCMP_DEV), "first runtime_put rejected");
	zassert_pm_state(LPCMP_DEV, PM_DEVICE_STATE_ACTIVE);
	zassert_true(lpcmp_cmp_en(), "CCR0.CMP_EN cleared while a reference was still held");

	zassert_ok(pm_device_runtime_put(LPCMP_DEV), "last runtime_put rejected");
	zassert_pm_state(LPCMP_DEV, PM_DEVICE_STATE_SUSPENDED);
	zassert_false(lpcmp_cmp_en(), "CCR0.CMP_EN still set after the last runtime_put");
}
```

## src/test_system.c
```c
/*
 * Copyright 2026 NXP
 * SPDX-License-Identifier: Apache-2.0
 */

/**
 * @file
 * @brief The system layer: the per-device power state constraint.
 *
 * &lpcmp0 lists the states that cut the comparator's analog bias in
 * zephyr,disabling-power-states (see constraints.overlay). Unlike the LPADC driver,
 * the LPCMP driver takes no policy lock of its own -- a comparator is useful for as
 * long as the application wants its output, not for the length of one call -- so
 * holding the constraint is the application's job, and both tests here are written
 * the way an application has to write it.
 */

#include <zephyr/pm/device_runtime.h>
#include <zephyr/pm/policy.h>
#include <zephyr/pm/state.h>
#include <zephyr/ztest.h>

#include <pm_test/lowpower.h>

#include "lpcmp.h"

ZTEST(lpcmp_pm, test_system_constraint_covers_the_declared_states)
{
	unsigned int declared = 0;

	pm_test_console_quiesce();

	for (enum pm_state state = PM_STATE_ACTIVE; state < PM_STATE_COUNT; state++) {
		zassert_false(pm_policy_state_lock_is_active(state, 0),
			      "power state %d was already locked before the test", state);
	}

	pm_policy_device_power_lock_get(LPCMP_DEV);

	for (enum pm_state state = PM_STATE_ACTIVE; state < PM_STATE_COUNT; state++) {
		bool disabling = pm_policy_device_is_disabling_state(LPCMP_DEV, state, 0);

		declared += disabling ? 1U : 0U;
		zassert_equal(pm_policy_state_lock_is_active(state, 0), disabling,
			      "power state %d: locked=%d but declared disabling=%d", state,
			      (int)pm_policy_state_lock_is_active(state, 0), (int)disabling);
	}

	/*
	 * Without this the loop above would compare "nothing locked" against "nothing
	 * declared" and pass while proving nothing -- which is exactly what a
	 * constraints.overlay that failed to reach &lpcmp0 looks like. States that are
	 * listed but disabled in the devicetree are dropped from the generated table,
	 * so on a board where all of them are disabled this is the check that fires.
	 */
	zassert_true(declared > 0,
		     "no disabling power state reached the constraint table; is "
		     "constraints.overlay applied to this board's comparator node?");

	pm_policy_device_power_lock_put(LPCMP_DEV);

	pm_test_console_quiesce();
	for (enum pm_state state = PM_STATE_ACTIVE; state < PM_STATE_COUNT; state++) {
		zassert_false(pm_policy_state_lock_is_active(state, 0),
			      "power state %d is still locked after the constraint was "
			      "released", state);
	}
}

ZTEST(lpcmp_pm, test_system_comparator_usable_under_the_constraint)
{
	int out;
	bool enabled;

	/* The pair an application needs: the reference keeps the block powered, the
	 * constraint keeps the policy from picking a state that would unpower it.
	 */
	pm_policy_device_power_lock_get(LPCMP_DEV);
	zassert_ok(pm_device_runtime_get(LPCMP_DEV), "runtime_get rejected");

	out = lpcmp_output();
	enabled = lpcmp_cmp_en();

	/* Released before anything is asserted: a failure must not leave a lock behind,
	 * which would silently block those states for the rest of the run.
	 */
	(void)pm_device_runtime_put(LPCMP_DEV);
	pm_policy_device_power_lock_put(LPCMP_DEV);

	zassert_true(enabled, "CCR0.CMP_EN clear while a runtime reference was held");
	zassert_true(out == 0 || out == 1, "get_output returned %d, want a level", out);
}
```
