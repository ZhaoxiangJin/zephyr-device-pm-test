## CMakeLists.txt
```
# Copyright 2026 NXP
# SPDX-License-Identifier: Apache-2.0

cmake_minimum_required(VERSION 3.20.0)

# Pulls in this repository as a Zephyr module, which is what makes lib/pm_test,
# include/pm_test and the snippets/pm-* snippets available. Nothing has to be
# passed on the command line: `-S pm-<layer>` is the whole interface.
list(APPEND EXTRA_ZEPHYR_MODULES ${CMAKE_CURRENT_LIST_DIR}/../..)

find_package(Zephyr REQUIRED HINTS $ENV{ZEPHYR_BASE})
project(lpdac_device_pm)

# The suite, the register view, and the control test that every layer runs.
target_sources(app PRIVATE src/main.c src/lpdac.c src/test_control.c)

# One file per layer. A layer's file is the only place that layer's claims live,
# so a build for a layer contains no code belonging to any other.
target_sources_ifdef(CONFIG_PM_TEST_LAYER_DEVICE     app PRIVATE src/test_device.c)
target_sources_ifdef(CONFIG_PM_TEST_LAYER_RUNTIME    app PRIVATE src/test_runtime.c)
target_sources_ifdef(CONFIG_PM_TEST_LAYER_SYSTEM     app PRIVATE src/test_system.c)
target_sources_ifdef(CONFIG_PM_TEST_LAYER_SYSMANAGED app PRIVATE src/test_lowpower.c)
target_sources_ifdef(CONFIG_PM_TEST_LAYER_DPD        app PRIVATE src/test_lowpower.c)
```

## prj.conf
```kconfig
# Copyright 2026 NXP
# SPDX-License-Identifier: Apache-2.0
#
# Layer-independent configuration only. The PM symbols come from the layer, which
# comes from the pm-* snippet; see lib/pm_test/Kconfig and docs/pm-layers.md.

CONFIG_ZTEST=y
CONFIG_PM_TEST=y
CONFIG_MAIN_STACK_SIZE=2048
CONFIG_ZTEST_STACK_SIZE=2048

CONFIG_DAC=y

# Driver logging at info level, immediate: the run ends with interrupts locked so
# that the core cannot park in WFI, and a deferred log would never be flushed.
# include/pm_test/layer.h asserts this pairing.
CONFIG_LOG=y
CONFIG_LOG_MODE_IMMEDIATE=y
CONFIG_DAC_LOG_LEVEL_INF=y
```

## constraints.overlay
```dts
/*
 * Copyright 2026 NXP
 * SPDX-License-Identifier: Apache-2.0
 *
 * System-PM constraint layer: mark which SoC power states stop the DAC output.
 * Stacked on top of the per-board overlay in boards/ for the system layer (via
 * EXTRA_DTC_OVERLAY_FILE, so the board overlay is still picked up automatically).
 *
 * The analog output survives none of the three: per MCX Nx4x RM Rev. 6_RC2 Table
 * 336, and the equivalent table in every MCXA RM, the DAC analog block is off in
 * Deep Sleep, Power Down and Deep Power Down unless an SPC low-power request asks
 * for it. Deep Power Down also gates the CORE domain and resets the registers,
 * which is the stronger loss the dpd layer is about.
 *
 * Every MCXN and MCXA SoC dtsi now carries this exact list on its DAC nodes, so
 * here it only restates what the SoC already declares. It is kept because the
 * layer is about the constraint mechanism, not about who declared it: the layer
 * still has to pass on a board whose SoC dtsi predates that list.
 */

&dac0 {
	zephyr,disabling-power-states = <&deepsleep &powerdown &deeppowerdown>;
};
```

## boards/frdm_mcxa156.overlay
```dts
/*
 * Copyright 2026 NXP
 * SPDX-License-Identifier: Apache-2.0
 *
 * DAC wiring for the device-PM test on FRDM-MCXA156.
 *
 * DAC0 channel 0, 12-bit, output on J2-9 (P2_2). Nothing has to be connected: this
 * test reads GCR, not the output voltage.
 *
 * The console is lpuart0 (P0_2/P0_3), so DAC0_OUT takes no console pin here.
 *
 * The board dts already sets &dac0 to "okay" and applies pinmux_dac0.
 */

/ {
	zephyr,user {
		dac = <&dac0>;
		dac-channel-id = <0>;
		dac-resolution = <12>;
	};
};
```

## boards/frdm_mcxa266.overlay
```dts
/*
 * Copyright 2026 NXP
 * SPDX-License-Identifier: Apache-2.0
 *
 * DAC wiring for the device-PM test on FRDM-MCXA266.
 *
 * DAC0_OUT and the board console's LPUART2_TXD share P2_2.
 * This register-only test leaves the pad with the console.
 */

/ {
	zephyr,user {
		dac = <&dac0>;
		dac-channel-id = <0>;
		dac-resolution = <12>;
		dac-console-shared-pad;
	};
};

&dac0 {
	/delete-property/ pinctrl-0;
	/delete-property/ pinctrl-names;
};
```

## boards/frdm_mcxa346.overlay
```dts
/*
 * Copyright 2026 NXP
 * SPDX-License-Identifier: Apache-2.0
 *
 * DAC wiring for the device-PM test on FRDM-MCXA346.
 *
 * DAC0_OUT and the board console's LPUART2_TXD share P2_2.
 * This register-only test leaves the pad with the console.
 */

/ {
	zephyr,user {
		dac = <&dac0>;
		dac-channel-id = <0>;
		dac-resolution = <12>;
	};
};

&dac0 {
	/delete-property/ pinctrl-0;
	/delete-property/ pinctrl-names;
};
```

## boards/frdm_mcxa366.overlay
```dts
/*
 * Copyright 2026 NXP
 * SPDX-License-Identifier: Apache-2.0
 *
 * DAC wiring for the device-PM test on FRDM-MCXA366.
 *
 * DAC0_OUT and the board console's LPUART2_TXD share P2_2.
 * This register-only test leaves the pad with the console.
 */

/ {
	zephyr,user {
		dac = <&dac0>;
		dac-channel-id = <0>;
		dac-resolution = <12>;
		dac-console-shared-pad;
	};
};

&dac0 {
	/delete-property/ pinctrl-0;
	/delete-property/ pinctrl-names;
};
```

## boards/frdm_mcxa577.overlay
```dts
/*
 * Copyright 2026 NXP
 * SPDX-License-Identifier: Apache-2.0
 *
 * DAC wiring for the device-PM test on FRDM-MCXA577.
 *
 * DAC0 channel 0, 12-bit, output on J8-23 (P2_2). Nothing has to be connected: this
 * test reads GCR, not the output voltage.
 *
 * The console is lpuart1 (P3_20/P3_21), so DAC0_OUT takes no console pin here.
 */

/ {
	zephyr,user {
		dac = <&dac0>;
		dac-channel-id = <0>;
		dac-resolution = <12>;
	};
};
```

## src/main.c
```c
/*
 * Copyright 2026 NXP
 * SPDX-License-Identifier: Apache-2.0
 */

/**
 * @file
 * @brief LPDAC device-PM suite: the suite hooks, and nothing else.
 *
 * Which layer this build tests, and therefore which src/test_*.c is compiled in,
 * is decided by the pm-* snippet on the command line. See docs/pm-layers.md.
 */

#include <zephyr/ztest.h>

#include <pm_test/layer.h>
#include <pm_test/state.h>

#include "lpdac.h"

static void *lpdac_pm_setup(void)
{
	(void)pm_test_setup();
	zassert_true(device_is_ready(LPDAC_DEV), "%s is not ready", LPDAC_DEV->name);
#if defined(CONFIG_PM_TEST_LAYER_RUNTIME)
	lpdac_capture_runtime_boot();
#endif
	lpdac_report_configuration();
	pm_test_note_state(LPDAC_DEV, "at boot");
	return NULL;
}

static void lpdac_pm_before(void *fixture)
{
	ARG_UNUSED(fixture);

	zassert_true(device_is_ready(LPDAC_DEV), "%s is not ready", LPDAC_DEV->name);
}

ZTEST_SUITE(lpdac_pm, NULL, lpdac_pm_setup, lpdac_pm_before, NULL, NULL);
```

## src/lpdac.c
```c
/*
 * Copyright 2026 NXP
 * SPDX-License-Identifier: Apache-2.0
 */

/**
 * @file
 * @brief The register view of the LPDAC block, shared by every layer.
 */

#include <zephyr/drivers/dac.h>
#include <zephyr/sys/util.h>
#include <zephyr/tc_util.h>

#include <fsl_device_registers.h>

#include "lpdac.h"

#if defined(FSL_FEATURE_LPDAC_HAS_GCR_BUF_EN) && \
	FSL_FEATURE_LPDAC_HAS_GCR_BUF_EN
#define LPDAC_OUTPUT_ENABLE_MASK (LPDAC_GCR_DACEN_MASK | LPDAC_GCR_BUF_EN_MASK)
#else
#define LPDAC_OUTPUT_ENABLE_MASK LPDAC_GCR_DACEN_MASK
#endif

static LPDAC_Type *const base = (LPDAC_Type *)DT_REG_ADDR(LPDAC_NODE);

static const struct dac_channel_cfg lpdac_ch_cfg = {
	.channel_id = LPDAC_CHANNEL_ID,
	.resolution = LPDAC_RESOLUTION,
};

int lpdac_setup(void)
{
	return dac_channel_setup(LPDAC_DEV, &lpdac_ch_cfg);
}

int lpdac_write(uint32_t value)
{
	return dac_write_value(LPDAC_DEV, LPDAC_CHANNEL_ID, value);
}

uint32_t lpdac_gcr(void)
{
	return base->GCR;
}

uint32_t lpdac_gcr_config(void)
{
	return base->GCR & ~LPDAC_OUTPUT_ENABLE_MASK;
}

bool lpdac_output_on(void)
{
	uint32_t enables = base->GCR & LPDAC_OUTPUT_ENABLE_MASK;

	return enables == LPDAC_OUTPUT_ENABLE_MASK;
}

bool lpdac_output_off(void)
{
	return (base->GCR & LPDAC_OUTPUT_ENABLE_MASK) == 0U;
}

void lpdac_gcr_clobber(void)
{
	base->GCR = 0U;
}

void lpdac_report_configuration(void)
{
	TC_PRINT("%s at 0x%08x: channel %u, %u-bit, mid-scale code %u\n", LPDAC_DEV->name,
		 (unsigned int)DT_REG_ADDR(LPDAC_NODE), (unsigned int)LPDAC_CHANNEL_ID,
		 (unsigned int)LPDAC_RESOLUTION, (unsigned int)LPDAC_MIDSCALE);
}

void lpdac_report_hw(const char *when)
{
	lpdac_report_hw_snapshot(when, lpdac_gcr());
}

void lpdac_report_hw_snapshot(const char *when, uint32_t gcr)
{
	TC_PRINT("hw(%s) GCR=0x%08x DACEN=%u\n", when, gcr,
		 (gcr & LPDAC_GCR_DACEN_MASK) != 0U ? 1U : 0U);
}
```

## src/lpdac.h
```c
/*
 * Copyright 2026 NXP
 * SPDX-License-Identifier: Apache-2.0
 */

/**
 * @file
 * @brief What every layer of the LPDAC case needs from the hardware.
 *
 * A DAC output has no completion event, so there is no operation whose success
 * could stand in for "the block is powered and configured" the way a conversion
 * does next door. What this case observes instead is GCR, the only register the
 * driver's PM callbacks write: bit DACEN is the analog output buffer, which
 * SUSPEND clears and RESUME puts back, and the rest of the register is the
 * devicetree configuration, which only TURN_ON rebuilds.
 *
 * Two things are deliberately not observed. DATA is write-only -- MCX Nx4x RM
 * Rev. 6_RC2 section 42.7.1.4 shows a zero read row -- so the code the driver
 * restores cannot be read back, and the output level itself needs a meter rather
 * than a test. Every claim below is therefore about the buffer being on and the
 * block being configured, not about the voltage.
 */

#ifndef LPDAC_PM_H_
#define LPDAC_PM_H_

#include <stdbool.h>
#include <stdint.h>
#include <zephyr/device.h>
#include <zephyr/devicetree.h>

#define LPDAC_USER_NODE DT_PATH(zephyr_user)

#if !DT_NODE_HAS_PROP(LPDAC_USER_NODE, dac) ||                                                     \
	!DT_NODE_HAS_PROP(LPDAC_USER_NODE, dac_channel_id) ||                                      \
	!DT_NODE_HAS_PROP(LPDAC_USER_NODE, dac_resolution)
#error "This board has no DAC wiring: add boards/<board_target>.overlay with a zephyr,user node"
#endif

#define LPDAC_NODE DT_PHANDLE(LPDAC_USER_NODE, dac)

#if !DT_NODE_HAS_COMPAT(LPDAC_NODE, nxp_lpdac)
#error "zephyr,user dac must name an nxp,lpdac node; nxp,hpdac is a different driver"
#endif

#if !defined(CONFIG_DAC_MCUX_LPDAC)
#error "CONFIG_DAC_MCUX_LPDAC is not enabled, so there is no driver to test"
#endif

/** The DAC under test. */
#define LPDAC_DEV DEVICE_DT_GET(LPDAC_NODE)

/** The channel and resolution the board's zephyr,user node names. */
#define LPDAC_CHANNEL_ID DT_PROP(LPDAC_USER_NODE, dac_channel_id)
#define LPDAC_RESOLUTION DT_PROP(LPDAC_USER_NODE, dac_resolution)

/** Mid-scale: in range on every resolution, and not the reset value. */
#define LPDAC_MIDSCALE (BIT(LPDAC_RESOLUTION) / 2U)

/**
 * @brief Configure channel @ref LPDAC_CHANNEL_ID.
 *
 * Also exercised as a claim in its own right by the layers that call it against a
 * device that is not active, where it has to be refused.
 *
 * @return 0 on success, negative errno from dac_channel_setup() otherwise.
 */
int lpdac_setup(void);

/**
 * @brief Drive @p value out of that channel.
 *
 * @return 0 on success, negative errno from dac_write_value() otherwise.
 */
int lpdac_write(uint32_t value);

#if defined(CONFIG_PM_TEST_LAYER_RUNTIME)
/** @brief Capture the runtime boot state before the control configures the DAC. */
void lpdac_capture_runtime_boot(void);
#endif

/** @brief GCR in full, for a log line or an assertion message. */
uint32_t lpdac_gcr(void);

/** @brief GCR without DACEN: the configuration half, which TURN_ON rebuilds. */
uint32_t lpdac_gcr_config(void);

/** @brief True while GCR[DACEN] says the analog output buffer is on. */
bool lpdac_output_on(void);

/**
 * @brief Clear GCR, leaving the block looking the way a reset leaves it.
 *
 * What stands in for a power cycle in a layer where nothing really cut power to
 * the block, so that TURN_ON has something to restore.
 */
void lpdac_gcr_clobber(void);

/** @brief Print what the devicetree asked for, once, from the suite setup. */
void lpdac_report_configuration(void);

/**
 * @brief Print the register view.
 *
 * @param when short label for where in the sequence this is, e.g. "before".
 */
void lpdac_report_hw(const char *when);

#endif /* LPDAC_PM_H_ */
```

## src/test_control.c
```c
/*
 * Copyright 2026 NXP
 * SPDX-License-Identifier: Apache-2.0
 */

/**
 * @file
 * @brief The control: this case really does drive the DAC.
 *
 * Compiled into every layer. If this fails, no verdict from the layer under test
 * means anything -- which is the whole reason the baseline layer exists as a layer.
 */

#include <zephyr/pm/device_runtime.h>
#include <zephyr/ztest.h>

#include "lpdac.h"

ZTEST(lpdac_pm, test_control_write)
{
	bool held = false;
	uint32_t config;
	bool on;
	int setup_rc;
	int write_rc;

	/*
	 * Where runtime PM owns the device it boots suspended, and this driver takes
	 * no reference of its own: the consumer owns the output's lifetime, because a
	 * DAC output has no completion event a put() could hang on. So the control has
	 * to ask for the device explicitly. That an unwrapped call is refused instead
	 * of being served is test_runtime.c's claim, not a premise of the control.
	 */
	if (pm_device_runtime_is_enabled(LPDAC_DEV)) {
		zassert_ok(pm_device_runtime_get(LPDAC_DEV),
			   "could not resume the device for the control write");
		held = true;
	}

	setup_rc = lpdac_setup();
	write_rc = lpdac_write(LPDAC_MIDSCALE);
	config = lpdac_gcr_config();
	on = lpdac_output_on();
	lpdac_report_hw("control");

	if (held) {
		/* Before the assertions below: a failure must not leak the reference. */
		(void)pm_device_runtime_put(LPDAC_DEV);
	}

	zassert_ok(setup_rc, "dac_channel_setup() failed (%d)", setup_rc);
	zassert_ok(write_rc, "dac_write_value(%u) failed (%d)", (unsigned int)LPDAC_MIDSCALE,
		   write_rc);
	zassert_true(on, "GCR[DACEN] clear after a write, so the output buffer is off");

	/*
	 * The rest of GCR is what the driver wrote from the devicetree. A cleared
	 * register is what a reset leaves, and every later layer tells "restored" from
	 * "came back from reset" by comparing against this, so a case in which it is
	 * empty proves nothing anywhere.
	 */
	zassert_not_equal(config, 0U, "GCR carries no configuration after channel setup");
}
```

## src/test_device.c
```c
/*
 * Copyright 2026 NXP
 * SPDX-License-Identifier: Apache-2.0
 */

/**
 * @file
 * @brief The device layer: the driver's PM callbacks, driven directly.
 *
 * SUSPEND/RESUME owns the output buffer; TURN_OFF/TURN_ON owns the register
 * block. GCR is cleared by hand to exercise replay without a physical power cut.
 * Both a driven output and a configured but idle DAC must retain their state.
 */

#include <zephyr/pm/device.h>
#include <zephyr/ztest.h>

#include <pm_test/state.h>

#include "lpdac.h"

ZTEST(lpdac_pm, test_device_suspend_resume)
{
	uint32_t config;
	int setup_rc;
	int write_rc;
	int err;

	/* No runtime PM in this layer, so pm_device_driver_init() resumed it. */
	zassert_pm_state(LPDAC_DEV, PM_DEVICE_STATE_ACTIVE);

	zassert_ok(lpdac_setup(), "channel setup failed");
	zassert_ok(lpdac_write(LPDAC_MIDSCALE), "write failed");
	zassert_true(lpdac_output_on(), "GCR[DACEN] clear while PM reports ACTIVE");
	config = lpdac_gcr_config();
	zassert_not_equal(config, 0U, "GCR carries no configuration after channel setup");

	zassert_ok(pm_device_action_run(LPDAC_DEV, PM_DEVICE_ACTION_SUSPEND),
		   "SUSPEND action rejected");
	zassert_pm_state(LPDAC_DEV, PM_DEVICE_STATE_SUSPENDED);
	zassert_false(lpdac_output_on(), "GCR[DACEN] still set after SUSPEND");
	zassert_equal(lpdac_gcr_config(), config,
		      "SUSPEND changed the configuration: 0x%08x -> 0x%08x", config,
		      lpdac_gcr_config());

	/*
	 * The API contract while the device is not active. Returning an error is the
	 * whole point: the alternative is writing GCR and DATA behind PM's back, which
	 * either drives a pin PM believes it has quietened or is thrown away by the
	 * next power cycle, and the caller is told neither.
	 */
	write_rc = lpdac_write(LPDAC_MIDSCALE);
	setup_rc = lpdac_setup();
	zassert_equal(write_rc, -EBUSY, "write against a SUSPENDED device returned %d, want -EBUSY",
		      write_rc);
	zassert_equal(setup_rc, -EBUSY,
		      "channel setup against a SUSPENDED device returned %d, want -EBUSY",
		      setup_rc);
	zassert_false(lpdac_output_on(), "a refused call re-enabled the output buffer");

	zassert_ok(pm_device_action_run(LPDAC_DEV, PM_DEVICE_ACTION_RESUME),
		   "RESUME action rejected");
	zassert_pm_state(LPDAC_DEV, PM_DEVICE_STATE_ACTIVE);
	lpdac_report_hw("after-resume");

	/* The output the consumer last asked for, and the configuration it was made
	 * with, both come back without the consumer doing anything.
	 */
	zassert_true(lpdac_output_on(), "RESUME did not put the output buffer back");
	zassert_equal(lpdac_gcr_config(), config,
		      "RESUME left a different configuration: 0x%08x, want 0x%08x",
		      lpdac_gcr_config(), config);

	/* A redundant action must be refused, not obeyed and not fatal. */
	err = pm_device_action_run(LPDAC_DEV, PM_DEVICE_ACTION_RESUME);
	zassert_equal(err, -EALREADY, "second RESUME returned %d, want -EALREADY", err);
}

ZTEST(lpdac_pm, test_device_turn_on_rebuilds_the_register_block)
{
	uint32_t config;
	uint32_t config_clobbered;
	uint32_t config_after_turn_on;
	bool on_after_turn_on;
	bool on_after_resume;
	int suspend_rc;
	int turn_off_rc;
	int turn_on_rc;
	int resume_rc;
	int off_setup_rc;
	int off_write_rc;

	zassert_pm_state(LPDAC_DEV, PM_DEVICE_STATE_ACTIVE);
	zassert_ok(lpdac_setup(), "channel setup failed");
	zassert_ok(lpdac_write(LPDAC_MIDSCALE), "write failed");
	config = lpdac_gcr_config();
	zassert_not_equal(config, 0U, "GCR carries no configuration after channel setup");

	/* Collected in one go and asserted afterwards, so that a failure cannot hand
	 * the next test a device the core still records as OFF.
	 */
	suspend_rc = pm_device_action_run(LPDAC_DEV, PM_DEVICE_ACTION_SUSPEND);
	lpdac_gcr_clobber();
	config_clobbered = lpdac_gcr_config();

	turn_off_rc = pm_device_action_run(LPDAC_DEV, PM_DEVICE_ACTION_TURN_OFF);
	off_setup_rc = lpdac_setup();
	off_write_rc = lpdac_write(LPDAC_MIDSCALE);

	turn_on_rc = pm_device_action_run(LPDAC_DEV, PM_DEVICE_ACTION_TURN_ON);
	config_after_turn_on = lpdac_gcr_config();
	on_after_turn_on = lpdac_output_on();
	lpdac_report_hw("after-turn-on");

	resume_rc = pm_device_action_run(LPDAC_DEV, PM_DEVICE_ACTION_RESUME);
	on_after_resume = lpdac_output_on();
	lpdac_report_hw("after-resume");

	zassert_ok(suspend_rc, "SUSPEND rejected (%d)", suspend_rc);
	zassert_ok(turn_off_rc, "TURN_OFF rejected (%d)", turn_off_rc);
	zassert_equal(off_setup_rc, -EBUSY, "channel setup while OFF returned %d",
		      off_setup_rc);
	zassert_equal(off_write_rc, -EBUSY, "write while OFF returned %d", off_write_rc);
	zassert_ok(turn_on_rc, "TURN_ON rejected (%d)", turn_on_rc);
	zassert_ok(resume_rc, "RESUME rejected (%d)", resume_rc);
	zassert_pm_state(LPDAC_DEV, PM_DEVICE_STATE_ACTIVE);

	/* Before anything else: a clobber that did not take would make the restore
	 * assertion below pass without the driver having rebuilt a thing.
	 */
	zassert_not_equal(config_clobbered, config,
			  "the clobber did not take, so this test proves nothing");

	zassert_equal(config_after_turn_on, config,
		      "TURN_ON left 0x%08x, want the devicetree configuration 0x%08x",
		      config_after_turn_on, config);

	/*
	 * And it has to stop there. TURN_ON returns with the core about to record the
	 * device as suspended, so a block left converting would be driving a pin that
	 * PM believes is quiet; putting the output back is RESUME's job.
	 */
	zassert_false(on_after_turn_on, "TURN_ON left the output buffer on");
	zassert_true(on_after_resume, "RESUME did not put the output buffer back");
}

ZTEST(lpdac_pm, test_device_configured_idle_stays_idle)
{
	uint32_t config;

	zassert_pm_state(LPDAC_DEV, PM_DEVICE_STATE_ACTIVE);
	zassert_ok(lpdac_setup(), "channel setup failed");
	config = lpdac_gcr_config();
	zassert_not_equal(config, 0U, "GCR carries no configuration after channel setup");
	zassert_false(lpdac_output_on(), "channel setup enabled an unwritten output");

	zassert_ok(pm_device_action_run(LPDAC_DEV, PM_DEVICE_ACTION_SUSPEND),
		   "SUSPEND rejected");
	zassert_ok(pm_device_action_run(LPDAC_DEV, PM_DEVICE_ACTION_RESUME),
		   "RESUME rejected");
	zassert_false(lpdac_output_on(), "RESUME enabled an unwritten output");
	zassert_equal(lpdac_gcr_config(), config, "RESUME changed idle configuration");

	zassert_ok(pm_device_action_run(LPDAC_DEV, PM_DEVICE_ACTION_SUSPEND),
		   "second SUSPEND rejected");
	lpdac_gcr_clobber();
	zassert_not_equal(lpdac_gcr_config(), config, "GCR clobber did not take");
	zassert_ok(pm_device_action_run(LPDAC_DEV, PM_DEVICE_ACTION_TURN_OFF),
		   "TURN_OFF rejected");
	zassert_pm_state(LPDAC_DEV, PM_DEVICE_STATE_OFF);
	zassert_ok(pm_device_action_run(LPDAC_DEV, PM_DEVICE_ACTION_TURN_ON),
		   "TURN_ON rejected");
	zassert_pm_state(LPDAC_DEV, PM_DEVICE_STATE_SUSPENDED);
	zassert_equal(lpdac_gcr_config(), config, "TURN_ON did not replay idle configuration");
	zassert_false(lpdac_output_on(), "TURN_ON enabled an unwritten output");

	zassert_ok(pm_device_action_run(LPDAC_DEV, PM_DEVICE_ACTION_RESUME),
		   "RESUME after TURN_ON rejected");
	zassert_pm_state(LPDAC_DEV, PM_DEVICE_STATE_ACTIVE);
	zassert_equal(lpdac_gcr_config(), config, "RESUME changed replayed configuration");
	zassert_false(lpdac_output_on(), "RESUME after TURN_ON enabled an unwritten output");
}
```

## src/test_lowpower.c
```c
/*
 * Copyright 2026 NXP
 * SPDX-License-Identifier: Apache-2.0
 */

/**
 * @file
 * @brief The sysmanaged and dpd layers: the device sweep across one transition.
 *
 * One file for two layers, because the sequence is identical and only the state
 * being entered differs -- and that difference is what separates the two claims.
 * In sysmanaged the sweep's SUSPEND and RESUME are all that happen, so putting the
 * output back is enough. In dpd the CORE domain is power gated: GCR comes back at
 * its reset value and nothing re-runs driver init, so the domain's TURN_ON has to
 * rebuild the devicetree configuration before RESUME can put the output back on top
 * of it. dpd is the only layer that can catch a driver with no restore path.
 *
 * The application's part is the reference held across the transition, which is why
 * the sequence below takes one: this driver never resumes itself, so an output that
 * nobody is holding is not one the sweep owes anything to.
 */

#include <zephyr/pm/device.h>
#include <zephyr/ztest.h>

#include <pm_test/lowpower.h>
#include <pm_test/state.h>

#include "lpdac.h"

ZTEST(lpdac_pm, test_sweep_across_transition)
{
	uint32_t config;
	uint32_t config_after;
	uint32_t gcr_after;
	bool on_after;
	bool off_for_report = false;
	int report_quiesce_ret = 0;
	const bool shared_console_pad =
		DT_PROP_OR(LPDAC_USER_NODE, dac_console_shared_pad, false);

	/* No runtime PM in these layers, so the sweep is the only thing that will
	 * suspend the device.
	 */
	zassert_pm_state(LPDAC_DEV, PM_DEVICE_STATE_ACTIVE);

	zassert_ok(lpdac_setup(), "channel setup failed before the transition");
	zassert_ok(lpdac_write(LPDAC_MIDSCALE), "write failed before the transition");
	zassert_true(lpdac_output_on(), "output buffer off before the transition");
	config = lpdac_gcr_config();
	lpdac_report_hw("before");

	pm_test_enter_transition();

	/* Sampled before the console is revived: reviving it takes time, and the
	 * question is what the block looked like the moment the sweep handed it back.
	 */
	config_after = lpdac_gcr_config();
	on_after = lpdac_output_on();
	gcr_after = lpdac_gcr();

	if (shared_console_pad) {
		/* Snapshot first, then release the shared pad. */
		report_quiesce_ret = lpdac_setup();
		if (report_quiesce_ret == 0) {
			off_for_report = lpdac_output_off();
		}
	}

	pm_test_console_resume(PM_TEST_CONSOLE_REINIT_PINMUX);
	TC_PRINT("resumed from %s\n", PM_TEST_TRANSITION_NAME);
	lpdac_report_hw_snapshot("after-resume", gcr_after);
	if (shared_console_pad) {
		lpdac_report_hw("report-quiesced");
		zassert_ok(report_quiesce_ret,
			   "cannot release the DAC/UART shared pad");
		zassert_true(off_for_report,
			     "DAC output still drives the console pad");
	}

	/*
	 * pm_resume_devices() walks the devices it suspended in init order, so the
	 * core domain's TURN_ON has already run by the time the DAC's own RESUME does.
	 * The two together have to leave the output the consumer was holding.
	 */
	zassert_pm_state(LPDAC_DEV, PM_DEVICE_STATE_ACTIVE);
	zassert_equal(config_after, config,
		      "the configuration did not survive the transition: 0x%08x, want 0x%08x",
		      config_after, config);
	zassert_true(on_after, "the output was not put back for a consumer that never let go");
}
```

## src/test_runtime.c
```c
/*
 * Copyright 2026 NXP
 * SPDX-License-Identifier: Apache-2.0
 */

/**
 * @file
 * @brief The runtime layer: the consumer owns the output, and says so with a
 *        reference.
 *
 * This driver takes no runtime PM reference of its own. A DAC output is held for
 * as long as the application wants a voltage on the pin, and there is no
 * completion event a put() could hang on, so wrapping each API call in its own
 * get/put would drop the output the moment the call returned. The reference is the
 * consumer's, and a call that arrives without one is refused.
 *
 * Suite setup captures the boot state before any test configures the DAC.
 * The reference-counting test leaves it suspended.
 */

#include <zephyr/pm/device.h>
#include <zephyr/pm/device_runtime.h>
#include <zephyr/ztest.h>

#include <pm_test/state.h>

#include "lpdac.h"

static struct {
	bool enabled;
	enum pm_device_state state;
	int state_rc;
	int setup_rc;
} runtime_boot;

void lpdac_capture_runtime_boot(void)
{
	runtime_boot.enabled = pm_device_runtime_is_enabled(LPDAC_DEV);
	runtime_boot.state_rc = pm_device_state_get(LPDAC_DEV, &runtime_boot.state);
	runtime_boot.setup_rc = lpdac_setup();
}

ZTEST(lpdac_pm, test_runtime_boots_without_a_consumer)
{
	zassert_true(runtime_boot.enabled,
		     "runtime PM is not enabled on %s, so this layer tests nothing",
		     LPDAC_DEV->name);

	zassert_ok(runtime_boot.state_rc, "pm_device_state_get() failed");
	zassert_true((runtime_boot.state == PM_DEVICE_STATE_SUSPENDED) ||
		     (runtime_boot.state == PM_DEVICE_STATE_OFF),
		     "%s booted %s, want SUSPENDED or OFF under runtime PM", LPDAC_DEV->name,
		     pm_device_state_str(runtime_boot.state));

	zassert_equal(runtime_boot.setup_rc, -EBUSY,
		      "channel setup without a reference returned %d, want -EBUSY",
		      runtime_boot.setup_rc);
}

ZTEST(lpdac_pm, test_runtime_reference_counting)
{
	uint32_t config;

	zassert_ok(pm_device_runtime_get(LPDAC_DEV), "runtime_get rejected");
	zassert_pm_state(LPDAC_DEV, PM_DEVICE_STATE_ACTIVE);

	zassert_ok(lpdac_setup(), "channel setup under a held reference failed");
	zassert_ok(lpdac_write(LPDAC_MIDSCALE), "write under a held reference failed");
	zassert_true(lpdac_output_on(), "GCR[DACEN] clear while PM reports ACTIVE");
	config = lpdac_gcr_config();
	zassert_not_equal(config, 0U, "GCR carries no configuration after channel setup");

	/* A second reference must not be a second resume, and releasing it must not
	 * drop an output somebody else is still holding.
	 */
	zassert_ok(pm_device_runtime_get(LPDAC_DEV), "nested runtime_get rejected");
	zassert_ok(pm_device_runtime_put(LPDAC_DEV), "first runtime_put rejected");
	zassert_pm_state(LPDAC_DEV, PM_DEVICE_STATE_ACTIVE);
	zassert_true(lpdac_output_on(), "output buffer switched off while a reference was held");

	zassert_ok(pm_device_runtime_put(LPDAC_DEV), "last runtime_put rejected");
	zassert_pm_state(LPDAC_DEV, PM_DEVICE_STATE_SUSPENDED);
	lpdac_report_hw("after-put");
	zassert_false(lpdac_output_on(), "GCR[DACEN] still set after the last runtime_put");
	zassert_equal(lpdac_setup(), -EBUSY, "setup without a runtime reference was accepted");
	zassert_equal(lpdac_write(LPDAC_MIDSCALE), -EBUSY,
		      "write without a runtime reference was accepted");
	zassert_pm_state(LPDAC_DEV, PM_DEVICE_STATE_SUSPENDED);
	zassert_false(lpdac_output_on(), "a refused API call enabled the output");
	zassert_equal(lpdac_gcr_config(), config, "a refused API call changed configuration");

	/*
	 * And the consumer gets its output back by taking the reference again, without
	 * calling channel_setup() a second time: what it configured is the driver's to
	 * remember across a suspend it did not ask for.
	 */
	zassert_ok(pm_device_runtime_get(LPDAC_DEV), "runtime_get after the put rejected");
	lpdac_report_hw("after-reget");
	zassert_true(lpdac_output_on(), "the output did not come back with the reference");
	zassert_equal(lpdac_gcr_config(), config,
		      "configuration changed across the suspend: 0x%08x, want 0x%08x",
		      lpdac_gcr_config(), config);

	/* Left as it was found, so this test's output does not outlive it. */
	zassert_ok(pm_device_runtime_put(LPDAC_DEV), "final runtime_put rejected");
}
```

## src/test_system.c
```c
/*
 * Copyright 2026 NXP
 * SPDX-License-Identifier: Apache-2.0
 */

/**
 * @file
 * @brief The system layer: the per-device power state constraint.
 *
 * The DAC node lists the states that stop the output in
 * zephyr,disabling-power-states (see constraints.overlay), and the driver holds a
 * policy constraint against exactly those states for as long as its output is on.
 * The window is not one API call -- a DAC output has no completion event -- it is
 * the span between the write that turns the output on and the suspend that turns
 * it off, which under runtime PM is the span the consumer's reference already
 * describes. So the consumer asks for the device and gets protection from the
 * states that would break it without naming any of them.
 *
 * Two tests: that the constraint matches what the node declares and appears only
 * once there is an output to protect, and that it follows the output across a
 * suspend and a resume rather than being taken once and kept.
 */

#include <zephyr/pm/device_runtime.h>
#include <zephyr/pm/policy.h>
#include <zephyr/pm/state.h>
#include <zephyr/ztest.h>

#include <pm_test/lowpower.h>

#include "lpdac.h"

/* How many power states are locked right now, by anyone. */
static unsigned int locked_states(void)
{
	unsigned int locked = 0;

	for (enum pm_state state = PM_STATE_ACTIVE; state < PM_STATE_COUNT; state++) {
		locked += pm_policy_state_lock_is_active(state, 0) ? 1U : 0U;
	}

	return locked;
}

/*
 * How many power states the DAC node declares as disabling. States that are listed
 * but disabled in the devicetree are dropped from the generated table, so this can
 * legitimately be smaller than the list in constraints.overlay -- but a zero means
 * the overlay never reached the node, and every comparison below would then pass
 * while proving nothing.
 */
static unsigned int declared_states(void)
{
	unsigned int declared = 0;

	for (enum pm_state state = PM_STATE_ACTIVE; state < PM_STATE_COUNT; state++) {
		declared += pm_policy_device_is_disabling_state(LPDAC_DEV, state, 0) ? 1U : 0U;
	}

	return declared;
}

/* Locked states that the node does not declare, or declared states left unlocked. */
static unsigned int constraint_mismatch(void)
{
	unsigned int mismatch = 0;

	for (enum pm_state state = PM_STATE_ACTIVE; state < PM_STATE_COUNT; state++) {
		bool locked = pm_policy_state_lock_is_active(state, 0);
		bool disabling = pm_policy_device_is_disabling_state(LPDAC_DEV, state, 0);

		mismatch += (locked != disabling) ? 1U : 0U;
	}

	return mismatch;
}

ZTEST(lpdac_pm, test_system_constraint_covers_the_declared_states)
{
	unsigned int before;
	unsigned int after_setup;
	unsigned int declared;
	unsigned int mismatch;
	unsigned int after_put;
	int setup_rc;
	int write_rc;
	int repeat_write_rc;
	int put_rc;
	bool on;

	pm_test_console_quiesce();
	before = locked_states();

	zassert_ok(pm_device_runtime_get(LPDAC_DEV), "runtime_get rejected");

	/* Configured, but GCR[DACEN] still clear: there is no output to protect yet. */
	setup_rc = lpdac_setup();
	after_setup = locked_states();

	write_rc = lpdac_write(LPDAC_MIDSCALE);
	repeat_write_rc = lpdac_write(LPDAC_MIDSCALE - 1U);
	on = lpdac_output_on();
	declared = declared_states();
	mismatch = constraint_mismatch();

	/* Released before anything is asserted: a failure must not leave a lock behind,
	 * which would silently block those states for the rest of the run.
	 */
	put_rc = pm_device_runtime_put(LPDAC_DEV);

	pm_test_console_quiesce();
	after_put = locked_states();

	zassert_equal(before, 0U, "%u power state(s) were already locked before the test",
		      before);
	zassert_ok(setup_rc, "channel setup failed (%d)", setup_rc);
	zassert_ok(write_rc, "write failed (%d)", write_rc);
	zassert_ok(repeat_write_rc, "repeated write failed (%d)", repeat_write_rc);
	zassert_ok(put_rc, "runtime_put failed (%d)", put_rc);
	zassert_true(on, "GCR[DACEN] clear while a runtime reference was held");

	zassert_equal(after_setup, 0U,
		      "%u power state(s) locked by a DAC that was configured but not driving "
		      "an output", after_setup);
	zassert_true(declared > 0U,
		     "no disabling power state reached the constraint table; is "
		     "constraints.overlay applied to this board's DAC node?");
	zassert_equal(mismatch, 0U,
		      "%u power state(s) whose lock does not match what the node declares",
		      mismatch);
	zassert_equal(after_put, 0U,
		      "%u power state(s) still locked after the last consumer reference was "
		      "dropped", after_put);
}

ZTEST(lpdac_pm, test_system_constraint_follows_the_output)
{
	unsigned int declared;
	unsigned int while_on;
	unsigned int while_suspended;
	unsigned int after_resume;
	unsigned int at_end;
	int setup_rc;
	int write_rc;
	bool on_after_resume;

	pm_test_console_quiesce();

	zassert_ok(pm_device_runtime_get(LPDAC_DEV), "runtime_get rejected");
	setup_rc = lpdac_setup();
	write_rc = lpdac_write(LPDAC_MIDSCALE);
	declared = declared_states();
	while_on = locked_states();

	/* The last reference goes away, so the driver suspends and the output stops. */
	(void)pm_device_runtime_put(LPDAC_DEV);
	pm_test_console_quiesce();
	while_suspended = locked_states();

	/*
	 * A resume restores the output the consumer last asked for, so it has to restore
	 * the protection too. A driver that only took the constraint in write_value()
	 * would come back driving a pin with nothing stopping the policy from entering a
	 * state that kills it.
	 */
	zassert_ok(pm_device_runtime_get(LPDAC_DEV), "second runtime_get rejected");
	on_after_resume = lpdac_output_on();
	after_resume = locked_states();

	(void)pm_device_runtime_put(LPDAC_DEV);
	pm_test_console_quiesce();
	at_end = locked_states();

	zassert_ok(setup_rc, "channel setup failed (%d)", setup_rc);
	zassert_ok(write_rc, "write failed (%d)", write_rc);
	zassert_true(declared > 0U,
		     "no disabling power state reached the constraint table; is "
		     "constraints.overlay applied to this board's DAC node?");

	zassert_equal(while_on, declared, "%u state(s) locked while the output was on, %u "
		      "declared", while_on, declared);
	zassert_equal(while_suspended, 0U,
		      "%u power state(s) still locked while the DAC was suspended",
		      while_suspended);
	zassert_true(on_after_resume, "output enables incomplete after RESUME");
	zassert_equal(after_resume, declared,
		      "%u state(s) locked after the output was resumed, %u declared",
		      after_resume, declared);
	zassert_equal(at_end, 0U, "%u power state(s) leaked past the end of the test",
		      at_end);
}

ZTEST(lpdac_pm, test_system_reconfigure_releases_constraint)
{
	unsigned int while_on;
	unsigned int after_setup;
	unsigned int at_end;
	bool off_after_setup;
	int setup_rc;
	int put_rc;

	pm_test_console_quiesce();
	zassert_ok(pm_device_runtime_get(LPDAC_DEV), "runtime_get rejected");
	zassert_ok(lpdac_setup(), "initial channel setup failed");
	zassert_ok(lpdac_write(LPDAC_MIDSCALE), "initial write failed");
	while_on = locked_states();

	setup_rc = lpdac_setup();
	off_after_setup = lpdac_output_off();
	after_setup = locked_states();
	put_rc = pm_device_runtime_put(LPDAC_DEV);
	pm_test_console_quiesce();
	at_end = locked_states();

	zassert_true(while_on > 0U, "the initial output held no constraint");
	zassert_ok(setup_rc, "reconfiguration failed (%d)", setup_rc);
	zassert_true(off_after_setup,
		     "reconfiguration left an output enable set");
	zassert_equal(after_setup, 0U, "reconfiguration left %u state(s) locked",
		      after_setup);
	zassert_ok(put_rc, "runtime_put failed (%d)", put_rc);
	zassert_equal(at_end, 0U, "%u state(s) locked after releasing the reference", at_end);
}
```
