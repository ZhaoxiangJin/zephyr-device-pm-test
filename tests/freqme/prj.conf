## CMakeLists.txt
```
# Copyright 2026 NXP
# SPDX-License-Identifier: Apache-2.0

cmake_minimum_required(VERSION 3.20.0)

# Pulls in this repository as a Zephyr module, which is what makes lib/pm_test,
# include/pm_test and the snippets/pm-* snippets available. Nothing has to be
# passed on the command line: `-S pm-<layer>` is the whole interface.
list(APPEND EXTRA_ZEPHYR_MODULES ${CMAKE_CURRENT_LIST_DIR}/../..)

find_package(Zephyr REQUIRED HINTS $ENV{ZEPHYR_BASE})
project(freqme_device_pm)

# The suite, the register view, and the control test that every layer runs.
target_sources(app PRIVATE src/main.c src/freqme.c src/test_control.c)

# One file per layer. A layer's file is the only place that layer's claims live,
# so a build for a layer contains no code belonging to any other.
target_sources_ifdef(CONFIG_PM_TEST_LAYER_DEVICE     app PRIVATE src/test_device.c)
target_sources_ifdef(CONFIG_PM_TEST_LAYER_RUNTIME    app PRIVATE src/test_runtime.c)
target_sources_ifdef(CONFIG_PM_TEST_LAYER_SYSTEM     app PRIVATE src/test_system.c)
target_sources_ifdef(CONFIG_PM_TEST_LAYER_SYSMANAGED app PRIVATE src/test_lowpower.c)
target_sources_ifdef(CONFIG_PM_TEST_LAYER_DPD        app PRIVATE src/test_lowpower.c)
```

## prj.conf
```kconfig
# Copyright 2026 NXP
# SPDX-License-Identifier: Apache-2.0
#
# Layer-independent configuration only. The PM symbols come from the layer, which
# comes from the pm-* snippet; see lib/pm_test/Kconfig and docs/pm-layers.md.

CONFIG_ZTEST=y
CONFIG_PM_TEST=y
CONFIG_MAIN_STACK_SIZE=2048
CONFIG_ZTEST_STACK_SIZE=2048

CONFIG_CLOCK_MONITOR=y

# Driver logging at info level, immediate: the run ends with interrupts locked so
# that the core cannot park in WFI, and a deferred log would never be flushed.
# include/pm_test/layer.h asserts this pairing.
CONFIG_LOG=y
CONFIG_LOG_MODE_IMMEDIATE=y
CONFIG_CLOCK_MONITOR_LOG_LEVEL_INF=y
```

## constraints.overlay
```dts
/*
 * Copyright 2026 NXP
 * SPDX-License-Identifier: Apache-2.0
 *
 * System-PM constraint layer: mark which SoC power states stop this FREQME
 * measuring. Stacked on top of whatever the board target already applies, for the
 * system layer only (via EXTRA_DTC_OVERLAY_FILE).
 *
 * Every board target in platform_allow gets this list from its SoC dtsi, so this
 * restates what is already there. It is kept so the system layer does not depend on
 * those dtsi commits being in the tree: on a checkout without them, this is what
 * supplies the list.
 *
 * All three states are listed on every part. The block does not run in Power Down,
 * Deep Power Down gates the CORE domain and resets it, and in Deep Sleep whether a
 * measurement survives depends on the part and on the clocks selected: per MCX Nx4x
 * RM Rev. 6_RC2 Table 336 the FREQME row is Static in Deep Sleep.
 */

&freqme0 {
	zephyr,disabling-power-states = <&deepsleep &powerdown &deeppowerdown>;
};
```

## boards/frdm_mcxa346.overlay
```dts
/*
 * Copyright 2026 NXP
 * SPDX-License-Identifier: Apache-2.0
 *
 * This board target does not enable FREQME or the INPUTMUX that routes its clocks,
 * and both are needed: the SoC dtsi declares them disabled.
 */

&inputmux0 {
	status = "okay";
};

&freqme0 {
	status = "okay";
};
```

## src/main.c
```c
/*
 * Copyright 2026 NXP
 * SPDX-License-Identifier: Apache-2.0
 */

/**
 * @file
 * @brief FREQME device-PM suite: the suite hooks, and nothing else.
 *
 * Which layer this build tests, and therefore which src/test_*.c is compiled in,
 * is decided by the pm-* snippet on the command line. See docs/pm-layers.md.
 */

#include <zephyr/ztest.h>

#include <pm_test/layer.h>
#include <pm_test/state.h>

#include "freqme.h"

static void *freqme_pm_setup(void)
{
	(void)pm_test_setup();
	freqme_enable_source_clocks();
	freqme_report_configuration();

	/* Nothing is read out of the block here: it has not been configured yet. */
	pm_test_note_state(freqme_dev(), "at boot");

	return NULL;
}

static void freqme_pm_before(void *fixture)
{
	ARG_UNUSED(fixture);

	zassert_true(device_is_ready(freqme_dev()), "%s is not ready", freqme_dev()->name);
}

ZTEST_SUITE(freqme_pm, NULL, freqme_pm_setup, freqme_pm_before, NULL, NULL);
```

## src/freqme.c
```c
/*
 * Copyright 2026 NXP
 * SPDX-License-Identifier: Apache-2.0
 */

#include <zephyr/drivers/clock_control.h>
#include <zephyr/kernel.h>
#include <zephyr/sys/atomic.h>
#include <zephyr/sys/util.h>
#include <zephyr/ztest.h>

#include "freqme.h"

/* FREQME register offsets and CTRLSTAT fields, from the reference manual. */
#define FREQME_CTRL_W_OFF   0x0U
#define FREQME_CTRLSTAT_OFF 0x4U
#define FREQME_MIN_OFF      0x8U
#define FREQME_MAX_OFF      0xCU

#define CTRLSTAT_REF_SCALE   GENMASK(4, 0)
#define CTRLSTAT_PULSE_MODE  BIT(8)
#define CTRLSTAT_PULSE_POL   BIT(9)
#define CTRLSTAT_LT_MIN_IE   BIT(12)
#define CTRLSTAT_GT_MAX_IE   BIT(13)
#define CTRLSTAT_READY_IE    BIT(14)
#define CTRLSTAT_CONTINUOUS  BIT(30)
#define CTRLSTAT_IN_PROGRESS BIT(31)

#define CTRLSTAT_INT_ENABLES (CTRLSTAT_LT_MIN_IE | CTRLSTAT_GT_MAX_IE | CTRLSTAT_READY_IE)
#define CTRLSTAT_CONFIG                                                                            \
	(CTRLSTAT_REF_SCALE | CTRLSTAT_PULSE_MODE | CTRLSTAT_PULSE_POL | CTRLSTAT_INT_ENABLES)

/* A devicetree connection cookie is the selector plus the register offset << 20. */
#define ROUTE_SHIFT 20U
#define ROUTE_VALUE(cookie)  ((uint32_t)(cookie) & (BIT(ROUTE_SHIFT) - 1U))
#define ROUTE_OFFSET(cookie) ((uint32_t)(cookie) >> ROUTE_SHIFT)

#define REF_NODE DT_CHILD(FREQME_NODE, reference_sources)
#define TAR_NODE DT_CHILD(FREQME_NODE, target_sources)
#define ALT_REF_NODE DT_CHILD(REF_NODE, ref_fro_12m)

BUILD_ASSERT(DT_NODE_EXISTS(ALT_REF_NODE),
	     "freqme0 has no ref-fro-12m reference source to switch to");

#define COOKIE(node) DT_PHA_BY_IDX(node, mux_states, 0, connection)

/* Exactly one child of each container is the default, so the sum is its cookie. */
#define DEFAULT_COOKIE_ONE(node) +(DT_PROP(node, default_source) ? COOKIE(node) : 0)
#define DEFAULT_REF_COOKIE ((uint32_t)(0 DT_FOREACH_CHILD(REF_NODE, DEFAULT_COOKIE_ONE)))
#define DEFAULT_TAR_COOKIE ((uint32_t)(0 DT_FOREACH_CHILD(TAR_NODE, DEFAULT_COOKIE_ONE)))

#define INPUTMUX_BASE                                                                              \
	((uintptr_t)DT_REG_ADDR(DT_PHANDLE_BY_IDX(ALT_REF_NODE, mux_states, 0)))

static const uintptr_t freqme_base = DT_REG_ADDR(FREQME_NODE);

static K_SEM_DEFINE(measure_done, 0, 1);
static atomic_t measure_events;
static atomic_t window_events;

static inline uint32_t reg_read(uintptr_t addr)
{
	return *(volatile uint32_t *)addr;
}

static inline void reg_write(uintptr_t addr, uint32_t value)
{
	*(volatile uint32_t *)addr = value;
}

static uint32_t ctrlstat(void)
{
	return reg_read(freqme_base + FREQME_CTRLSTAT_OFF);
}

const struct device *freqme_dev(void)
{
	return DEVICE_DT_GET(FREQME_NODE);
}

void freqme_image_read(struct freqme_image *img)
{
	img->ctrl = ctrlstat() & CTRLSTAT_CONFIG;
	img->min = reg_read(freqme_base + FREQME_MIN_OFF);
	img->max = reg_read(freqme_base + FREQME_MAX_OFF);
	img->route_ref = reg_read(INPUTMUX_BASE + ROUTE_OFFSET(DEFAULT_REF_COOKIE));
	img->route_tar = reg_read(INPUTMUX_BASE + ROUTE_OFFSET(DEFAULT_TAR_COOKIE));
}

bool freqme_image_equal(const struct freqme_image *a, const struct freqme_image *b)
{
	return (a->ctrl == b->ctrl) && (a->min == b->min) && (a->max == b->max) &&
	       (a->route_ref == b->route_ref) && (a->route_tar == b->route_tar);
}

bool freqme_measuring(void)
{
	return (ctrlstat() & CTRLSTAT_IN_PROGRESS) != 0U;
}

bool freqme_continuous(void)
{
	return (ctrlstat() & CTRLSTAT_CONTINUOUS) != 0U;
}

uint32_t freqme_int_enables(void)
{
	return ctrlstat() & (uint32_t)CTRLSTAT_INT_ENABLES;
}

uint32_t freqme_min(void)
{
	return reg_read(freqme_base + FREQME_MIN_OFF);
}

void freqme_min_write(uint32_t value)
{
	reg_write(freqme_base + FREQME_MIN_OFF, value);
}

void freqme_clobber(struct freqme_image *clobbered)
{
	/* REF_SCALE 31 and no interrupt enable, with MEASURE_IN_PROGRESS 0. No
	 * configuration in this case asks for a window that long.
	 */
	reg_write(freqme_base + FREQME_CTRL_W_OFF, CTRLSTAT_REF_SCALE);
	reg_write(freqme_base + FREQME_MIN_OFF, 0x00ABCDEFU);
	reg_write(freqme_base + FREQME_MAX_OFF, 0x00FEDCBAU);
	reg_write(INPUTMUX_BASE + ROUTE_OFFSET(DEFAULT_REF_COOKIE), 0x1FU);
	reg_write(INPUTMUX_BASE + ROUTE_OFFSET(DEFAULT_TAR_COOKIE), 0x1FU);
	freqme_image_read(clobbered);
}

void freqme_default_route(uint32_t *ref, uint32_t *tar)
{
	*ref = ROUTE_VALUE(DEFAULT_REF_COOKIE);
	*tar = ROUTE_VALUE(DEFAULT_TAR_COOKIE);
}

uint32_t freqme_alt_ref_cookie(void)
{
	return (uint32_t)COOKIE(ALT_REF_NODE);
}

uint32_t freqme_alt_ref_route(void)
{
	return ROUTE_VALUE(COOKIE(ALT_REF_NODE));
}

#define SOURCE_CLOCK_ON(node)                                                                      \
	COND_CODE_1(DT_NODE_HAS_PROP(node, clocks),                                                \
		    ((void)clock_control_on(DEVICE_DT_GET(DT_CLOCKS_CTLR(node)),               \
					    (clock_control_subsys_t)(uintptr_t)                \
						    DT_CLOCKS_CELL(node, name));),             \
		    ())

void freqme_enable_source_clocks(void)
{
	/* The driver queries these clocks and never turns them on; the consumer
	 * owns that. A clock that is always on refuses clock_control_on(), which
	 * is why the return value is not checked: the control measures the rate.
	 */
	DT_FOREACH_CHILD(REF_NODE, SOURCE_CLOCK_ON)
	DT_FOREACH_CHILD(TAR_NODE, SOURCE_CLOCK_ON)
}

static void measure_cb(const struct device *dev, const struct clock_monitor_event_data *evt,
		       void *user_data)
{
	ARG_UNUSED(dev);
	ARG_UNUSED(user_data);

	if ((evt->events & (CLOCK_MONITOR_EVT_MEASURE_DONE | CLOCK_MONITOR_EVT_CLOCK_LOST)) !=
	    0U) {
		atomic_inc(&measure_events);
		k_sem_give(&measure_done);
	}
}

static void window_cb(const struct device *dev, const struct clock_monitor_event_data *evt,
		      void *user_data)
{
	ARG_UNUSED(dev);
	ARG_UNUSED(user_data);

	if ((evt->events & (CLOCK_MONITOR_EVT_FREQ_HIGH | CLOCK_MONITOR_EVT_FREQ_LOW)) != 0U) {
		atomic_inc(&window_events);
	}
}

int freqme_configure_measure(uint32_t window_ns)
{
	struct clock_monitor_config cfg = {
		.mode = CLOCK_MONITOR_MODE_MEASURE,
		.measure = {.window_ns = window_ns},
		.callback = measure_cb,
	};

	return clock_monitor_configure(freqme_dev(), &cfg);
}

int freqme_measure_start(void)
{
	k_sem_reset(&measure_done);

	return clock_monitor_start(freqme_dev());
}

int freqme_measure_wait(uint32_t timeout_ms)
{
	if (k_sem_take(&measure_done, K_MSEC(timeout_ms)) != 0) {
		(void)clock_monitor_stop(freqme_dev());
		return -ETIMEDOUT;
	}

	return 0;
}

int freqme_start_and_wait(uint32_t timeout_ms)
{
	int err;

	err = freqme_measure_start();
	if (err != 0) {
		return err;
	}

	return freqme_measure_wait(timeout_ms);
}

int freqme_measure_once(uint32_t window_ns, uint32_t *hz)
{
	int err;

	err = freqme_configure_measure(window_ns);
	if (err != 0) {
		return err;
	}
	err = freqme_start_and_wait(100U + window_ns / 1000000U * 2U);
	if (err != 0) {
		return err;
	}

	return clock_monitor_get_rate(freqme_dev(), hz);
}

bool freqme_rate_plausible(uint32_t hz)
{
	uint32_t slack = FREQME_TARGET_HZ / 100U * FREQME_TOLERANCE_PCT;

	return (hz >= FREQME_TARGET_HZ - slack) && (hz <= FREQME_TARGET_HZ + slack);
}

int freqme_start_window(bool faulty)
{
	struct clock_monitor_config cfg = {
		.mode = CLOCK_MONITOR_MODE_WINDOW,
		.window =
			{
				.expected_hz = faulty ? 2U * FREQME_TARGET_HZ : FREQME_TARGET_HZ,
				.tolerance_ppm = faulty ? 10000U : FREQME_TOLERANCE_PCT * 10000U,
				.window_ns = FREQME_WINDOW_NS,
			},
		.callback = window_cb,
	};
	int err;

	err = clock_monitor_configure(freqme_dev(), &cfg);
	if (err != 0) {
		return err;
	}

	return clock_monitor_start(freqme_dev());
}

uint32_t freqme_window_events(void)
{
	return (uint32_t)atomic_get(&window_events);
}

void freqme_window_events_reset(void)
{
	(void)atomic_set(&window_events, 0);
}

bool freqme_window_events_arrive(uint32_t timeout_ms)
{
	int64_t end = k_uptime_get() + timeout_ms;

	freqme_window_events_reset();
	while (k_uptime_get() < end) {
		if (freqme_window_events() != 0U) {
			return true;
		}
		k_msleep(1);
	}

	return false;
}

void freqme_report_configuration(void)
{
	uint32_t ref;
	uint32_t tar;

	freqme_default_route(&ref, &tar);
	TC_PRINT("freqme0 @ 0x%08lx, inputmux @ 0x%08lx\n", (unsigned long)freqme_base,
		 (unsigned long)INPUTMUX_BASE);
	TC_PRINT("default route: REF 0x%03x <- %u, TAR 0x%03x <- %u; alternate REF <- %u\n",
		 ROUTE_OFFSET(DEFAULT_REF_COOKIE), ref, ROUTE_OFFSET(DEFAULT_TAR_COOKIE), tar,
		 freqme_alt_ref_route());
}

void freqme_report_hw(const char *when)
{
	struct freqme_image img;
	uint32_t raw = ctrlstat();

	freqme_image_read(&img);
	TC_PRINT("freqme %s: CTRLSTAT=0x%08x (measuring=%u continuous=%u ie=0x%x) MIN=0x%08x "
		 "MAX=0x%08x route REF=%u TAR=%u\n",
		 when, raw, (unsigned int)((raw & CTRLSTAT_IN_PROGRESS) != 0U),
		 (unsigned int)((raw & CTRLSTAT_CONTINUOUS) != 0U),
		 (unsigned int)(raw & CTRLSTAT_INT_ENABLES), img.min, img.max, img.route_ref,
		 img.route_tar);
}
```

## src/freqme.h
```c
/*
 * Copyright 2026 NXP
 * SPDX-License-Identifier: Apache-2.0
 */

/**
 * @file
 * @brief What every layer of the FREQME case needs from the hardware.
 *
 * Three things are observed. The FREQME registers are read only once the
 * instance has been configured: until the first configure() the block can still
 * be held in peripheral reset, where an access faults, and under runtime PM it
 * can still be ungated. Once configured they read back whether or not the device
 * is suspended, because a read with the peripheral gate closed still returns the
 * retained contents. The INPUTMUX route is read only once the device has been
 * turned on, which is when it is applied.
 *
 * The control state, read back through CTRLSTAT. CTRL_W, which software writes,
 * is write-only, and CTRLSTAT mirrors every field of it: REF_SCALE, the mode
 * bits, the three interrupt enables, CONTINUOUS_MODE_EN and
 * MEASURE_IN_PROGRESS. Whether the block is measuring is the last two; whether
 * the consumer's configuration is in the block is the rest, together with MIN
 * and MAX.
 *
 * The INPUTMUX route that selects the reference and the target clock. It lives
 * in another peripheral, so a block that measures correctly against the wrong
 * clocks would pass every FREQME register check. The register holds the low 20
 * bits of the devicetree connection cookie, so the expected value is computed
 * from the devicetree rather than captured.
 *
 * What the clock_monitor API reports, which is the control: a frequency close
 * to what the target clock is known to run at, and callbacks that arrive.
 */

#ifndef FREQME_PM_H_
#define FREQME_PM_H_

#include <stdbool.h>
#include <stdint.h>

#include <zephyr/device.h>
#include <zephyr/devicetree.h>
#include <zephyr/drivers/clock_monitor.h>

#if !DT_NODE_HAS_STATUS(DT_NODELABEL(freqme0), okay)
#error "freqme0 is not enabled on this board"
#endif

#if !defined(CONFIG_CLOCK_MONITOR_NXP_FREQME)
#error "CONFIG_CLOCK_MONITOR_NXP_FREQME is not enabled, so there is no driver to test"
#endif

/** The single FREQME instance every part in scope has. */
#define FREQME_NODE DT_NODELABEL(freqme0)

/** The rate the default target, FRO_12M, runs at on every board in scope. */
#define FREQME_TARGET_HZ 12000000U

/** Accepted deviation of a measurement from @ref FREQME_TARGET_HZ, in percent. */
#define FREQME_TOLERANCE_PCT 5U

/** The measurement window every test uses: long enough to be accurate, short
 * enough that a test waiting on many of them stays quick.
 */
#define FREQME_WINDOW_NS 1000000U

/**
 * A window long enough that a test can observe the block while it is still
 * measuring: 200 ms, against a 1 ms window used everywhere else.
 */
#define FREQME_LONG_WINDOW_NS 200000000U

/** The register image a configuration leaves in the block. */
struct freqme_image {
	/**
	 * The configuration fields of CTRLSTAT: REF_SCALE, PULSE_MODE, PULSE_POL
	 * and the three interrupt enables. Whether the block is measuring is read
	 * separately, with freqme_measuring() and freqme_continuous().
	 */
	uint32_t ctrl;
	uint32_t min;
	uint32_t max;
	/** INPUTMUX FREQMEAS_REF and FREQMEAS_TAR. */
	uint32_t route_ref;
	uint32_t route_tar;
};

/** @brief The FREQME device. */
const struct device *freqme_dev(void);

/** @brief Sample @ref freqme_image. Only after the instance has been configured. */
void freqme_image_read(struct freqme_image *img);

/** @brief Read the INPUTMUX route alone, without touching the FREQME block. */
void freqme_route_read(uint32_t *ref, uint32_t *tar);

/** @brief True when two images are the same. */
bool freqme_image_equal(const struct freqme_image *a, const struct freqme_image *b);

/** @brief True while CTRLSTAT[MEASURE_IN_PROGRESS] is set. */
bool freqme_measuring(void);

/** @brief True while CTRLSTAT[CONTINUOUS_MODE_EN] is set. */
bool freqme_continuous(void);

/** @brief The three interrupt-enable bits of CTRLSTAT. */
uint32_t freqme_int_enables(void);

/** @brief The raw MIN register. */
uint32_t freqme_min(void);

/** @brief Write MIN behind the driver's back. */
void freqme_min_write(uint32_t value);

/**
 * @brief Overwrite every register this case observes with values no
 * configuration in this case produces.
 *
 * What stands in for a power cycle in a layer where nothing really cut power, so
 * that a TURN_ON has something to put back.
 *
 * @param clobbered read back after the write, so a caller can prove the clobber took
 */
void freqme_clobber(struct freqme_image *clobbered);

/**
 * @brief The route values the devicetree says the default sources produce.
 *
 * @param ref the expected FREQMEAS_REF value
 * @param tar the expected FREQMEAS_TAR value
 */
void freqme_default_route(uint32_t *ref, uint32_t *tar);

/** @brief The set_source() cookie for the FRO_12M reference, and its route value. */
uint32_t freqme_alt_ref_cookie(void);
uint32_t freqme_alt_ref_route(void);

/** @brief Turn on the clocks of the sources this case selects. */
void freqme_enable_source_clocks(void);

/**
 * @brief One MEASURE run: configure, start, wait for the callback.
 *
 * @param window_ns the measurement window
 * @param hz        the reported frequency, written on success
 *
 * @return 0, a negative errno from the API, or -ETIMEDOUT when no callback came.
 */
int freqme_measure_once(uint32_t window_ns, uint32_t *hz);

/** @brief Configure MEASURE without starting it. */
int freqme_configure_measure(uint32_t window_ns);

/** @brief Start a configured MEASURE and wait for its callback. */
int freqme_start_and_wait(uint32_t timeout_ms);

/** @brief Start a configured MEASURE without waiting. */
int freqme_measure_start(void);

/**
 * @brief Wait for the callback of a MEASURE started with freqme_measure_start().
 *
 * @return 0, or -ETIMEDOUT after stopping the measurement.
 */
int freqme_measure_wait(uint32_t timeout_ms);

/** @brief True when @p hz is within @ref FREQME_TOLERANCE_PCT of the target. */
bool freqme_rate_plausible(uint32_t hz);

/**
 * @brief Configure and start WINDOW monitoring.
 *
 * @param faulty when true the expected rate is twice the target's, so every
 *        window reports FREQ_LOW and the callback count shows whether the
 *        hardware is monitoring at all; when false the expected rate is the
 *        target's own and no callback is expected
 */
int freqme_start_window(bool faulty);

/** @brief Number of WINDOW callbacks since the last reset. */
uint32_t freqme_window_events(void);

/** @brief Reset the WINDOW callback count. */
void freqme_window_events_reset(void);

/**
 * @brief True when at least one WINDOW callback arrives within @p timeout_ms.
 *
 * Resets the count first, so only new callbacks are counted.
 */
bool freqme_window_events_arrive(uint32_t timeout_ms);

/** @brief Print what the devicetree asked for, once, from the suite setup. */
void freqme_report_configuration(void);

/** @brief Print the register image. */
void freqme_report_hw(const char *when);

#endif /* FREQME_PM_H_ */
```

## src/test_control.c
```c
/*
 * Copyright 2026 NXP
 * SPDX-License-Identifier: Apache-2.0
 */

/**
 * @file
 * @brief The control: this case really does drive the FREQME.
 *
 * Compiled into every layer. If this fails, no verdict from the layer under test
 * means anything.
 *
 * Four claims: that a measurement reports a frequency close to the target's, that
 * the INPUTMUX route holds what the devicetree asked for, that a configuration
 * leaves a register image distinguishable from a reset block, and that WINDOW
 * monitoring is silent on a good clock and reports on a bad one. Every later layer
 * tells "restored" from "came back from reset" by comparing against that image,
 * and tells "monitoring" from "stopped" by whether WINDOW callbacks arrive.
 */

#include <zephyr/drivers/clock_monitor.h>
#include <zephyr/pm/device_runtime.h>
#include <zephyr/ztest.h>

#include "freqme.h"

ZTEST(freqme_pm, test_control_measures_and_monitors)
{
	const struct device *dev = freqme_dev();
	struct freqme_image configured;
	uint32_t want_ref;
	uint32_t want_tar;
	uint32_t hz = 0U;
	bool held = false;
	int measure_rc;
	bool quiet_when_good;
	bool reports_when_bad;
	bool measuring_window;
	bool continuous_window;
	bool measuring_after_stop;

	/*
	 * Under runtime PM the device boots suspended and this driver takes no
	 * reference of its own, so the control has to ask for it. That an
	 * unwrapped call is refused is test_runtime.c's claim, not a premise of
	 * the control.
	 */
	if (pm_device_runtime_is_enabled(dev)) {
		zassert_ok(pm_device_runtime_get(dev),
			   "%s: could not resume the device for the control", dev->name);
		held = true;
	}

	measure_rc = freqme_measure_once(FREQME_WINDOW_NS, &hz);
	freqme_image_read(&configured);
	freqme_report_hw("control, measured");

	zassert_ok(freqme_start_window(false), "%s: could not start WINDOW", dev->name);
	measuring_window = freqme_measuring();
	continuous_window = freqme_continuous();
	quiet_when_good = !freqme_window_events_arrive(50U);
	(void)clock_monitor_stop(dev);

	zassert_ok(freqme_start_window(true), "%s: could not start a faulty WINDOW", dev->name);
	reports_when_bad = freqme_window_events_arrive(50U);
	(void)clock_monitor_stop(dev);
	measuring_after_stop = freqme_measuring();

	if (held) {
		/* Before the assertions: a failure must not leak the reference. */
		(void)pm_device_runtime_put(dev);
	}

	freqme_default_route(&want_ref, &want_tar);

	/*
	 * The route first. A block measuring against the wrong inputs would still
	 * produce a register image and possibly a number.
	 */
	zassert_equal(configured.route_ref, want_ref,
		      "%s: FREQMEAS_REF holds %u, the devicetree default source is %u",
		      dev->name, configured.route_ref, want_ref);
	zassert_equal(configured.route_tar, want_tar,
		      "%s: FREQMEAS_TAR holds %u, the devicetree default source is %u",
		      dev->name, configured.route_tar, want_tar);

	zassert_ok(measure_rc, "%s: the measurement failed (%d)", dev->name, measure_rc);
	zassert_true(freqme_rate_plausible(hz), "%s: measured %u Hz, want %u Hz +/- %u%%",
		     dev->name, hz, FREQME_TARGET_HZ, FREQME_TOLERANCE_PCT);

	/*
	 * A reset block has REF_SCALE 0 and no interrupt enabled; a 1 ms window
	 * against any reference in scope needs a REF_SCALE well above 0 and MEASURE
	 * enables the result-ready interrupt. So the image is distinguishable.
	 */
	zassert_not_equal(configured.ctrl, 0U, "%s: the configuration left CTRLSTAT at 0",
			  dev->name);

	zassert_true(measuring_window && continuous_window,
		     "%s: WINDOW started but the block is not measuring continuously",
		     dev->name);
	zassert_true(quiet_when_good, "%s: WINDOW reported a good clock as out of range",
		     dev->name);
	zassert_true(reports_when_bad, "%s: WINDOW did not report a clock at half the "
		     "expected rate", dev->name);
	zassert_false(measuring_after_stop, "%s: still measuring after clock_monitor_stop()",
		      dev->name);
}
```

## src/test_device.c
```c
/*
 * Copyright 2026 NXP
 * SPDX-License-Identifier: Apache-2.0
 */

/**
 * @file
 * @brief The device layer: the driver's PM callbacks, driven directly.
 *
 * Three tests. The first is the SUSPEND/RESUME round trip on a running WINDOW
 * monitor, configured against a rate twice the target's so that every window
 * reports: whether callbacks arrive is then a direct reading of whether the
 * hardware is monitoring. A suspend has to stop them and a resume has to bring
 * them back without the consumer calling clock_monitor_start() again.
 *
 * The second is a MEASURE started after a suspend and a resume with no power loss
 * in between. The suspend clears the interrupt enables, so this is the case that
 * shows whether the resume put them back: without them the measurement still runs
 * and its callback never comes.
 *
 * The third is TURN_OFF/TURN_ON, which owns the register block. Nothing in this
 * layer really cuts power, so the block and its INPUTMUX route are clobbered by
 * hand for the restore to have something to put back. What a real power cycle does
 * is asked in src/test_lowpower.c under the dpd layer.
 */

#include <zephyr/drivers/clock_monitor.h>
#include <zephyr/pm/device.h>
#include <zephyr/ztest.h>

#include <pm_test/state.h>

#include "freqme.h"

ZTEST(freqme_pm, test_device_suspend_resume_window)
{
	const struct device *dev = freqme_dev();
	struct freqme_image running;
	struct freqme_image after;
	int err;

	/* No runtime PM in this layer, so pm_device_driver_init() resumed it. */
	zassert_pm_state(dev, PM_DEVICE_STATE_ACTIVE);

	zassert_ok(freqme_start_window(true), "%s: could not start WINDOW", dev->name);
	zassert_true(freqme_window_events_arrive(50U),
		     "%s: a faulty WINDOW reported nothing before the suspend", dev->name);
	freqme_image_read(&running);
	freqme_report_hw("before-suspend");

	zassert_ok(pm_device_action_run(dev, PM_DEVICE_ACTION_SUSPEND),
		   "%s: SUSPEND action rejected", dev->name);
	zassert_pm_state(dev, PM_DEVICE_STATE_SUSPENDED);
	freqme_report_hw("after-suspend");

	/* The claim of this layer: the block really stopped, not just the driver's
	 * state variable.
	 */
	zassert_false(freqme_measuring(), "%s: still measuring after SUSPEND", dev->name);
	zassert_false(freqme_continuous(), "%s: continuous mode still on after SUSPEND",
		      dev->name);
	zassert_equal(freqme_int_enables(), 0U,
		      "%s: interrupt enables 0x%x left set after SUSPEND", dev->name,
		      freqme_int_enables());
	zassert_false(freqme_window_events_arrive(20U),
		      "%s: WINDOW callbacks kept arriving while suspended", dev->name);

	/* A suspended device refuses what would write its register block. */
	err = clock_monitor_start(dev);
	zassert_equal(err, -EBUSY, "%s: start() on a suspended device returned %d", dev->name,
		      err);
	err = freqme_start_window(true);
	zassert_equal(err, -EBUSY, "%s: configure() on a suspended device returned %d",
		      dev->name, err);
	err = clock_monitor_set_source(dev, freqme_alt_ref_cookie(), 0U);
	zassert_equal(err, -EBUSY, "%s: set_source() on a suspended device returned %d",
		      dev->name, err);

	zassert_ok(pm_device_action_run(dev, PM_DEVICE_ACTION_RESUME),
		   "%s: RESUME action rejected", dev->name);
	zassert_pm_state(dev, PM_DEVICE_STATE_ACTIVE);
	freqme_image_read(&after);
	freqme_report_hw("after-resume");

	/*
	 * The monitor the consumer started is running again, with the
	 * configuration it had, and reports -- all without another start().
	 */
	zassert_true(freqme_measuring() && freqme_continuous(),
		     "%s: RESUME did not re-arm continuous monitoring", dev->name);
	zassert_true(freqme_image_equal(&after, &running),
		     "%s: RESUME left CTRLSTAT config 0x%08x MIN 0x%08x MAX 0x%08x, want "
		     "0x%08x/0x%08x/0x%08x", dev->name, after.ctrl, after.min, after.max,
		     running.ctrl, running.min, running.max);
	zassert_true(freqme_window_events_arrive(50U),
		     "%s: WINDOW reported nothing after RESUME", dev->name);

	/* A redundant action must be refused, not obeyed and not fatal. */
	err = pm_device_action_run(dev, PM_DEVICE_ACTION_RESUME);
	zassert_equal(err, -EALREADY, "%s: second RESUME returned %d, want -EALREADY",
		      dev->name, err);

	(void)clock_monitor_stop(dev);
}

ZTEST(freqme_pm, test_device_measure_after_resume)
{
	const struct device *dev = freqme_dev();
	uint32_t before = 0U;
	uint32_t retained = 0U;
	uint32_t after = 0U;
	int suspend_rc;
	int retained_rc;
	int stop_rc;
	int resume_rc;
	int measure_rc;

	zassert_pm_state(dev, PM_DEVICE_STATE_ACTIVE);
	zassert_ok(freqme_measure_once(FREQME_WINDOW_NS, &before),
		   "%s: the first measurement failed", dev->name);

	suspend_rc = pm_device_action_run(dev, PM_DEVICE_ACTION_SUSPEND);
	retained_rc = clock_monitor_get_rate(dev, &retained);
	stop_rc = clock_monitor_stop(dev);
	resume_rc = pm_device_action_run(dev, PM_DEVICE_ACTION_RESUME);
	freqme_report_hw("after-resume");

	/* Started from the same configuration: no configure() in between. */
	measure_rc = freqme_start_and_wait(100U);
	if (measure_rc == 0) {
		(void)clock_monitor_get_rate(dev, &after);
	}

	zassert_ok(suspend_rc, "%s: SUSPEND rejected (%d)", dev->name, suspend_rc);
	/* The result is answered from RAM, so a suspend does not take it away. */
	zassert_ok(retained_rc, "%s: get_rate() on a suspended device returned %d", dev->name,
		   retained_rc);
	zassert_equal(retained, before, "%s: get_rate() returned %u while suspended, %u before",
		      dev->name, retained, before);
	zassert_ok(stop_rc, "%s: stop() on a suspended device returned %d", dev->name, stop_rc);
	zassert_ok(resume_rc, "%s: RESUME rejected (%d)", dev->name, resume_rc);

	/*
	 * The claim. The measurement runs either way; its callback only arrives if
	 * RESUME restored the result-ready interrupt enable the suspend cleared.
	 */
	zassert_ok(measure_rc,
		   "%s: a measurement started after the resume did not complete (%d)",
		   dev->name, measure_rc);
	zassert_true(freqme_rate_plausible(after), "%s: measured %u Hz after the resume",
		     dev->name, after);
}

ZTEST(freqme_pm, test_device_turn_on_rebuilds_the_register_block)
{
	const struct device *dev = freqme_dev();
	struct freqme_image running;
	struct freqme_image clobbered;
	struct freqme_image after_turn_on;
	bool measuring_after_turn_on;
	int suspend_rc;
	int turn_off_rc;
	int turn_on_rc;
	int resume_rc;

	zassert_pm_state(dev, PM_DEVICE_STATE_ACTIVE);
	zassert_ok(freqme_start_window(true), "%s: could not start WINDOW", dev->name);
	freqme_image_read(&running);

	/*
	 * Collected in one go and asserted afterwards, so that a failure cannot
	 * hand the next test a device the core still records as OFF.
	 */
	suspend_rc = pm_device_action_run(dev, PM_DEVICE_ACTION_SUSPEND);
	freqme_clobber(&clobbered);
	turn_off_rc = pm_device_action_run(dev, PM_DEVICE_ACTION_TURN_OFF);
	turn_on_rc = pm_device_action_run(dev, PM_DEVICE_ACTION_TURN_ON);
	measuring_after_turn_on = freqme_measuring();
	freqme_image_read(&after_turn_on);
	freqme_report_hw("after-turn-on");
	resume_rc = pm_device_action_run(dev, PM_DEVICE_ACTION_RESUME);
	freqme_report_hw("after-resume");

	zassert_ok(suspend_rc, "%s: SUSPEND rejected (%d)", dev->name, suspend_rc);
	zassert_ok(turn_off_rc, "%s: TURN_OFF rejected (%d)", dev->name, turn_off_rc);
	zassert_ok(turn_on_rc, "%s: TURN_ON rejected (%d)", dev->name, turn_on_rc);
	zassert_ok(resume_rc, "%s: RESUME rejected (%d)", dev->name, resume_rc);
	zassert_pm_state(dev, PM_DEVICE_STATE_ACTIVE);

	/* Before anything else: a clobber that did not take would make the claims
	 * below answerable without the block ever having been disturbed.
	 */
	zassert_false(freqme_image_equal(&clobbered, &running), "%s: the clobber did not take",
		      dev->name);

	/*
	 * TURN_ON returns with the core about to record the device as suspended,
	 * so a block that started measuring would be running behind a PM state that
	 * says it is not.
	 */
	zassert_false(measuring_after_turn_on, "%s: TURN_ON left the block measuring",
		      dev->name);

	/* The rebuild, registers and route both. */
	zassert_true(freqme_image_equal(&after_turn_on, &running),
		     "%s: TURN_ON rebuilt CTRLSTAT config 0x%08x MIN 0x%08x MAX 0x%08x route "
		     "%u/%u, want 0x%08x/0x%08x/0x%08x route %u/%u",
		     dev->name, after_turn_on.ctrl, after_turn_on.min, after_turn_on.max,
		     after_turn_on.route_ref, after_turn_on.route_tar, running.ctrl,
		     running.min, running.max, running.route_ref, running.route_tar);

	/* And the monitor the consumer had started is monitoring again. */
	zassert_true(freqme_measuring() && freqme_continuous(),
		     "%s: RESUME did not re-arm monitoring after the rebuild", dev->name);
	zassert_true(freqme_window_events_arrive(50U),
		     "%s: WINDOW reported nothing after the rebuild", dev->name);

	(void)clock_monitor_stop(dev);
}
```

## src/test_lowpower.c
```c
/*
 * Copyright 2026 NXP
 * SPDX-License-Identifier: Apache-2.0
 */

/**
 * @file
 * @brief The sysmanaged and dpd layers: one forced transition with a monitor running.
 *
 * The sequence is the same in both and only the state entered differs, which
 * pm_test_enter_transition() picks from the layer symbol.
 *
 * Before the transition the reference is switched to FRO_12M, so the route the
 * driver has to put back is the one the consumer selected and not the boot
 * default, and WINDOW monitoring is started. Then MIN is overwritten behind the
 * driver's back with a value the driver does not hold in RAM. That one register
 * tells the two layers apart:
 *
 * - across Deep Sleep the block keeps its power and nothing rewrites MIN, so the
 *   overwritten value has to still be there;
 * - across Deep Power Down the block loses its registers and TURN_ON rebuilds them
 *   from what configure() applied, so the overwritten value has to be gone and the
 *   configured one back. That is what shows both that power was really cut and that
 *   the replay ran.
 *
 * In both layers the rest of the configuration and the route must come back, and
 * the monitor the consumer started must be running again without another start().
 */

#include <zephyr/drivers/clock_monitor.h>
#include <zephyr/pm/device.h>
#include <zephyr/ztest.h>

#include <pm_test/lowpower.h>
#include <pm_test/state.h>

#include "freqme.h"

ZTEST(freqme_pm, test_monitor_across_transition)
{
	const struct device *dev = freqme_dev();
	struct freqme_image running;
	struct freqme_image after;
	uint32_t sentinel;
	uint32_t hz = 0U;
	bool measuring_after;
	bool continuous_after;

	/* No runtime PM in these layers, so the sweep is the only thing that will
	 * suspend the device.
	 */
	zassert_pm_state(dev, PM_DEVICE_STATE_ACTIVE);

	zassert_ok(clock_monitor_set_source(dev, freqme_alt_ref_cookie(), 0U),
		   "%s: could not select the FRO_12M reference", dev->name);
	zassert_ok(freqme_start_window(false), "%s: could not start WINDOW", dev->name);
	freqme_image_read(&running);
	zassert_equal(running.route_ref, freqme_alt_ref_route(),
		      "%s: FREQMEAS_REF holds %u after set_source(), want %u", dev->name,
		      running.route_ref, freqme_alt_ref_route());

	sentinel = running.min ^ 1U;
	freqme_min_write(sentinel);
	zassert_equal(freqme_min(), sentinel, "%s: the MIN overwrite did not take", dev->name);
	freqme_report_hw("before");

	pm_test_enter_transition();

	/* Sampled before the console is revived: reviving it takes time, and the
	 * question is what the block looked like the moment the sweep handed it back.
	 */
	measuring_after = freqme_measuring();
	continuous_after = freqme_continuous();
	freqme_image_read(&after);

	pm_test_console_resume(PM_TEST_CONSOLE_REINIT_PINMUX);
	TC_PRINT("resumed from %s\n", PM_TEST_TRANSITION_NAME);
	freqme_report_hw("after-resume");

	zassert_pm_state(dev, PM_DEVICE_STATE_ACTIVE);

#if defined(CONFIG_PM_TEST_LAYER_DPD)
	zassert_not_equal(after.min, sentinel,
			  "%s: the overwritten MIN survived %s, so the block kept its power",
			  dev->name, PM_TEST_TRANSITION_NAME);
	zassert_equal(after.min, running.min,
		      "%s: MIN is 0x%08x after %s, want the configured 0x%08x", dev->name,
		      after.min, PM_TEST_TRANSITION_NAME, running.min);
#else
	zassert_equal(after.min, sentinel,
		      "%s: MIN is 0x%08x after %s, want the untouched 0x%08x", dev->name,
		      after.min, PM_TEST_TRANSITION_NAME, sentinel);
#endif

	zassert_equal(after.ctrl, running.ctrl,
		      "%s: CTRLSTAT config 0x%08x after %s, want 0x%08x", dev->name, after.ctrl,
		      PM_TEST_TRANSITION_NAME, running.ctrl);
	zassert_equal(after.max, running.max, "%s: MAX 0x%08x after %s, want 0x%08x", dev->name,
		      after.max, PM_TEST_TRANSITION_NAME, running.max);
	zassert_equal(after.route_ref, running.route_ref,
		      "%s: FREQMEAS_REF %u after %s, want the selected %u", dev->name,
		      after.route_ref, PM_TEST_TRANSITION_NAME, running.route_ref);
	zassert_equal(after.route_tar, running.route_tar,
		      "%s: FREQMEAS_TAR %u after %s, want %u", dev->name, after.route_tar,
		      PM_TEST_TRANSITION_NAME, running.route_tar);
	zassert_true(measuring_after && continuous_after,
		     "%s: monitoring was not re-armed after %s", dev->name,
		     PM_TEST_TRANSITION_NAME);

	/* And the block has to work, not just read back right. */
	(void)clock_monitor_stop(dev);
	zassert_ok(freqme_measure_once(FREQME_WINDOW_NS, &hz),
		   "%s: a measurement after %s failed", dev->name, PM_TEST_TRANSITION_NAME);
	zassert_true(freqme_rate_plausible(hz), "%s: measured %u Hz after %s", dev->name, hz,
		     PM_TEST_TRANSITION_NAME);
}
```

## src/test_runtime.c
```c
/*
 * Copyright 2026 NXP
 * SPDX-License-Identifier: Apache-2.0
 */

/**
 * @file
 * @brief The runtime layer: the consumer owns the reference.
 *
 * This driver takes no runtime reference of its own, in either mode, so the
 * consumer holds one for as long as it wants the monitor. Three claims: nothing is
 * measuring before a consumer asks, a call that would write the register block is
 * refused rather than silently lost while no reference is held, and what the
 * consumer configured comes back with the reference -- a measured result that is
 * still readable while suspended, a MEASURE that still completes, and a WINDOW
 * monitor that resumes on its own.
 */

#include <zephyr/drivers/clock_monitor.h>
#include <zephyr/pm/device.h>
#include <zephyr/pm/device_runtime.h>
#include <zephyr/ztest.h>

#include <pm_test/state.h>

#include "freqme.h"

ZTEST(freqme_pm, test_runtime_boots_without_a_consumer)
{
	const struct device *dev = freqme_dev();
	enum pm_device_state state;
	uint32_t want_ref;
	uint32_t want_tar;
	struct freqme_image img;
	int err;

	zassert_true(pm_device_runtime_is_enabled(dev), "%s: runtime PM is not enabled",
		     dev->name);

	/*
	 * Two boot states are legal. Without a power domain the device lands in
	 * SUSPENDED; with one it lands in OFF, because the domain is
	 * runtime-suspended before FREQME initialises and TURN_ON was skipped --
	 * pd-soc-state-change-no-turn-on-under-runtime-pm in docs/findings.md.
	 */
	zassert_ok(pm_device_state_get(dev, &state), "%s: pm_device_state_get() failed",
		   dev->name);
	zassert_true((state == PM_DEVICE_STATE_SUSPENDED) || (state == PM_DEVICE_STATE_OFF),
		     "%s booted %s, want SUSPENDED or OFF under runtime PM", dev->name,
		     pm_device_state_str(state));

	/* Nothing may be measuring before a consumer has asked for it. */
	zassert_false(freqme_measuring(), "%s: measuring before any consumer took a reference",
		      dev->name);

	/* And an unwrapped call is refused, not silently lost. */
	err = freqme_configure_measure(FREQME_WINDOW_NS);
	zassert_equal(err, -EBUSY, "%s: configure() without a reference returned %d",
		      dev->name, err);

	/*
	 * Booted OFF, the device has had no TURN_ON yet. Taking the first reference
	 * resumes the power domain, which turns on every device under it before
	 * this one is resumed -- so by the time the reference is held the selected
	 * sources are routed, whichever state it booted in.
	 */
	zassert_ok(pm_device_runtime_get(dev), "%s: runtime_get rejected", dev->name);
	freqme_default_route(&want_ref, &want_tar);
	freqme_image_read(&img);
	(void)pm_device_runtime_put(dev);

	zassert_equal(img.route_ref, want_ref,
		      "%s: FREQMEAS_REF %u once the first reference is held, want %u",
		      dev->name, img.route_ref, want_ref);
	zassert_equal(img.route_tar, want_tar,
		      "%s: FREQMEAS_TAR %u once the first reference is held, want %u",
		      dev->name, img.route_tar, want_tar);
}

ZTEST(freqme_pm, test_runtime_measure_survives_a_put)
{
	const struct device *dev = freqme_dev();
	uint32_t before = 0U;
	uint32_t retained = 0U;
	uint32_t after = 0U;

	zassert_ok(pm_device_runtime_get(dev), "%s: runtime_get rejected", dev->name);
	zassert_pm_state(dev, PM_DEVICE_STATE_ACTIVE);
	zassert_ok(freqme_measure_once(FREQME_WINDOW_NS, &before),
		   "%s: the measurement failed under a held reference", dev->name);

	/* A second reference must not be a second resume, and releasing it must not
	 * suspend a device somebody else still holds.
	 */
	zassert_ok(pm_device_runtime_get(dev), "%s: nested runtime_get rejected", dev->name);
	zassert_ok(pm_device_runtime_put(dev), "%s: first runtime_put rejected", dev->name);
	zassert_pm_state(dev, PM_DEVICE_STATE_ACTIVE);

	zassert_ok(pm_device_runtime_put(dev), "%s: last runtime_put rejected", dev->name);
	zassert_pm_state(dev, PM_DEVICE_STATE_SUSPENDED);
	freqme_report_hw("after-put");

	/* The result the consumer was handed stays readable while suspended. */
	zassert_ok(clock_monitor_get_rate(dev, &retained),
		   "%s: get_rate() refused on a suspended device", dev->name);
	zassert_equal(retained, before, "%s: get_rate() returned %u while suspended, %u before",
		      dev->name, retained, before);

	/*
	 * The consumer gets the configured measurement back by taking the reference
	 * again, without configuring again. Its callback only arrives if the resume
	 * put back the interrupt enable the suspend cleared.
	 */
	zassert_ok(pm_device_runtime_get(dev), "%s: runtime_get after the put rejected",
		   dev->name);
	zassert_ok(freqme_start_and_wait(100U),
		   "%s: a measurement started after the reference came back did not complete",
		   dev->name);
	zassert_ok(clock_monitor_get_rate(dev, &after), "%s: no result after re-get",
		   dev->name);
	zassert_true(freqme_rate_plausible(after), "%s: measured %u Hz after re-get", dev->name,
		     after);
	zassert_ok(pm_device_runtime_put(dev), "%s: final runtime_put rejected", dev->name);
}

ZTEST(freqme_pm, test_runtime_window_follows_the_reference)
{
	const struct device *dev = freqme_dev();
	bool reported_while_held;
	bool reported_while_released;
	bool reported_after_reget;

	zassert_ok(pm_device_runtime_get(dev), "%s: runtime_get rejected", dev->name);
	zassert_ok(freqme_start_window(true), "%s: could not start WINDOW", dev->name);
	reported_while_held = freqme_window_events_arrive(50U);

	/* The last reference goes away, so the driver suspends and monitoring stops. */
	zassert_ok(pm_device_runtime_put(dev), "%s: runtime_put rejected", dev->name);
	reported_while_released = freqme_window_events_arrive(20U);
	freqme_report_hw("after-put");

	/* Taking it back re-arms the monitor the consumer started, without a start(). */
	zassert_ok(pm_device_runtime_get(dev), "%s: runtime_get after the put rejected",
		   dev->name);
	reported_after_reget = freqme_window_events_arrive(50U);
	freqme_report_hw("after-reget");

	(void)clock_monitor_stop(dev);
	(void)pm_device_runtime_put(dev);

	zassert_true(reported_while_held, "%s: WINDOW reported nothing under a reference",
		     dev->name);
	zassert_false(reported_while_released,
		      "%s: WINDOW kept reporting after the last reference was dropped",
		      dev->name);
	zassert_true(reported_after_reget,
		     "%s: WINDOW did not resume when the reference was taken back", dev->name);
}
```
