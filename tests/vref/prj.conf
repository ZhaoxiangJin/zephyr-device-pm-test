## CMakeLists.txt
```
# Copyright 2026 NXP
# SPDX-License-Identifier: Apache-2.0

cmake_minimum_required(VERSION 3.20.0)

# Expose the shared PM-test library and layer snippets.
list(APPEND EXTRA_ZEPHYR_MODULES ${CMAKE_CURRENT_LIST_DIR}/../..)

find_package(Zephyr REQUIRED HINTS $ENV{ZEPHYR_BASE})
project(vref_device_pm)

target_sources(app PRIVATE src/main.c src/vref.c src/test_control.c)

target_sources_ifdef(CONFIG_PM_TEST_LAYER_DEVICE     app PRIVATE src/test_device.c)
target_sources_ifdef(CONFIG_PM_TEST_LAYER_RUNTIME    app PRIVATE src/test_runtime.c)
target_sources_ifdef(CONFIG_PM_TEST_LAYER_SYSTEM     app PRIVATE src/test_system.c)
target_sources_ifdef(CONFIG_PM_TEST_LAYER_SYSMANAGED app PRIVATE src/test_lowpower.c)
target_sources_ifdef(CONFIG_PM_TEST_LAYER_DPD        app PRIVATE src/test_lowpower.c)
```

## prj.conf
```kconfig
# Copyright 2026 NXP
# SPDX-License-Identifier: Apache-2.0

CONFIG_ZTEST=y
CONFIG_MAIN_STACK_SIZE=2048
CONFIG_PM_TEST=y
CONFIG_PM_EARLY_SYSTEM_TIMER_RESUME=y

CONFIG_REGULATOR=y
CONFIG_ADC=n

# Flush logs before the test disables interrupts.
CONFIG_LOG=y
CONFIG_LOG_MODE_IMMEDIATE=y
CONFIG_REGULATOR_LOG_LEVEL_INF=y
```

## overlay-pm-runtime.conf
```kconfig
# Layer 2: runtime device PM (reference counted).
#
# CONFIG_PM_DEVICE_RUNTIME alone is NOT enough to get the interesting behaviour.
# pm_device_driver_init() (subsys/pm/device.c) only leaves a device SUSPENDED and
# marks runtime PM enabled for it when either
#   - CONFIG_PM_DEVICE_RUNTIME_DEFAULT_ENABLE=y, or
#   - the DT node has zephyr,pm-device-runtime-auto
# is present. Without one of them the device is resumed to ACTIVE, runtime PM stays
# *disabled* for it, and pm_device_runtime_get()/put() return 0 without doing
# anything (subsys/pm/device_runtime.c early-returns on !PM_DEVICE_FLAG_RUNTIME_ENABLED)
# -- i.e. the whole phase would silently pass while testing nothing.

CONFIG_PM_DEVICE=y
CONFIG_PM_DEVICE_RUNTIME=y
CONFIG_PM_DEVICE_RUNTIME_DEFAULT_ENABLE=y
```

## overlay-pm-sysmanaged.conf
```kconfig
# Layer 4: system PM with the system-managed device sweep.
#
# CONFIG_PM_DEVICE_SYSTEM_MANAGED and CONFIG_PM_DEVICE_RUNTIME are mutually
# exclusive suspend paths, and they exercise different driver code:
#
#   - runtime PM   a consumer's get/put drives SUSPEND/RESUME. The regulator API
#                  takes no runtime PM reference of its own, so nothing but this
#                  test ever calls them on a vref.
#   - system sweep pm_suspend_devices() walks every device in reverse init order
#                  on the way into a low-power state and resumes them on the way
#                  out. Stacked with a DPD overlay this is also what drives the
#                  core power domain, and therefore the only path that reaches
#                  the driver's TURN_ON on a block that really lost power.
#
# This layer covers the second one: the reference boots ACTIVE and enabled, the
# test forces one transition, and the reference has to come back configured.

CONFIG_PM=y
CONFIG_PM_DEVICE=y
CONFIG_PM_DEVICE_SYSTEM_MANAGED=y

# Wakeup: LPTMR0 through the counter alarm API, the same arrangement the
# samples/boards/nxp/mcxn_a/s2ram sample uses.
CONFIG_WUC=y
CONFIG_COUNTER=y
CONFIG_COUNTER_MCUX_LPTMR_ALARM=y
```

## overlay-pm-system.conf
```kconfig
# Layer 3: system PM + per-device power-state constraints.
# With CONFIG_PM and CONFIG_PM_POLICY_DEVICE_CONSTRAINTS a driver can block the
# power states its block does not survive while it has work in flight. The VREF
# driver takes no such lock -- an enabled reference is not an operation in flight
# -- so what this layer checks is that the mechanism is on, that the node
# declares the state (see constraints.overlay), and that nothing ends up holding
# a policy lock on the reference's behalf.

CONFIG_PM=y
CONFIG_PM_DEVICE=y
CONFIG_PM_DEVICE_RUNTIME=y
CONFIG_PM_DEVICE_RUNTIME_DEFAULT_ENABLE=y
CONFIG_PM_POLICY_DEVICE_CONSTRAINTS=y
```

## constraints.overlay
```dts
/*
 * Copyright 2026 NXP
 * SPDX-License-Identifier: Apache-2.0
 */

/* Include the deepest state in the generated constraint table; this layer
 * checks policy locks without entering that state.
 */
&deeppowerdown {
	status = "okay";
};
```

## boards/frdm_mcxa577.overlay
```dts
/*
 * Copyright 2026 NXP
 * SPDX-License-Identifier: Apache-2.0
 */

#include <zephyr/dt-bindings/regulator/nxp_vref.h>

/ {
	aliases {
		test-vref = &vref;
	};
};

&vref {
	status = "okay";
	regulator-initial-mode = <NXP_VREF_MODE_HIGH_POWER>;
};
```

## boards/mcx_n9xx_evk_mcxn947_cpu0.overlay
```dts
/*
 * Copyright 2026 NXP
 * SPDX-License-Identifier: Apache-2.0
 *
 * VREF setup for the device-PM test.
 *
 * The alias is what src/main.c resolves, so the sample never hard-codes a node
 * label. status = "okay" is redundant on the boards whose dts already enables the
 * reference and is repeated here so the case does not depend on that.
 *
 * regulator-initial-mode pins the 2.1 V buffer on in high-power mode, matching
 * samples/drivers/adc/adc_dt. It also gives this test something to check: the
 * mode is applied by regulator_common_init() at boot, and the phases ask whether
 * it is still in effect afterwards.
 */

#include <zephyr/dt-bindings/regulator/nxp_vref.h>

/ {
	aliases {
		test-vref = &vref;
	};
};

&vref {
	status = "okay";
	regulator-initial-mode = <NXP_VREF_MODE_HIGH_POWER>;
};
```

## src/main.c
```c
/*
 * Copyright 2026 NXP
 * SPDX-License-Identifier: Apache-2.0
 */

#include <zephyr/ztest.h>
#include <zephyr/dt-bindings/regulator/nxp_vref.h>

#include <pm_test/layer.h>

#include "vref.h"

static void *vref_pm_setup(void)
{
	(void)pm_test_setup();
	vref_report_configuration();
	vref_report_hw("at boot");
	return NULL;
}

static void vref_pm_before(void *fixture)
{
	ARG_UNUSED(fixture);

	zassert_true(device_is_ready(VREF_DEV), "%s is not ready", VREF_DEV->name);
	zassert_false(regulator_is_enabled(VREF_DEV), "previous test leaked a regulator reference");
	zassert_ok(regulator_set_mode(VREF_DEV, DT_PROP_OR(VREF_NODE, regulator_initial_mode,
							 NXP_VREF_MODE_STANDBY)));
}

ZTEST_SUITE(vref_pm, NULL, vref_pm_setup, vref_pm_before, NULL, NULL);
```

## src/test_control.c
```c
/*
 * Copyright 2026 NXP
 * SPDX-License-Identifier: Apache-2.0
 */

#include <zephyr/dt-bindings/regulator/nxp_vref.h>
#include <zephyr/ztest.h>

#include "vref.h"

ZTEST(vref_pm, test_control_enable)
{
	regulator_mode_t mode;

	zassert_false(regulator_is_enabled(VREF_DEV), "another consumer holds the test regulator");
	zassert_ok(regulator_get_mode(VREF_DEV, &mode));
	zassert_equal(mode, DT_PROP_OR(VREF_NODE, regulator_initial_mode, NXP_VREF_MODE_STANDBY));
	zassert_ok(regulator_enable(VREF_DEV));
	zassert_true(vref_config_bits_present(), "DT configuration missing: CSR 0x%08x",
		     vref_csr());
	zassert_true(vref_output_stable(), "bandgap not enabled and stable");
	zassert_true(vref_mode_is_configured(), "buffer mode not applied");
	vref_report_hw("enabled");

	zassert_ok(regulator_disable(VREF_DEV));
	zassert_true(vref_output_disabled(), "last disable left analog circuitry enabled");
	zassert_ok(regulator_enable(VREF_DEV));
	zassert_true(vref_mode_is_configured(), "disable/enable lost the requested mode");
	zassert_ok(regulator_disable(VREF_DEV));
}
```

## src/test_device.c
```c
/*
 * Copyright 2026 NXP
 * SPDX-License-Identifier: Apache-2.0
 */

#include <errno.h>
#include <zephyr/dt-bindings/regulator/nxp_vref.h>
#include <zephyr/pm/device.h>
#include <zephyr/ztest.h>

#include <pm_test/state.h>

#include "vref.h"

static void cycle(bool enabled, regulator_mode_t mode)
{
	int32_t voltage;
	int32_t restored;
	uint32_t clobber;
	uint32_t expected_trim;

	zassert_ok(vref_pick_voltage(&voltage));
	zassert_ok(regulator_set_voltage(VREF_DEV, voltage, voltage));
	expected_trim = vref_trim();
	zassert_ok(regulator_set_mode(VREF_DEV, mode));
	if (enabled) {
		zassert_ok(regulator_enable(VREF_DEV));
		zassert_ok(regulator_enable(VREF_DEV));
	}

	for (int i = 0; i < 2; i++) {
		zassert_ok(pm_device_action_run(VREF_DEV, PM_DEVICE_ACTION_SUSPEND));
		zassert_pm_state(VREF_DEV, PM_DEVICE_STATE_SUSPENDED);
		zassert_true(vref_output_disabled(), "SUSPEND left output circuitry enabled");
		zassert_ok(pm_device_action_run(VREF_DEV, PM_DEVICE_ACTION_TURN_OFF));

		vref_config_bits_clobber();
		clobber = vref_trim_clobber();
		zassert_false(vref_config_bits_present(), "configuration corruption did not take");
		zassert_equal(vref_trim(), clobber);
		zassert_not_equal(clobber, expected_trim,
				  "trim corruption left the selected value");

		zassert_ok(pm_device_action_run(VREF_DEV, PM_DEVICE_ACTION_TURN_ON));
		zassert_pm_state(VREF_DEV, PM_DEVICE_STATE_SUSPENDED);
		zassert_true(vref_config_bits_present(), "TURN_ON did not rebuild configuration");
		zassert_true(vref_output_disabled(), "TURN_ON started an output");
		zassert_ok(pm_device_action_run(VREF_DEV, PM_DEVICE_ACTION_RESUME));
		zassert_pm_state(VREF_DEV, PM_DEVICE_STATE_ACTIVE);
		zassert_ok(regulator_get_voltage(VREF_DEV, &restored));
		zassert_equal(restored, voltage);
		zassert_equal(regulator_is_enabled(VREF_DEV), enabled);
		if (enabled) {
			zassert_true(vref_output_stable(), "held output not restored");
			zassert_equal(vref_hw_mode(), mode, "consumer mode not restored");
		} else {
			zassert_true(vref_output_disabled(), "unused output was enabled");
		}
		vref_report_hw("replayed");
	}

	if (enabled) {
		zassert_ok(regulator_disable(VREF_DEV));
		zassert_true(vref_output_stable(),
			     "first disable dropped another consumer's output");
		zassert_ok(regulator_disable(VREF_DEV));
	}
	zassert_true(vref_output_disabled());
}

ZTEST(vref_pm, test_device_held_output_replay)
{
	cycle(true, NXP_VREF_MODE_LOW_POWER);
	cycle(true, NXP_VREF_MODE_HIGH_POWER);
	cycle(true, NXP_VREF_MODE_STANDBY);
}

ZTEST(vref_pm, test_device_disabled_output_replay)
{
	cycle(false, NXP_VREF_MODE_HIGH_POWER);
}

ZTEST(vref_pm, test_device_suspended_access)
{
	int32_t voltage;
	regulator_mode_t mode;

	zassert_ok(vref_pick_voltage(&voltage));
	zassert_ok(pm_device_action_run(VREF_DEV, PM_DEVICE_ACTION_SUSPEND));
	zassert_equal(regulator_set_mode(VREF_DEV, UINT8_MAX), -EINVAL);
	zassert_equal(regulator_set_voltage(VREF_DEV, 0, 0), -EINVAL);
	zassert_equal(regulator_enable(VREF_DEV), -EBUSY);
	zassert_equal(regulator_set_mode(VREF_DEV, NXP_VREF_MODE_LOW_POWER), -EBUSY);
	zassert_equal(regulator_set_voltage(VREF_DEV, voltage, voltage), -EBUSY);
	zassert_equal(regulator_get_voltage(VREF_DEV, &voltage), -EBUSY);
	zassert_equal(regulator_get_mode(VREF_DEV, &mode), -EBUSY);
	zassert_true(vref_output_disabled());
	zassert_ok(pm_device_action_run(VREF_DEV, PM_DEVICE_ACTION_RESUME));
}
```

## src/test_lowpower.c
```c
/*
 * Copyright 2026 NXP
 * SPDX-License-Identifier: Apache-2.0
 */

#include <zephyr/dt-bindings/regulator/nxp_vref.h>
#include <zephyr/pm/device.h>
#include <zephyr/sys/atomic.h>
#include <zephyr/ztest.h>

#include <pm_test/lowpower.h>
#include <pm_test/state.h>

#include "vref.h"

static atomic_t entries;
static atomic_t exits;

static void state_entry(enum pm_state state)
{
	if (state == PM_TEST_TRANSITION_STATE) {
		atomic_inc(&entries);
	}
}

static void state_exit(enum pm_state state)
{
	if (state == PM_TEST_TRANSITION_STATE) {
		atomic_inc(&exits);
	}
}

static struct pm_notifier notifier = {
	.state_entry = state_entry,
	.state_exit = state_exit,
};

static void transition(bool enabled)
{
	int32_t before_uv;
	int32_t after_uv = 0;
	bool configured;
	bool stable;
	bool disabled;
	bool enabled_after;
	regulator_mode_t mode;
	int voltage_rc;
	int disable_rc = 0;

	zassert_ok(vref_pick_voltage(&before_uv));
	zassert_ok(regulator_set_voltage(VREF_DEV, before_uv, before_uv));
	zassert_ok(regulator_set_mode(VREF_DEV, NXP_VREF_MODE_LOW_POWER));
	if (enabled) {
		zassert_ok(regulator_enable(VREF_DEV));
		zassert_true(vref_output_stable());
	}
	zassert_pm_state(VREF_DEV, PM_DEVICE_STATE_ACTIVE);
	atomic_clear(&entries);
	atomic_clear(&exits);
	pm_notifier_register(&notifier);
	pm_test_enter_transition();

	configured = vref_config_bits_present();
	stable = vref_output_stable();
	disabled = vref_output_disabled();
	mode = vref_hw_mode();
	enabled_after = regulator_is_enabled(VREF_DEV);
	voltage_rc = regulator_get_voltage(VREF_DEV, &after_uv);

	pm_test_console_resume(PM_TEST_CONSOLE_REINIT_PINMUX);
	zassert_ok(pm_notifier_unregister(&notifier));
	vref_report_hw("resumed");
	if (enabled) {
		disable_rc = regulator_disable(VREF_DEV);
	}

	zassert_true(atomic_get(&entries) > 0, "requested power state was never entered");
	zassert_equal(atomic_get(&exits), atomic_get(&entries), "unpaired PM notifications");
	zassert_pm_state(VREF_DEV, PM_DEVICE_STATE_ACTIVE);
	zassert_true(configured, "DT configuration was not restored");
	zassert_ok(voltage_rc);
	zassert_equal(after_uv, before_uv, "consumer voltage was not restored");
	zassert_equal(enabled_after, enabled, "regulator reference count changed across PM");
	zassert_ok(disable_rc);
	if (enabled) {
		zassert_true(stable, "held output was not restored");
		zassert_equal(mode, NXP_VREF_MODE_LOW_POWER, "consumer mode was not restored");
	} else {
		zassert_true(disabled, "unused output was enabled on resume");
	}
	zassert_true(vref_output_disabled());
}

ZTEST(vref_pm, test_sweep_held_output)
{
	transition(true);
}

ZTEST(vref_pm, test_sweep_disabled_output)
{
	transition(false);
}
```

## src/test_runtime.c
```c
/*
 * Copyright 2026 NXP
 * SPDX-License-Identifier: Apache-2.0
 */

#include <zephyr/dt-bindings/regulator/nxp_vref.h>
#include <zephyr/pm/device_runtime.h>
#include <zephyr/ztest.h>

#include <pm_test/state.h>

#include "vref.h"

ZTEST(vref_pm, test_runtime_output_lifetime)
{
	zassert_true(pm_device_runtime_is_enabled(VREF_DEV));
	zassert_pm_state(VREF_DEV, PM_DEVICE_STATE_SUSPENDED);
	zassert_equal(pm_device_runtime_usage(VREF_DEV), 0);
	zassert_true(vref_output_disabled());

	zassert_ok(regulator_enable(VREF_DEV));
	zassert_ok(regulator_enable(VREF_DEV));
	zassert_pm_state(VREF_DEV, PM_DEVICE_STATE_ACTIVE);
	zassert_equal(pm_device_runtime_usage(VREF_DEV), 1);
	zassert_true(vref_config_bits_present());
	zassert_true(vref_output_stable());

	zassert_ok(regulator_disable(VREF_DEV));
	zassert_pm_state(VREF_DEV, PM_DEVICE_STATE_ACTIVE);
	zassert_true(vref_output_stable());
	zassert_ok(regulator_disable(VREF_DEV));
	zassert_pm_state(VREF_DEV, PM_DEVICE_STATE_SUSPENDED);
	zassert_equal(pm_device_runtime_usage(VREF_DEV), 0);
	zassert_true(vref_output_disabled());
}

ZTEST(vref_pm, test_runtime_configuration_without_output)
{
	int32_t chosen;
	int32_t voltage;
	regulator_mode_t mode;

	zassert_ok(vref_pick_voltage(&chosen));
	zassert_ok(regulator_set_voltage(VREF_DEV, chosen, chosen));
	zassert_ok(regulator_set_mode(VREF_DEV, NXP_VREF_MODE_LOW_POWER));
	zassert_ok(regulator_get_voltage(VREF_DEV, &voltage));
	zassert_ok(regulator_get_mode(VREF_DEV, &mode));
	zassert_equal(voltage, chosen);
	zassert_equal(mode, NXP_VREF_MODE_LOW_POWER);
	zassert_pm_state(VREF_DEV, PM_DEVICE_STATE_SUSPENDED);
	zassert_equal(pm_device_runtime_usage(VREF_DEV), 0);
	zassert_true(vref_output_disabled());

	zassert_ok(regulator_enable(VREF_DEV));
	zassert_equal(vref_hw_mode(), NXP_VREF_MODE_LOW_POWER);
	zassert_ok(regulator_disable(VREF_DEV));
}

ZTEST(vref_pm, test_runtime_external_reference)
{
	zassert_ok(pm_device_runtime_get(VREF_DEV));
	zassert_ok(regulator_enable(VREF_DEV));
	zassert_equal(pm_device_runtime_usage(VREF_DEV), 2);
	zassert_ok(regulator_disable(VREF_DEV));
	zassert_pm_state(VREF_DEV, PM_DEVICE_STATE_ACTIVE);
	zassert_true(vref_output_disabled());
	zassert_ok(pm_device_runtime_put(VREF_DEV));
	zassert_pm_state(VREF_DEV, PM_DEVICE_STATE_SUSPENDED);
	zassert_equal(pm_device_runtime_usage(VREF_DEV), 0);
}
```

## src/test_system.c
```c
/*
 * Copyright 2026 NXP
 * SPDX-License-Identifier: Apache-2.0
 */

#include <zephyr/pm/device_runtime.h>
#include <zephyr/pm/policy.h>
#include <zephyr/ztest.h>

#include <pm_test/lowpower.h>

#include "vref.h"

static void assert_constraints(bool locked)
{
	unsigned int states = 0U;

	pm_test_console_quiesce();
	for (enum pm_state state = PM_STATE_RUNTIME_IDLE; state < PM_STATE_COUNT; state++) {
		if (pm_policy_device_is_disabling_state(VREF_DEV, state, 0U)) {
			states++;
			zassert_equal(pm_policy_state_lock_is_active(state, 0U), locked,
				      "state %d lock does not follow the output", state);
		}
	}
	zassert_true(states > 0U, "no enabled disabling state: this test proves nothing");
}

ZTEST(vref_pm, test_system_constraints_follow_output)
{
	assert_constraints(false);
	zassert_ok(regulator_enable(VREF_DEV));
	zassert_ok(regulator_enable(VREF_DEV));
	assert_constraints(true);
	zassert_ok(regulator_disable(VREF_DEV));
	assert_constraints(true);
	zassert_ok(regulator_disable(VREF_DEV));
	assert_constraints(false);
}

ZTEST(vref_pm, test_system_active_registers_do_not_hold_output_constraint)
{
	zassert_ok(pm_device_runtime_get(VREF_DEV));
	zassert_true(vref_output_disabled());
	assert_constraints(false);
	zassert_ok(regulator_enable(VREF_DEV));
	assert_constraints(true);
	zassert_ok(regulator_disable(VREF_DEV));
	assert_constraints(false);
	zassert_ok(pm_device_runtime_put(VREF_DEV));
}
```

## src/vref.c
```c
/*
 * Copyright 2026 NXP
 * SPDX-License-Identifier: Apache-2.0
 */

#include <errno.h>

#include <zephyr/devicetree.h>
#include <zephyr/drivers/regulator.h>
#include <zephyr/dt-bindings/regulator/nxp_vref.h>
#include <zephyr/tc_util.h>

#include <fsl_device_registers.h>

#include "vref.h"

static VREF_Type *const base = (VREF_Type *)DT_REG_ADDR(VREF_NODE);

#if defined(FSL_FEATURE_VREF_HAS_TRIM2V1) && (FSL_FEATURE_VREF_HAS_TRIM2V1 == 0)
#define VREF_TRIM_MASK  VREF_UTRIM_VREFTRIM_MASK
#define VREF_TRIM_SHIFT VREF_UTRIM_VREFTRIM_SHIFT
const bool vref_trim_is_factory = true;
#else
#define VREF_TRIM_MASK  VREF_UTRIM_TRIM2V1_MASK
#define VREF_TRIM_SHIFT VREF_UTRIM_TRIM2V1_SHIFT
const bool vref_trim_is_factory = false;
#endif

#define VREF_DT_CSR_BITS                                                                           \
	((DT_PROP(VREF_NODE, nxp_current_compensation_en) ? VREF_CSR_ICOMPEN_MASK : 0U) |          \
	 (DT_PROP(VREF_NODE, nxp_chop_oscillator_en) ? VREF_CSR_CHOPEN_MASK : 0U) |                \
	 (DT_PROP(VREF_NODE, nxp_internal_voltage_regulator_en) ? VREF_CSR_REGEN_MASK : 0U))

#define VREF_DT_MODE DT_PROP_OR(VREF_NODE, regulator_initial_mode, NXP_VREF_MODE_STANDBY)

static const char *mode_str(regulator_mode_t mode)
{
	switch (mode) {
	case NXP_VREF_MODE_STANDBY:
		return "STANDBY";
	case NXP_VREF_MODE_LOW_POWER:
		return "LOW_POWER";
	case NXP_VREF_MODE_HIGH_POWER:
		return "HIGH_POWER";
	default:
		return "?";
	}
}

uint32_t vref_csr(void)
{
	return base->CSR;
}

uint32_t vref_trim(void)
{
	return (base->UTRIM & VREF_TRIM_MASK) >> VREF_TRIM_SHIFT;
}

bool vref_config_bits_present(void)
{
	return (base->CSR & (VREF_CSR_ICOMPEN_MASK | VREF_CSR_CHOPEN_MASK |
			     VREF_CSR_REGEN_MASK)) == VREF_DT_CSR_BITS;
}

void vref_config_bits_clobber(void)
{
	base->CSR ^= VREF_CSR_ICOMPEN_MASK | VREF_CSR_CHOPEN_MASK | VREF_CSR_REGEN_MASK;
}

regulator_mode_t vref_hw_mode(void)
{
	uint32_t csr = base->CSR;

	if ((csr & VREF_CSR_BUF21EN_MASK) == 0U) {
		return NXP_VREF_MODE_STANDBY;
	}
	return (csr & VREF_CSR_HI_PWR_LV_MASK) != 0U ?
		NXP_VREF_MODE_HIGH_POWER : NXP_VREF_MODE_LOW_POWER;
}

bool vref_mode_is_configured(void)
{
	return vref_hw_mode() == VREF_DT_MODE;
}

bool vref_output_disabled(void)
{
	uint32_t mask = VREF_CSR_HCBGEN_MASK | VREF_CSR_BUF21EN_MASK;

#if defined(FSL_FEATURE_VREF_HAS_LPBGEN) && (FSL_FEATURE_VREF_HAS_LPBGEN == 0)
	mask |= VREF_CSR_IBIAS_EN_MASK;
#else
	mask |= VREF_CSR_LPBGEN_MASK;
#endif
#if !(defined(FSL_FEATURE_VREF_HAS_LOWPOWER_BUFFER) && (FSL_FEATURE_VREF_HAS_LOWPOWER_BUFFER == 0))
	mask |= VREF_CSR_LPBG_BUF_EN_MASK;
#endif
	return (base->CSR & mask) == 0U;
}

bool vref_output_stable(void)
{
	uint32_t mask = VREF_CSR_HCBGEN_MASK | VREF_CSR_VREFST_MASK;

	return (base->CSR & mask) == mask;
}

uint32_t vref_trim_clobber(void)
{
	uint32_t code = vref_trim() == 3U ? 0U : 3U;

	base->UTRIM = (base->UTRIM & ~VREF_TRIM_MASK) |
		      ((code << VREF_TRIM_SHIFT) & VREF_TRIM_MASK);

	return code;
}

int vref_pick_voltage(int32_t *volt_uv)
{
	unsigned int count = regulator_count_voltages(VREF_DEV);

	if (count == 0U) {
		return -ENOTSUP;
	}

	return regulator_list_voltage(VREF_DEV, count / 2U, volt_uv);
}

void vref_report_configuration(void)
{
	TC_PRINT("%s at 0x%08x: devicetree CSR bits 0x%08x, initial mode %s, trim variant %s\n",
		 VREF_DEV->name, (unsigned int)DT_REG_ADDR(VREF_NODE),
		 (unsigned int)VREF_DT_CSR_BITS, mode_str(VREF_DT_MODE),
		 vref_trim_is_factory ? "VREFTRIM (factory)" : "TRIM2V1");
}

void vref_report_hw(const char *when)
{
	TC_PRINT("hw(%s) CSR=0x%08x trim=0x%x mode=%s stable=%u enabled=%u\n", when,
		 base->CSR, vref_trim(), mode_str(vref_hw_mode()), vref_output_stable() ? 1U : 0U,
		 regulator_is_enabled(VREF_DEV) ? 1U : 0U);
}
```

## src/vref.h
```c
/*
 * Copyright 2026 NXP
 * SPDX-License-Identifier: Apache-2.0
 */

/* Register readback does not acquire runtime PM references. */

#ifndef VREF_PM_H_
#define VREF_PM_H_

#include <stdbool.h>
#include <stdint.h>
#include <zephyr/device.h>
#include <zephyr/devicetree.h>
#include <zephyr/drivers/regulator.h>

#define VREF_NODE DT_ALIAS(test_vref)

#if !DT_NODE_HAS_STATUS(VREF_NODE, okay)
#error "No test-vref alias resolving to an enabled nxp,vref node on this board"
#endif

#if !DT_NODE_HAS_COMPAT(VREF_NODE, nxp_vref)
#error "test-vref must name an nxp,vref node; nxp,vrefv1 is a different driver"
#endif

#if !defined(CONFIG_REGULATOR_NXP_VREF)
#error "CONFIG_REGULATOR_NXP_VREF is not enabled, so there is no driver to test"
#endif

#define VREF_DEV DEVICE_DT_GET(VREF_NODE)

/** True for the factory-loaded VREFTRIM-only variant. */
extern const bool vref_trim_is_factory;

uint32_t vref_csr(void);
uint32_t vref_trim(void);

/** Compare all configuration bits, including disabled DT options. */
bool vref_config_bits_present(void);
void vref_config_bits_clobber(void);

/** Compare the hardware mode with regulator-initial-mode. */
bool vref_mode_is_configured(void);

/** Decode CSR rather than the driver's cached mode. */
regulator_mode_t vref_hw_mode(void);

/** True when all bandgap, bias and buffer enable bits are clear. */
bool vref_output_disabled(void);

/** Require both HCBGEN and VREFST. */
bool vref_output_stable(void);

/** Corrupt UTRIM without changing the driver's saved trim; return the new code. */
uint32_t vref_trim_clobber(void);

int vref_pick_voltage(int32_t *volt_uv);

void vref_report_configuration(void);
void vref_report_hw(const char *when);

#endif /* VREF_PM_H_ */
```
