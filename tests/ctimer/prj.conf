## CMakeLists.txt
```
# Copyright 2026 NXP
# SPDX-License-Identifier: Apache-2.0

cmake_minimum_required(VERSION 3.20.0)

# Pulls in this repository as a Zephyr module, which is what makes lib/pm_test,
# include/pm_test and the snippets/pm-* snippets available. Nothing has to be
# passed on the command line: `-S pm-<layer>` is the whole interface.
list(APPEND EXTRA_ZEPHYR_MODULES ${CMAKE_CURRENT_LIST_DIR}/../..)

find_package(Zephyr REQUIRED HINTS $ENV{ZEPHYR_BASE})
project(ctimer_device_pm)

# The suite, the register view, and the control test that every layer runs.
target_sources(app PRIVATE src/main.c src/ctimer.c src/test_control.c)

# One file per layer. A layer's file is the only place that layer's claims live,
# so a build for a layer contains no code belonging to any other.
target_sources_ifdef(CONFIG_PM_TEST_LAYER_DEVICE     app PRIVATE src/test_device.c)
target_sources_ifdef(CONFIG_PM_TEST_LAYER_RUNTIME    app PRIVATE src/test_runtime.c)
target_sources_ifdef(CONFIG_PM_TEST_LAYER_SYSTEM     app PRIVATE src/test_system.c)
target_sources_ifdef(CONFIG_PM_TEST_LAYER_SYSMANAGED app PRIVATE src/test_lowpower.c)
target_sources_ifdef(CONFIG_PM_TEST_LAYER_DPD        app PRIVATE src/test_lowpower.c)
```

## prj.conf
```kconfig
# Copyright 2026 NXP
# SPDX-License-Identifier: Apache-2.0
#
# Layer-independent configuration only. The PM symbols come from the layer, which
# comes from the pm-* snippet; see lib/pm_test/Kconfig and docs/pm-layers.md.

CONFIG_ZTEST=y
CONFIG_PM_TEST=y

CONFIG_COUNTER=y

# Driver logging at info level, immediate: the run ends with interrupts locked so
# that the core cannot park in WFI, and a deferred log would never be flushed.
# include/pm_test/layer.h asserts this pairing.
CONFIG_LOG=y
CONFIG_LOG_MODE_IMMEDIATE=y
CONFIG_COUNTER_LOG_LEVEL_INF=y
```

## constraints.overlay
```dts
/*
 * Copyright 2026 NXP
 * SPDX-License-Identifier: Apache-2.0
 *
 * System-PM constraint layer: mark which SoC power states stop this CTIMER
 * counting. Stacked on top of whatever the board target already applies, for the
 * system layer only (via EXTRA_DTC_OVERLAY_FILE).
 *
 * Why all three, and why this belongs here rather than in the SoC dtsi. Per MCX
 * Nx4x RM Rev. 6_RC2 Table 336, CTIMER0 is "LP/Static" in both Deep Sleep and Power
 * Down and CTIMER1-3 are "LP/Static" in Deep Sleep -- that is, the block *can* keep
 * counting in those states, but only on a functional clock that survives them. The
 * MCXN and MCXA boards this case runs on all attach PLL0 (or the equivalent
 * system PLL) to their CTIMER, and that PLL is off in Deep Sleep, so on these boards
 * every one of the three states does stop the counter. Which clock feeds a CTIMER is
 * a board decision, not an SoC one, so the SoC dtsi cannot declare this list for
 * every board the way the DAC nodes can -- a board that attached the low-power
 * oscillator instead would be declaring a constraint it does not have.
 *
 * Deep Power Down additionally gates the CORE domain and resets the registers, which
 * is the stronger loss the dpd layer is about.
 */

&ctimer0 {
	zephyr,disabling-power-states = <&deepsleep &powerdown &deeppowerdown>;
};
```

## src/main.c
```c
/*
 * Copyright 2026 NXP
 * SPDX-License-Identifier: Apache-2.0
 */

/**
 * @file
 * @brief CTIMER device-PM suite: the suite hooks, and nothing else.
 *
 * Which layer this build tests, and therefore which src/test_*.c is compiled in,
 * is decided by the pm-* snippet on the command line. See docs/pm-layers.md.
 */

#include <zephyr/ztest.h>

#include <pm_test/layer.h>
#include <pm_test/state.h>

#include "ctimer.h"

static void *ctimer_pm_setup(void)
{
	(void)pm_test_setup();
	ctimer_report_configuration();

	CTIMER_FOREACH_CASE(c) {
		pm_test_note_state(c->dev, "at boot");
		ctimer_report_hw(c, "at boot");
	}

	return NULL;
}

static void ctimer_pm_before(void *fixture)
{
	ARG_UNUSED(fixture);

	CTIMER_FOREACH_CASE(c) {
		zassert_true(device_is_ready(c->dev), "%s is not ready", c->dev->name);
	}
}

ZTEST_SUITE(ctimer_pm, NULL, ctimer_pm_setup, ctimer_pm_before, NULL, NULL);
```

## src/ctimer.c
```c
/*
 * Copyright 2026 NXP
 * SPDX-License-Identifier: Apache-2.0
 */

/**
 * @file
 * @brief The CTIMER wiring, and the hardware truths this case asserts on.
 */

#include <zephyr/devicetree.h>
#include <zephyr/kernel.h>
#include <zephyr/sys/util.h>
#include <zephyr/tc_util.h>

#include <zephyr/dt-bindings/clock/mcux_lpc_syscon_clock.h>
#include <fsl_clock.h>
#include <soc.h>

#include "ctimer.h"

/*
 * Every instance takes its clock from the syscon node with a single MCUX_CTIMERn
 * cell, so the instance number is the distance from MCUX_CTIMER0_CLK. That is also
 * what names the clock gate below, so a part wiring this driver to some other clock
 * controller would need a different mapping and is refused here rather than read
 * out of the wrong register.
 */
#define CTIMER_ASSERT_SYSCON_CLOCK(node_id)                                                        \
	BUILD_ASSERT(DT_NODE_HAS_COMPAT(DT_CLOCKS_CTLR(node_id), nxp_lpc_syscon),                  \
		     "this case reads the CTIMER clock gate out of the MCX clock controller and "   \
		     "only fits SoCs whose CTIMER clocks come from nxp,lpc-syscon");

DT_FOREACH_STATUS_OKAY(nxp_lpc_ctimer, CTIMER_ASSERT_SYSCON_CLOCK)

#define CTIMER_ENTRY(node_id)                                                                      \
	{                                                                                          \
		.dev = DEVICE_DT_GET(node_id),                                                     \
		.index = (uint8_t)(DT_CLOCKS_CELL(node_id, name) - MCUX_CTIMER0_CLK),              \
		.base = (uintptr_t)DT_REG_ADDR(node_id),                                           \
	},

const struct ctimer_case ctimer_cases[CTIMER_CASE_COUNT] = {
	DT_FOREACH_STATUS_OKAY(nxp_lpc_ctimer, CTIMER_ENTRY)
};

/* Set from the alarm callback; one slot per instance, indexed by ctimer_cases. */
static volatile bool ctimer_fired[CTIMER_CASE_COUNT];

static CTIMER_Type *ctimer_base(const struct ctimer_case *c)
{
	return (CTIMER_Type *)c->base;
}

static uint8_t ctimer_slot(const struct ctimer_case *c)
{
	return (uint8_t)(c - &ctimer_cases[0]);
}

static bool ctimer_gate_of(uint8_t index, clock_ip_name_t *gate)
{
	/*
	 * Guarded by the HAL's instance count, not by the devicetree: MCXA153 and
	 * MCXA344 stop at CTIMER2 and have no gate constant beyond it, so naming
	 * kCLOCK_GateCTIMER3 there does not compile. Same guard as the syscon clock
	 * driver's own CTIMER cases in clock_control_mcux_syscon.c.
	 */
#if defined(CONFIG_SOC_FAMILY_MCXA)
	switch (index) {
	case 0:
		*gate = kCLOCK_GateCTIMER0;
		break;
#if FSL_FEATURE_SOC_CTIMER_COUNT > 1
	case 1:
		*gate = kCLOCK_GateCTIMER1;
		break;
#endif
#if FSL_FEATURE_SOC_CTIMER_COUNT > 2
	case 2:
		*gate = kCLOCK_GateCTIMER2;
		break;
#endif
#if FSL_FEATURE_SOC_CTIMER_COUNT > 3
	case 3:
		*gate = kCLOCK_GateCTIMER3;
		break;
#endif
#if FSL_FEATURE_SOC_CTIMER_COUNT > 4
	case 4:
		*gate = kCLOCK_GateCTIMER4;
		break;
#endif
	default:
		return false;
	}

	return *gate != kCLOCK_GateNotAvail;
#else
	switch (index) {
	case 0:
		*gate = kCLOCK_Timer0;
		break;
#if FSL_FEATURE_SOC_CTIMER_COUNT > 1
	case 1:
		*gate = kCLOCK_Timer1;
		break;
#endif
#if FSL_FEATURE_SOC_CTIMER_COUNT > 2
	case 2:
		*gate = kCLOCK_Timer2;
		break;
#endif
#if FSL_FEATURE_SOC_CTIMER_COUNT > 3
	case 3:
		*gate = kCLOCK_Timer3;
		break;
#endif
#if FSL_FEATURE_SOC_CTIMER_COUNT > 4
	case 4:
		*gate = kCLOCK_Timer4;
		break;
#endif
	default:
		return false;
	}

	return *gate != kCLOCK_None;
#endif
}

bool ctimer_gate_observable(const struct ctimer_case *c)
{
	clock_ip_name_t gate;

	return ctimer_gate_of(c->index, &gate);
}

/*
 * CLOCK_EnableClock()/CLOCK_DisableClock() write through the write-only SET/CLR
 * aliases, so the readable register is the one at the head of each group:
 * SYSCON->AHBCLKCTRL0..3 on MCXN (contiguous from 0x200), MRCC0->MRCC_GLB_CCn on
 * MCXA (group stride 0x10, which is what the HAL's CLK_GATE_REG_OFFSET() encodes).
 */
bool ctimer_gate_is_open(const struct ctimer_case *c)
{
	clock_ip_name_t gate;

	if (!ctimer_gate_of(c->index, &gate)) {
		return false;
	}

#if defined(CONFIG_SOC_FAMILY_MCXA)
	const volatile uint32_t *reg =
		(const volatile uint32_t *)((uintptr_t)&MRCC0->MRCC_GLB_CC0 +
					    CLK_GATE_REG_OFFSET(gate));

	return (*reg & BIT(CLK_GATE_BIT_SHIFT(gate))) != 0U;
#else
	const volatile uint32_t *reg = &(&SYSCON->AHBCLKCTRL0)[CLK_GATE_ABSTRACT_REG_OFFSET(gate)];

	return (*reg & BIT(CLK_GATE_ABSTRACT_BITS_SHIFT(gate))) != 0U;
#endif
}

void ctimer_gate_open(const struct ctimer_case *c)
{
	clock_ip_name_t gate;

	if (ctimer_gate_of(c->index, &gate)) {
		CLOCK_EnableClock(gate);
	}
}

void ctimer_gate_close(const struct ctimer_case *c)
{
	clock_ip_name_t gate;

	if (ctimer_gate_of(c->index, &gate)) {
		CLOCK_DisableClock(gate);
	}
}

void ctimer_image_read(const struct ctimer_case *c, struct ctimer_image *img)
{
	CTIMER_Type *base = ctimer_base(c);

	img->mcr = base->MCR;
	img->mr = base->MR[CTIMER_ALARM_CHANNEL];
	img->tcr = base->TCR;
}

bool ctimer_image_equal(const struct ctimer_image *a, const struct ctimer_image *b)
{
	return (a->mcr == b->mcr) && (a->mr == b->mr) && (a->tcr == b->tcr);
}

void ctimer_clobber(const struct ctimer_case *c, struct ctimer_image *clobbered)
{
	CTIMER_Type *base = ctimer_base(c);
	bool was_open = ctimer_gate_is_open(c);

	/* The registers cannot be written while the block is unclocked, and this is
	 * called from a layer where the driver has already gated it.
	 */
	ctimer_gate_open(c);

	base->TCR = 0U;
	base->MCR = 0U;
	base->MR[CTIMER_ALARM_CHANNEL] = 0U;

	ctimer_image_read(c, clobbered);

	if (!was_open) {
		ctimer_gate_close(c);
	}
}

bool ctimer_running(const struct ctimer_case *c)
{
	return (ctimer_base(c)->TCR & CTIMER_TCR_CEN_MASK) != 0U;
}

bool ctimer_advances(const struct ctimer_case *c)
{
	uint32_t first;
	uint32_t second;

	if (counter_get_value(c->dev, &first) != 0) {
		return false;
	}

	/*
	 * Busy-waited rather than slept: at the slowest CTIMER clock any board here
	 * attaches this is still hundreds of ticks, and a sleep would let the idle
	 * thread enter a power state in the layers that have one.
	 */
	k_busy_wait(200);

	if (counter_get_value(c->dev, &second) != 0) {
		return false;
	}

	return first != second;
}

int ctimer_start_and_verify(const struct ctimer_case *c)
{
	int err = counter_start(c->dev);

	if (err != 0) {
		return err;
	}

	return ctimer_advances(c) ? 0 : -ESTALE;
}

int ctimer_stop(const struct ctimer_case *c)
{
	return counter_stop(c->dev);
}

static void ctimer_alarm_callback(const struct device *dev, uint8_t chan_id, uint32_t ticks,
				  void *user_data)
{
	const struct ctimer_case *c = user_data;

	ARG_UNUSED(dev);
	ARG_UNUSED(chan_id);
	ARG_UNUSED(ticks);

	ctimer_fired[ctimer_slot(c)] = true;
}

int ctimer_arm_alarm(const struct ctimer_case *c, uint32_t delay_ms)
{
	uint32_t freq = counter_get_frequency(c->dev);
	struct counter_alarm_cfg cfg = {
		.callback = ctimer_alarm_callback,
		.user_data = (void *)c,
		.flags = 0,
	};

	if (freq == 0U) {
		return -EIO;
	}

	cfg.ticks = (uint32_t)(((uint64_t)freq * delay_ms) / 1000U);
	if (cfg.ticks == 0U) {
		return -EINVAL;
	}

	ctimer_fired[ctimer_slot(c)] = false;

	return counter_set_channel_alarm(c->dev, CTIMER_ALARM_CHANNEL, &cfg);
}

int ctimer_cancel_alarm(const struct ctimer_case *c)
{
	return counter_cancel_channel_alarm(c->dev, CTIMER_ALARM_CHANNEL);
}

bool ctimer_alarm_fired(const struct ctimer_case *c)
{
	return ctimer_fired[ctimer_slot(c)];
}

bool ctimer_alarm_wait(const struct ctimer_case *c, uint32_t timeout_ms)
{
	for (uint32_t waited = 0U; waited < timeout_ms; waited += 5U) {
		if (ctimer_alarm_fired(c)) {
			return true;
		}

		k_msleep(5);
	}

	return ctimer_alarm_fired(c);
}

void ctimer_report_configuration(void)
{
	TC_PRINT("%u CTIMER instance(s) under test\n", (unsigned int)CTIMER_CASE_COUNT);

	CTIMER_FOREACH_CASE(c) {
		TC_PRINT("  %s: CTIMER%u @ %p, %u Hz, gate %s\n", c->dev->name,
			 (unsigned int)c->index, (void *)c->base, counter_get_frequency(c->dev),
			 ctimer_gate_observable(c) ? "observable" : "NOT observable on this SoC");
	}
}

void ctimer_report_hw(const struct ctimer_case *c, const char *when)
{
	if (!ctimer_gate_observable(c)) {
		TC_PRINT("hw(%s, %s) gate not observable on this SoC\n", when, c->dev->name);
		return;
	}

	if (!ctimer_gate_is_open(c)) {
		/* Deliberately no register read: an unclocked block does not answer. */
		TC_PRINT("hw(%s, %s) gate=0, registers not read\n", when, c->dev->name);
		return;
	}

	struct ctimer_image img;

	ctimer_image_read(c, &img);
	TC_PRINT("hw(%s, %s) gate=1 TCR=0x%08x MCR=0x%08x MR%u=0x%08x\n", when, c->dev->name,
		 img.tcr, img.mcr, (unsigned int)CTIMER_ALARM_CHANNEL, img.mr);
}
```

## src/ctimer.h
```c
/*
 * Copyright 2026 NXP
 * SPDX-License-Identifier: Apache-2.0
 */

/**
 * @file
 * @brief What every layer of the CTIMER case needs from the hardware.
 *
 * Two things are observed, because neither alone is enough.
 *
 * The first is the block's AHB clock gate, read out of the clock controller the
 * way tests/port reads it -- not out of a CTIMER register, because a CTIMER
 * register only answers while the block is clocked, and whether it is clocked is
 * the question. Gating that clock is the whole of what SUSPEND does for power, so
 * without it there is nothing to see: a stopped counter and a suspended one look
 * identical from the counter API.
 *
 * The second is the register image of an armed alarm: MR[0] holds the match value
 * and MCR its interrupt enable, and nothing else in the block carries them. This
 * is what tells a restored CTIMER from one that came back from reset -- and it has
 * to be the run-time image rather than the devicetree one, because on every board
 * here prescale, mode and input are all 0, which is also what a reset leaves. A
 * case that compared the devicetree configuration against reset would compare zero
 * against zero and pass without the driver restoring anything.
 *
 * A counter that advances is the third thing, and it is the control: it is what
 * makes "the gate is open" mean the peripheral works rather than that a bit is set.
 */

#ifndef CTIMER_PM_H_
#define CTIMER_PM_H_

#include <stdbool.h>
#include <stdint.h>
#include <zephyr/device.h>
#include <zephyr/devicetree.h>
#include <zephyr/drivers/counter.h>

#if !DT_HAS_COMPAT_STATUS_OKAY(nxp_lpc_ctimer)
#error "No nxp,lpc-ctimer node is enabled on this board"
#endif

#if !defined(CONFIG_COUNTER_MCUX_CTIMER)
#error "CONFIG_COUNTER_MCUX_CTIMER is not enabled, so there is no driver to test"
#endif

/** The alarm channel every test arms. Channel 0 exists on every instance. */
#define CTIMER_ALARM_CHANNEL 0U

/** How many enabled nxp,lpc-ctimer instances this build covers. */
#define CTIMER_PM_COUNT_ONE(node_id) +1
#define CTIMER_CASE_COUNT (0 DT_FOREACH_STATUS_OKAY(nxp_lpc_ctimer, CTIMER_PM_COUNT_ONE))

/** One CTIMER instance under test. */
struct ctimer_case {
	const struct device *dev;
	/** Instance number, from the syscon clock cell; names the clock gate. */
	uint8_t index;
	/** Register block, for the two registers an armed alarm lives in. */
	uintptr_t base;
};

extern const struct ctimer_case ctimer_cases[CTIMER_CASE_COUNT];

/** @brief Iterate the instances. */
#define CTIMER_FOREACH_CASE(c)                                                                     \
	for (const struct ctimer_case *c = &ctimer_cases[0];                                       \
	     c < &ctimer_cases[CTIMER_CASE_COUNT]; c++)

/**
 * @brief True when this SoC's HAL names a clock gate for @p c.
 *
 * An instance whose gate cannot be named is reported and asserted nothing about,
 * rather than passing quietly.
 */
bool ctimer_gate_observable(const struct ctimer_case *c);

/** @brief True while the instance's AHB clock gate is open. */
bool ctimer_gate_is_open(const struct ctimer_case *c);

/** @brief Open the gate behind the driver's back, so a clobber can be written. */
void ctimer_gate_open(const struct ctimer_case *c);

/** @brief Close it again, leaving the block as a suspend left it. */
void ctimer_gate_close(const struct ctimer_case *c);

/**
 * @brief The registers an armed alarm lives in.
 *
 * Only meaningful while the block is clocked; every caller here reads it with the
 * gate open.
 */
struct ctimer_image {
	uint32_t mcr;
	uint32_t mr;
	uint32_t tcr;
};

/** @brief Sample @ref ctimer_image. */
void ctimer_image_read(const struct ctimer_case *c, struct ctimer_image *img);

/** @brief True when two images are the same. */
bool ctimer_image_equal(const struct ctimer_image *a, const struct ctimer_image *b);

/**
 * @brief Overwrite the armed-alarm registers with a cleared image.
 *
 * What stands in for a power cycle in a layer where nothing really cut power, so
 * that a restore has something to put back. Takes care of the clock gate itself and
 * leaves it as it found it.
 *
 * @param c         instance to clobber
 * @param clobbered read back after the write, so a caller can prove the clobber took
 */
void ctimer_clobber(const struct ctimer_case *c, struct ctimer_image *clobbered);

/** @brief True while TCR[CEN] says the counter is running. */
bool ctimer_running(const struct ctimer_case *c);

/**
 * @brief Start the counter and check that it is actually counting.
 *
 * @return 0 when two reads taken a short wait apart differ, negative errno from
 *         the counter API, or -ESTALE when the counter did not move.
 */
int ctimer_start_and_verify(const struct ctimer_case *c);

/** @brief counter_stop(). */
int ctimer_stop(const struct ctimer_case *c);

/** @brief True when two reads a short wait apart differ. */
bool ctimer_advances(const struct ctimer_case *c);

/**
 * @brief Arm the alarm on @ref CTIMER_ALARM_CHANNEL, @p delay_ms out.
 *
 * Clears the fired flag first. The alarm is relative, so it is measured from the
 * counter's current value.
 *
 * @return 0, or negative errno from counter_set_alarm().
 */
int ctimer_arm_alarm(const struct ctimer_case *c, uint32_t delay_ms);

/** @brief Cancel it again, whether or not it fired. */
int ctimer_cancel_alarm(const struct ctimer_case *c);

/** @brief True once the alarm callback has run. */
bool ctimer_alarm_fired(const struct ctimer_case *c);

/**
 * @brief Wait up to @p timeout_ms for the alarm to fire.
 *
 * @return true if it fired within the timeout.
 */
bool ctimer_alarm_wait(const struct ctimer_case *c, uint32_t timeout_ms);

/** @brief Print what the devicetree asked for, once, from the suite setup. */
void ctimer_report_configuration(void);

/**
 * @brief Print the gate and, when the gate is open, the register image.
 *
 * Safe to call with the gate closed: it prints the gate and says the registers
 * were not read rather than faulting on an unclocked block.
 *
 * @param when short label for where in the sequence this is, e.g. "before".
 */
void ctimer_report_hw(const struct ctimer_case *c, const char *when);

#endif /* CTIMER_PM_H_ */
```

## src/test_control.c
```c
/*
 * Copyright 2026 NXP
 * SPDX-License-Identifier: Apache-2.0
 */

/**
 * @file
 * @brief The control: this case really does drive the CTIMER.
 *
 * Compiled into every layer. If this fails, no verdict from the layer under test
 * means anything -- which is the whole reason the baseline layer exists as a layer.
 *
 * Two claims, and the second is what makes the rest of the case possible: that the
 * counter counts, and that an armed alarm leaves a register image distinguishable
 * from a reset block. Every later layer tells "restored" from "came back from
 * reset" by comparing against that image, so a case where it is empty proves
 * nothing anywhere.
 */

#include <zephyr/pm/device_runtime.h>
#include <zephyr/ztest.h>

#include "ctimer.h"

ZTEST(ctimer_pm, test_control_counts_and_arms)
{
	CTIMER_FOREACH_CASE(c) {
		struct ctimer_image armed;
		bool held = false;
		int start_rc;
		int arm_rc;
		bool fired;

		/*
		 * Under runtime PM the device boots suspended and this driver takes no
		 * reference of its own, so the control has to ask for it. That an
		 * unwrapped call is refused is test_runtime.c's claim, not a premise
		 * of the control.
		 */
		if (pm_device_runtime_is_enabled(c->dev)) {
			zassert_ok(pm_device_runtime_get(c->dev),
				   "%s: could not resume the device for the control",
				   c->dev->name);
			held = true;
		}

		start_rc = ctimer_start_and_verify(c);
		arm_rc = ctimer_arm_alarm(c, 20U);
		ctimer_image_read(c, &armed);
		fired = ctimer_alarm_wait(c, 500U);

		(void)ctimer_cancel_alarm(c);
		(void)ctimer_stop(c);
		ctimer_report_hw(c, "control");

		if (held) {
			/* Before the assertions: a failure must not leak the reference. */
			(void)pm_device_runtime_put(c->dev);
		}

		zassert_ok(start_rc, "%s: counter did not start and count (%d)", c->dev->name,
			   start_rc);
		zassert_ok(arm_rc, "%s: counter_set_alarm() failed (%d)", c->dev->name, arm_rc);
		zassert_true(fired, "%s: the alarm never fired", c->dev->name);

		/*
		 * The prescale, mode and input this driver writes from devicetree are all
		 * 0 on every board here, which is also what a reset leaves -- so the
		 * armed alarm is the only register state in this block that a restore can
		 * be seen to put back.
		 */
		zassert_not_equal(armed.mr, 0U, "%s: MR%u is 0 with an alarm armed",
				  c->dev->name, (unsigned int)CTIMER_ALARM_CHANNEL);
		zassert_not_equal(armed.mcr, 0U, "%s: MCR is 0 with an alarm armed",
				  c->dev->name);
	}
}
```

## src/test_device.c
```c
/*
 * Copyright 2026 NXP
 * SPDX-License-Identifier: Apache-2.0
 */

/**
 * @file
 * @brief The device layer: the driver's PM callbacks, driven directly.
 *
 * Two tests, for the two halves of the callback. The first is the SUSPEND/RESUME
 * round trip, which owns the clock gate. The second is TURN_OFF/TURN_ON, which owns
 * the register block -- and since nothing in this layer really cut power to it, the
 * block is clobbered by hand so that the restore has something to put back. What a
 * real power cycle does is asked in src/test_lowpower.c under the dpd layer.
 *
 * Note which action is expected to bring the block up. This driver does nothing in
 * TURN_ON and configures from RESUME, so that an instance which boots SUSPENDED
 * under runtime PM boots with its clock genuinely gated instead of running behind a
 * PM state that says otherwise. The second test asserts that split rather than
 * assuming it.
 */

#include <zephyr/pm/device.h>
#include <zephyr/ztest.h>

#include <pm_test/state.h>

#include "ctimer.h"

ZTEST(ctimer_pm, test_device_suspend_resume)
{
	CTIMER_FOREACH_CASE(c) {
		struct ctimer_image armed;
		struct ctimer_image after;
		int err;

		if (!ctimer_gate_observable(c)) {
			TC_PRINT("%s: clock gate not observable, nothing asserted\n",
				 c->dev->name);
			continue;
		}

		/* No runtime PM in this layer, so pm_device_driver_init() resumed it. */
		zassert_pm_state(c->dev, PM_DEVICE_STATE_ACTIVE);
		zassert_true(ctimer_gate_is_open(c), "%s: gate closed while PM reports ACTIVE",
			     c->dev->name);

		zassert_ok(ctimer_start_and_verify(c), "%s: counter did not start", c->dev->name);
		zassert_ok(ctimer_arm_alarm(c, 50U), "%s: could not arm the alarm", c->dev->name);
		ctimer_image_read(c, &armed);
		ctimer_report_hw(c, "before-suspend");

		zassert_ok(pm_device_action_run(c->dev, PM_DEVICE_ACTION_SUSPEND),
			   "%s: SUSPEND action rejected", c->dev->name);
		zassert_pm_state(c->dev, PM_DEVICE_STATE_SUSPENDED);
		ctimer_report_hw(c, "after-suspend");

		/*
		 * The claim of this layer: the block is no longer clocked. Nothing is read
		 * out of it here -- an unclocked block does not answer, and reading it to
		 * find out whether it is clocked is the one thing that cannot be done.
		 */
		zassert_false(ctimer_gate_is_open(c), "%s: clock gate still open after SUSPEND",
			      c->dev->name);
		zassert_false(ctimer_alarm_fired(c),
			      "%s: the alarm fired while the block was suspended", c->dev->name);

		zassert_ok(pm_device_action_run(c->dev, PM_DEVICE_ACTION_RESUME),
			   "%s: RESUME action rejected", c->dev->name);
		zassert_pm_state(c->dev, PM_DEVICE_STATE_ACTIVE);
		ctimer_image_read(c, &after);
		ctimer_report_hw(c, "after-resume");

		zassert_true(ctimer_gate_is_open(c), "%s: gate still closed after RESUME",
			     c->dev->name);

		/*
		 * The alarm the consumer armed is still armed, and the counter it was
		 * armed against is running again -- so it fires without the consumer
		 * doing anything.
		 */
		zassert_true(ctimer_image_equal(&after, &armed),
			     "%s: RESUME left TCR=0x%08x MCR=0x%08x MR=0x%08x, want "
			     "0x%08x/0x%08x/0x%08x", c->dev->name, after.tcr, after.mcr,
			     after.mr, armed.tcr, armed.mcr, armed.mr);
		zassert_true(ctimer_advances(c), "%s: the counter is not running after RESUME",
			     c->dev->name);
		zassert_true(ctimer_alarm_wait(c, 500U),
			     "%s: the alarm did not fire after RESUME", c->dev->name);

		/* A redundant action must be refused, not obeyed and not fatal. */
		err = pm_device_action_run(c->dev, PM_DEVICE_ACTION_RESUME);
		zassert_equal(err, -EALREADY, "%s: second RESUME returned %d, want -EALREADY",
			      c->dev->name, err);

		(void)ctimer_cancel_alarm(c);
		(void)ctimer_stop(c);
	}
}

ZTEST(ctimer_pm, test_device_resume_rebuilds_the_register_block)
{
	CTIMER_FOREACH_CASE(c) {
		struct ctimer_image armed;
		struct ctimer_image clobbered;
		struct ctimer_image after_resume;
		bool gate_after_turn_on;
		int suspend_rc;
		int turn_off_rc;
		int turn_on_rc;
		int resume_rc;

		if (!ctimer_gate_observable(c)) {
			TC_PRINT("%s: clock gate not observable, nothing asserted\n",
				 c->dev->name);
			continue;
		}

		zassert_pm_state(c->dev, PM_DEVICE_STATE_ACTIVE);
		zassert_ok(ctimer_start_and_verify(c), "%s: counter did not start", c->dev->name);
		zassert_ok(ctimer_arm_alarm(c, 50U), "%s: could not arm the alarm", c->dev->name);
		ctimer_image_read(c, &armed);

		/*
		 * Collected in one go and asserted afterwards, so that a failure cannot
		 * hand the next test a device the core still records as OFF.
		 */
		suspend_rc = pm_device_action_run(c->dev, PM_DEVICE_ACTION_SUSPEND);

		ctimer_clobber(c, &clobbered);

		turn_off_rc = pm_device_action_run(c->dev, PM_DEVICE_ACTION_TURN_OFF);

		turn_on_rc = pm_device_action_run(c->dev, PM_DEVICE_ACTION_TURN_ON);
		gate_after_turn_on = ctimer_gate_is_open(c);

		resume_rc = pm_device_action_run(c->dev, PM_DEVICE_ACTION_RESUME);
		ctimer_image_read(c, &after_resume);
		ctimer_report_hw(c, "after-resume");

		zassert_ok(suspend_rc, "%s: SUSPEND rejected (%d)", c->dev->name, suspend_rc);
		zassert_ok(turn_off_rc, "%s: TURN_OFF rejected (%d)", c->dev->name, turn_off_rc);
		zassert_ok(turn_on_rc, "%s: TURN_ON rejected (%d)", c->dev->name, turn_on_rc);
		zassert_ok(resume_rc, "%s: RESUME rejected (%d)", c->dev->name, resume_rc);
		zassert_pm_state(c->dev, PM_DEVICE_STATE_ACTIVE);

		/* Before anything else: a clobber that did not take would make the restore
		 * assertion below pass without the driver having rebuilt a thing.
		 */
		zassert_false(ctimer_image_equal(&clobbered, &armed),
			      "%s: the clobber did not take, so this test proves nothing",
			      c->dev->name);

		/*
		 * TURN_ON returns with the core about to record the device as suspended,
		 * so a block left clocked would be a block running behind a PM state that
		 * says it is not. Bringing it back is RESUME's job, and it has to bring
		 * back the run-time image and not just a devicetree configuration that is
		 * indistinguishable from reset.
		 */
		zassert_false(gate_after_turn_on, "%s: TURN_ON opened the clock gate",
			      c->dev->name);
		zassert_true(ctimer_gate_is_open(c), "%s: RESUME left the clock gate closed",
			     c->dev->name);
		zassert_true(ctimer_image_equal(&after_resume, &armed),
			     "%s: RESUME left TCR=0x%08x MCR=0x%08x MR=0x%08x, want "
			     "0x%08x/0x%08x/0x%08x", c->dev->name, after_resume.tcr,
			     after_resume.mcr, after_resume.mr, armed.tcr, armed.mcr, armed.mr);
		zassert_true(ctimer_alarm_wait(c, 500U),
			     "%s: the restored alarm did not fire", c->dev->name);

		(void)ctimer_cancel_alarm(c);
		(void)ctimer_stop(c);
	}
}
```

## src/test_lowpower.c
```c
/*
 * Copyright 2026 NXP
 * SPDX-License-Identifier: Apache-2.0
 */

/**
 * @file
 * @brief The sysmanaged and dpd layers: the device sweep across one transition.
 *
 * One file for two layers, because the sequence is identical and only the state
 * being entered differs -- and that difference is what separates the two claims. In
 * sysmanaged the sweep's SUSPEND and RESUME are all that happen, so re-opening the
 * clock gate and restarting the counter is enough. In dpd the CORE domain is power
 * gated: the whole register block comes back at its reset value, the SYSCON clock
 * gate with it, and nothing re-runs driver init -- so RESUME has to rebuild the
 * armed alarm from the image the suspend kept. dpd is the only layer that can catch
 * a driver with no restore path.
 *
 * What is asserted after the transition is deliberately behavioural as well as
 * register-level: that the counter counts and the alarm the consumer armed still
 * fires. A CTIMER's functional clock is selected by the board rather than by this
 * driver, so a register image that came back perfectly while the clock mux did not
 * would look restored and still not count.
 */

#include <zephyr/pm/device.h>
#include <zephyr/ztest.h>

#include <pm_test/lowpower.h>
#include <pm_test/state.h>

#include "ctimer.h"

ZTEST(ctimer_pm, test_sweep_across_transition)
{
	CTIMER_FOREACH_CASE(c) {
		struct ctimer_image armed;
		struct ctimer_image after;
		bool gate_after;

		/* No runtime PM in these layers, so the sweep is the only thing that will
		 * suspend the device.
		 */
		zassert_pm_state(c->dev, PM_DEVICE_STATE_ACTIVE);

		zassert_ok(ctimer_start_and_verify(c), "%s: counter did not start before the "
			   "transition", c->dev->name);

		/*
		 * Far enough out that the console traffic below cannot consume it before
		 * the transition, and the counter is stopped for the whole of the
		 * transition, so what is left of it is measured from the resume.
		 */
		zassert_ok(ctimer_arm_alarm(c, 200U), "%s: could not arm the alarm",
			   c->dev->name);
		ctimer_image_read(c, &armed);
		ctimer_report_hw(c, "before");

		pm_test_enter_transition();

		/* Sampled before the console is revived: reviving it takes time, and the
		 * question is what the block looked like the moment the sweep handed it
		 * back.
		 */
		gate_after = ctimer_gate_is_open(c);
		if (gate_after) {
			ctimer_image_read(c, &after);
		}

		pm_test_console_resume(PM_TEST_CONSOLE_REINIT_PINMUX);
		TC_PRINT("resumed from %s\n", PM_TEST_TRANSITION_NAME);
		ctimer_report_hw(c, "after-resume");

		zassert_pm_state(c->dev, PM_DEVICE_STATE_ACTIVE);

		if (!ctimer_gate_observable(c)) {
			TC_PRINT("%s: clock gate not observable, register claims skipped\n",
				 c->dev->name);
		} else {
			/*
			 * The gate first: without it the register comparison below would be
			 * reading an unclocked block, and "restored" would be whatever the
			 * bus returns.
			 */
			zassert_true(gate_after,
				     "%s: the clock gate was not re-opened across the "
				     "transition", c->dev->name);
			zassert_true(ctimer_image_equal(&after, &armed),
				     "%s: the armed alarm did not survive the transition: "
				     "TCR=0x%08x MCR=0x%08x MR=0x%08x, want 0x%08x/0x%08x/"
				     "0x%08x", c->dev->name, after.tcr, after.mcr, after.mr,
				     armed.tcr, armed.mcr, armed.mr);
		}

		/* And the block has to work, not just read back right. */
		zassert_true(ctimer_advances(c),
			     "%s: the counter is not counting after the transition",
			     c->dev->name);
		zassert_true(ctimer_alarm_wait(c, 1000U),
			     "%s: the alarm the consumer armed did not fire after the "
			     "transition", c->dev->name);

		(void)ctimer_cancel_alarm(c);
		(void)ctimer_stop(c);
	}
}
```

## src/test_runtime.c
```c
/*
 * Copyright 2026 NXP
 * SPDX-License-Identifier: Apache-2.0
 */

/**
 * @file
 * @brief The runtime layer: the consumer owns the counter, and says so with a
 *        reference.
 *
 * This driver takes no runtime PM reference of its own. A counter runs for as long
 * as the application wants a time base, and there is no completion event a put()
 * could hang on, so wrapping each API call in its own get/put would stop the
 * counter the moment the call returned. The reference is the consumer's.
 *
 * What this layer is really here to catch is the boot state. pm_device_driver_init()
 * runs TURN_ON and then stops short of RESUME when runtime PM is about to own the
 * device, so a driver that brings the block up in TURN_ON boots it clocked while the
 * core records it as SUSPENDED -- green everywhere else, and wrong. This driver
 * brings the block up in RESUME for exactly that reason, and the first test below is
 * the check.
 *
 * Two tests. The first has to run first: it reads the state the device booted in,
 * and the second leaves it suspended.
 */

#include <zephyr/pm/device.h>
#include <zephyr/pm/device_runtime.h>
#include <zephyr/ztest.h>

#include <pm_test/state.h>

#include "ctimer.h"

ZTEST(ctimer_pm, test_runtime_boots_without_a_consumer)
{
	CTIMER_FOREACH_CASE(c) {
		enum pm_device_state state;

		zassert_true(pm_device_runtime_is_enabled(c->dev),
			     "%s: runtime PM is not enabled, so this layer tests nothing",
			     c->dev->name);

		/*
		 * Two boot states are legal. Without a power domain the device lands in
		 * SUSPENDED; with one it lands in OFF, because the domain is
		 * runtime-suspended before the CTIMER initialises and TURN_ON was skipped
		 * -- pd-soc-state-change-no-turn-on-under-runtime-pm in docs/findings.md.
		 */
		zassert_ok(pm_device_state_get(c->dev, &state),
			   "%s: pm_device_state_get() failed", c->dev->name);
		zassert_true((state == PM_DEVICE_STATE_SUSPENDED) ||
				     (state == PM_DEVICE_STATE_OFF),
			     "%s booted %s, want SUSPENDED or OFF under runtime PM",
			     c->dev->name, pm_device_state_str(state));

		if (!ctimer_gate_observable(c)) {
			TC_PRINT("%s: clock gate not observable, nothing asserted\n",
				 c->dev->name);
			continue;
		}

		/* The claim. Nothing may be clocked before a consumer has asked for it. */
		zassert_false(ctimer_gate_is_open(c),
			      "%s: clock gate open before any consumer took a reference",
			      c->dev->name);
	}
}

ZTEST(ctimer_pm, test_runtime_reference_counting)
{
	CTIMER_FOREACH_CASE(c) {
		struct ctimer_image armed;
		struct ctimer_image after;

		zassert_ok(pm_device_runtime_get(c->dev), "%s: runtime_get rejected",
			   c->dev->name);
		zassert_pm_state(c->dev, PM_DEVICE_STATE_ACTIVE);

		if (ctimer_gate_observable(c)) {
			zassert_true(ctimer_gate_is_open(c),
				     "%s: gate closed while PM reports ACTIVE", c->dev->name);
		}

		zassert_ok(ctimer_start_and_verify(c), "%s: counter did not start under a held "
			   "reference", c->dev->name);
		zassert_ok(ctimer_arm_alarm(c, 50U), "%s: could not arm the alarm", c->dev->name);
		ctimer_image_read(c, &armed);

		/* A second reference must not be a second resume, and releasing it must not
		 * stop a counter somebody else is still holding.
		 */
		zassert_ok(pm_device_runtime_get(c->dev), "%s: nested runtime_get rejected",
			   c->dev->name);
		zassert_ok(pm_device_runtime_put(c->dev), "%s: first runtime_put rejected",
			   c->dev->name);
		zassert_pm_state(c->dev, PM_DEVICE_STATE_ACTIVE);
		zassert_true(ctimer_advances(c), "%s: counter stopped while a reference was held",
			     c->dev->name);

		zassert_ok(pm_device_runtime_put(c->dev), "%s: last runtime_put rejected",
			   c->dev->name);
		zassert_pm_state(c->dev, PM_DEVICE_STATE_SUSPENDED);
		ctimer_report_hw(c, "after-put");

		if (ctimer_gate_observable(c)) {
			zassert_false(ctimer_gate_is_open(c),
				      "%s: clock gate still open after the last runtime_put",
				      c->dev->name);
		}

		/*
		 * And the consumer gets its counter back by taking the reference again,
		 * without re-arming: what it programmed is the driver's to remember across
		 * a suspend the consumer did not ask for.
		 */
		zassert_ok(pm_device_runtime_get(c->dev), "%s: runtime_get after the put rejected",
			   c->dev->name);
		ctimer_image_read(c, &after);
		ctimer_report_hw(c, "after-reget");

		zassert_true(ctimer_image_equal(&after, &armed),
			     "%s: the armed alarm did not come back with the reference: "
			     "TCR=0x%08x MCR=0x%08x MR=0x%08x, want 0x%08x/0x%08x/0x%08x",
			     c->dev->name, after.tcr, after.mcr, after.mr, armed.tcr, armed.mcr,
			     armed.mr);
		zassert_true(ctimer_alarm_wait(c, 500U), "%s: the alarm did not fire after the "
			     "counter came back", c->dev->name);

		/* Left as it was found, so this test's counter does not outlive it. */
		(void)ctimer_cancel_alarm(c);
		(void)ctimer_stop(c);
		zassert_ok(pm_device_runtime_put(c->dev), "%s: final runtime_put rejected",
			   c->dev->name);
	}
}
```

## src/test_system.c
```c
/*
 * Copyright 2026 NXP
 * SPDX-License-Identifier: Apache-2.0
 */

/**
 * @file
 * @brief The system layer: the per-device power state constraint.
 *
 * The CTIMER node lists the states that stop it counting in
 * zephyr,disabling-power-states (see constraints.overlay), and the driver holds a
 * policy constraint against exactly those states for as long as the counter is
 * actually counting. The window is not one API call -- a counter has no completion
 * event -- so the invariant the driver keeps is narrower and more useful than
 * "between start and stop": the lock is held while TCR[CEN] is set, which means a
 * runtime-PM suspend that stops the counter hands the lock back and a resume that
 * restarts it takes it again. Without that, one counter_start() would block those
 * states for the rest of the run even with no consumer left holding a reference.
 *
 * Two tests: that the lock matches what the node declares and appears only once
 * there is a running counter to protect, and that it follows the counter across a
 * suspend and a resume rather than being taken once and kept.
 */

#include <zephyr/pm/device_runtime.h>
#include <zephyr/pm/policy.h>
#include <zephyr/pm/state.h>
#include <zephyr/ztest.h>

#include <pm_test/lowpower.h>

#include "ctimer.h"

/* How many power states are locked right now, by anyone. */
static unsigned int locked_states(void)
{
	unsigned int locked = 0;

	for (enum pm_state state = PM_STATE_ACTIVE; state < PM_STATE_COUNT; state++) {
		locked += pm_policy_state_lock_is_active(state, 0) ? 1U : 0U;
	}

	return locked;
}

/*
 * How many power states this node declares as disabling. States that are listed but
 * disabled in the devicetree are dropped from the generated table, so this can
 * legitimately be smaller than the list in constraints.overlay -- but a zero means
 * the overlay never reached the node, and every comparison below would then pass
 * while proving nothing.
 */
static unsigned int declared_states(const struct device *dev)
{
	unsigned int declared = 0;

	for (enum pm_state state = PM_STATE_ACTIVE; state < PM_STATE_COUNT; state++) {
		declared += pm_policy_device_is_disabling_state(dev, state, 0) ? 1U : 0U;
	}

	return declared;
}

/* Locked states that the node does not declare, or declared states left unlocked. */
static unsigned int constraint_mismatch(const struct device *dev)
{
	unsigned int mismatch = 0;

	for (enum pm_state state = PM_STATE_ACTIVE; state < PM_STATE_COUNT; state++) {
		bool locked = pm_policy_state_lock_is_active(state, 0);
		bool disabling = pm_policy_device_is_disabling_state(dev, state, 0);

		mismatch += (locked != disabling) ? 1U : 0U;
	}

	return mismatch;
}

ZTEST(ctimer_pm, test_system_constraint_covers_the_declared_states)
{
	CTIMER_FOREACH_CASE(c) {
		unsigned int before;
		unsigned int after_get;
		unsigned int while_counting;
		unsigned int declared;
		unsigned int mismatch;
		unsigned int after_stop;
		int start_rc;

		declared = declared_states(c->dev);
		if (declared == 0U) {
			/* No state is declared to stop this instance, so there is no
			 * constraint to observe. Said rather than passed quietly.
			 */
			TC_PRINT("%s: declares no disabling power state, nothing asserted\n",
				 c->dev->name);
			continue;
		}

		pm_test_console_quiesce();
		before = locked_states();

		zassert_ok(pm_device_runtime_get(c->dev), "%s: runtime_get rejected",
			   c->dev->name);

		/* Resumed, but the counter is not counting yet: nothing to protect. */
		pm_test_console_quiesce();
		after_get = locked_states();

		start_rc = ctimer_start_and_verify(c);
		while_counting = locked_states();
		mismatch = constraint_mismatch(c->dev);

		/* Released before anything is asserted: a failure must not leave a lock
		 * behind, which would silently block those states for the rest of the run.
		 */
		(void)ctimer_stop(c);
		(void)pm_device_runtime_put(c->dev);

		pm_test_console_quiesce();
		after_stop = locked_states();

		zassert_equal(before, 0U, "%s: %u power state(s) were already locked",
			      c->dev->name, before);
		zassert_ok(start_rc, "%s: counter did not start and count (%d)", c->dev->name,
			   start_rc);

		zassert_equal(after_get, 0U,
			      "%s: %u power state(s) locked by a resumed but stopped counter",
			      c->dev->name, after_get);
		zassert_equal(while_counting, declared,
			      "%s: %u state(s) locked while counting, %u declared", c->dev->name,
			      while_counting, declared);
		zassert_equal(mismatch, 0U,
			      "%s: %u power state(s) whose lock does not match the node",
			      c->dev->name, mismatch);
		zassert_equal(after_stop, 0U, "%s: %u power state(s) still locked after stop",
			      c->dev->name, after_stop);
	}
}

ZTEST(ctimer_pm, test_system_constraint_follows_the_counter)
{
	CTIMER_FOREACH_CASE(c) {
		unsigned int declared;
		unsigned int while_counting;
		unsigned int while_suspended;
		unsigned int after_resume;
		unsigned int at_end;
		int start_rc;
		bool counting_after_resume;

		declared = declared_states(c->dev);
		if (declared == 0U) {
			TC_PRINT("%s: declares no disabling power state, nothing asserted\n",
				 c->dev->name);
			continue;
		}

		pm_test_console_quiesce();

		zassert_ok(pm_device_runtime_get(c->dev), "%s: runtime_get rejected",
			   c->dev->name);
		start_rc = ctimer_start_and_verify(c);
		while_counting = locked_states();

		/* The last reference goes away, so the driver suspends and the counter
		 * stops -- and with it the reason for the lock.
		 */
		(void)pm_device_runtime_put(c->dev);
		pm_test_console_quiesce();
		while_suspended = locked_states();

		/*
		 * A resume restarts the counter the consumer was running, so it has to
		 * take the protection back. A driver that only took the lock in start()
		 * would come back counting with nothing stopping the policy from entering
		 * a state that stops the clock under it.
		 */
		zassert_ok(pm_device_runtime_get(c->dev), "%s: second runtime_get rejected",
			   c->dev->name);
		counting_after_resume = ctimer_advances(c);
		after_resume = locked_states();

		(void)ctimer_stop(c);
		(void)pm_device_runtime_put(c->dev);
		pm_test_console_quiesce();
		at_end = locked_states();

		zassert_ok(start_rc, "%s: counter did not start and count (%d)", c->dev->name,
			   start_rc);
		zassert_equal(while_counting, declared,
			      "%s: %u state(s) locked while counting, %u declared", c->dev->name,
			      while_counting, declared);
		zassert_equal(while_suspended, 0U,
			      "%s: %u power state(s) still locked while suspended", c->dev->name,
			      while_suspended);
		zassert_true(counting_after_resume, "%s: the counter is not running after resume",
			     c->dev->name);
		zassert_equal(after_resume, declared,
			      "%s: %u state(s) locked after the counter came back, %u declared",
			      c->dev->name, after_resume, declared);
		zassert_equal(at_end, 0U, "%s: %u power state(s) leaked past the end of the test",
			      c->dev->name, at_end);
	}
}
```
