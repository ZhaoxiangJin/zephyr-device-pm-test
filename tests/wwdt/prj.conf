## CMakeLists.txt
```
# Copyright 2026 NXP
# SPDX-License-Identifier: Apache-2.0

cmake_minimum_required(VERSION 3.20.0)

# Pulls in this repository as a Zephyr module, which is what makes lib/pm_test,
# include/pm_test and the snippets/pm-* snippets available. Nothing has to be
# passed on the command line: `-S pm-<layer>` is the whole interface.
list(APPEND EXTRA_ZEPHYR_MODULES ${CMAKE_CURRENT_LIST_DIR}/../..)

find_package(Zephyr REQUIRED HINTS $ENV{ZEPHYR_BASE})
project(wwdt_device_pm)

# The suite, the register view, and the control test that every layer runs.
target_sources(app PRIVATE src/main.c src/wwdt.c src/test_control.c)

# One file per layer. A layer's file is the only place that layer's claims live,
# so a build for a layer contains no code belonging to any other.
target_sources_ifdef(CONFIG_PM_TEST_LAYER_DEVICE     app PRIVATE src/test_device.c)
target_sources_ifdef(CONFIG_PM_TEST_LAYER_RUNTIME    app PRIVATE src/test_runtime.c)
target_sources_ifdef(CONFIG_PM_TEST_LAYER_SYSTEM     app PRIVATE src/test_system.c)
target_sources_ifdef(CONFIG_PM_TEST_LAYER_SYSMANAGED app PRIVATE src/test_lowpower.c)
target_sources_ifdef(CONFIG_PM_TEST_LAYER_DPD        app PRIVATE src/test_lowpower.c)
```

## prj.conf
```kconfig
# Copyright 2026 NXP
# SPDX-License-Identifier: Apache-2.0
#
# Layer-independent configuration only. The PM symbols come from the layer, which
# comes from the pm-* snippet; see lib/pm_test/Kconfig and docs/pm-layers.md.

CONFIG_ZTEST=y
CONFIG_PM_TEST=y
CONFIG_MAIN_STACK_SIZE=4096

CONFIG_WATCHDOG=y

# Driver logging at info level, immediate: the run ends with interrupts locked so
# that the core cannot park in WFI, and a deferred log would never be flushed.
# include/pm_test/layer.h asserts this pairing.
CONFIG_LOG=y
CONFIG_LOG_MODE_IMMEDIATE=y
CONFIG_WDT_LOG_LEVEL_INF=y
```

## boards/frdm_mcxa577.overlay
```dts
/*
 * Copyright 2026 NXP
 * SPDX-License-Identifier: Apache-2.0
 */

&wwdt1 {
	status = "okay";
};
```

## src/main.c
```c
/*
 * Copyright 2026 NXP
 * SPDX-License-Identifier: Apache-2.0
 */

/**
 * @file
 * @brief WWDT device-PM suite: the suite hooks, and nothing else.
 *
 * Which layer this build tests, and therefore which src/test_*.c is compiled
 * in, is decided by the pm-* snippet on the command line. See
 * docs/pm-layers.md.
 *
 * Idle observations precede the shared running session. The terminal disable
 * suite runs afterward, without relying on test registration or shuffle order.
 */

#include <errno.h>
#include <zephyr/drivers/watchdog.h>
#include <zephyr/pm/device_runtime.h>
#include <zephyr/pm/policy.h>
#include <zephyr/ztest.h>

#include <pm_test/layer.h>
#include <pm_test/lowpower.h>
#include <pm_test/state.h>

#include "wwdt.h"

enum wwdt_test_phase {
  WWDT_TEST_RUNNING,
  WWDT_TEST_STOPPED,
};

static bool wwdt_running_phase(const void *state) {
  return state != NULL && *(const enum wwdt_test_phase *)state == WWDT_TEST_RUNNING;
}

static bool wwdt_stopped_phase(const void *state) {
  return state != NULL && *(const enum wwdt_test_phase *)state == WWDT_TEST_STOPPED;
}

static void *wwdt_pm_setup(void) {
  (void)pm_test_setup();
  wwdt_report_configuration();

  pm_test_note_state(wwdt_dev, "at boot");
  wwdt_report_hw("at boot");

  if (!device_is_ready(wwdt_dev)) {
    wwdt_start_rc = -ENODEV;
    return NULL;
  }

  TC_PRINT("pre-start checks begin\n");
  wwdt_start_rc = wwdt_layer_before_start();
  TC_PRINT("pre-start checks returned %d\n", wwdt_start_rc);
  if (wwdt_start_rc != 0) {
    TC_PRINT("pre-start checks failed: %d\n", wwdt_start_rc);
    return NULL;
  }

  wwdt_start_rc = wwdt_install();
  if (wwdt_start_rc != 0) {
    return NULL;
  }
#if defined(CONFIG_PM_DEVICE_RUNTIME)
  /*
   * The driver takes no runtime reference of its own: the consumer holds one
   * for as long as the watchdog runs, until the terminal disable suite.
   */
  TC_PRINT("runtime get begin\n");
  wwdt_start_rc = pm_device_runtime_get(wwdt_dev);
  TC_PRINT("runtime get returned %d\n", wwdt_start_rc);
  if (wwdt_start_rc != 0) {
    TC_PRINT("watchdog resume failed: %d\n", wwdt_start_rc);
    return NULL;
  }
#endif

  TC_PRINT("watchdog start begin\n");
  wwdt_start_rc = wwdt_start();
  TC_PRINT("watchdog start returned %d\n", wwdt_start_rc);
  if (wwdt_start_rc != 0) {
    int ret = pm_device_runtime_put(wwdt_dev);

    if (ret != 0) {
      TC_PRINT("runtime reference cleanup failed: %d\n", ret);
    }
    return NULL;
  }
  wwdt_report_hw("started");

  return NULL;
}

static void wwdt_pm_before(void *fixture) {
  ARG_UNUSED(fixture);

  zassert_true(device_is_ready(wwdt_dev), "%s is not ready", wwdt_dev->name);
  zassert_ok(wwdt_start_rc, "%s: the watchdog did not start (%d)",
             wwdt_dev->name, wwdt_start_rc);

  /* Every test begins a full period away from the timeout. */
  zassert_ok(wwdt_feed_and_verify(), "%s: feed reload not observed",
             wwdt_dev->name);
}

static void wwdt_pm_after(void *fixture) {
  ARG_UNUSED(fixture);

  zassert_ok(wwdt_feed_and_verify(), "feed reload after test not observed");
}

ZTEST_SUITE(wwdt_pm, wwdt_running_phase, wwdt_pm_setup, wwdt_pm_before,
            wwdt_pm_after, NULL);

ZTEST(wwdt_stop, test_disable_stops_and_uninstalls) {
  const struct wdt_timeout_cfg cfg = {
      .window = {.min = 0U, .max = WWDT_TIMEOUT_MS},
      .flags = WDT_FLAG_RESET_NONE,
  };
  uint32_t stopped_tv;

  zassert_ok(wwdt_start_rc);
  zassert_ok(wdt_disable(wwdt_dev));
  zassert_true(wwdt_clock_is_halted());
  k_busy_wait(2000);
  stopped_tv = wwdt_tv();
  k_busy_wait(2U * WWDT_TIMEOUT_MS * 1000U);
  zassert_equal(wwdt_tv(), stopped_tv, "disabled counter moved");
  zassert_false(wwdt_expired(), "disabled timeout fired");
  zassert_equal(wdt_disable(wwdt_dev), -EFAULT);
  zassert_equal(wdt_feed(wwdt_dev, 0), -EINVAL);
  zassert_equal(wdt_install_timeout(wwdt_dev, &cfg), -ENOTSUP);
  zassert_equal(wdt_setup(wwdt_dev, 0), -ENOTSUP);

#if defined(CONFIG_PM_POLICY_DEVICE_CONSTRAINTS)
  pm_test_console_quiesce();
  for (enum pm_state state = PM_STATE_RUNTIME_IDLE; state < PM_STATE_COUNT;
       state++) {
    if (pm_policy_device_is_disabling_state(wwdt_dev, state, 0U)) {
      zassert_false(pm_policy_state_lock_is_active(state, 0U),
                    "disable retained constraint for state %d", state);
    }
  }
#endif

#if defined(CONFIG_PM_DEVICE_RUNTIME)
  zassert_ok(pm_device_runtime_put(wwdt_dev));
  zassert_equal(pm_device_runtime_usage(wwdt_dev), 0);
  zassert_ok(pm_device_runtime_get(wwdt_dev));
#elif defined(CONFIG_PM_DEVICE)
  zassert_ok(pm_device_action_run(wwdt_dev, PM_DEVICE_ACTION_SUSPEND));
  zassert_ok(pm_device_action_run(wwdt_dev, PM_DEVICE_ACTION_RESUME));
#endif
  zassert_true(wwdt_gate_is_open());
  zassert_true(wwdt_clock_is_halted());
  zassert_equal(wwdt_tv(), stopped_tv, "PM resumed disabled counter");
  wwdt_layer_after_stop();
  zassert_equal(wdt_setup(wwdt_dev, 0), -ENOTSUP);
  zassert_equal(wdt_feed(wwdt_dev, 0), -EINVAL);

#if defined(CONFIG_PM_DEVICE_RUNTIME)
  zassert_ok(pm_device_runtime_put(wwdt_dev));
#endif
}

ZTEST_SUITE(wwdt_stop, wwdt_stopped_phase, NULL, NULL, NULL, NULL);

void test_main(void) {
  enum wwdt_test_phase phase = WWDT_TEST_RUNNING;

  ztest_run_test_suites(&phase, false, 1, 1);
  phase = WWDT_TEST_STOPPED;
  ztest_run_test_suites(&phase, false, 1, 1);
  ztest_verify_all_test_suites_ran();
}
```

## src/test_control.c
```c
/*
 * Copyright 2026 NXP
 * SPDX-License-Identifier: Apache-2.0
 */

/**
 * @file
 * @brief The control, compiled into every layer: this case really drives the
 * WWDT.
 *
 * A layer verdict from a build whose watchdog never ran would mean nothing, so
 * each layer first establishes that the watchdog the suite setup started is
 * enabled, counts down, takes a feed, and has not run out.
 */

#include <zephyr/ztest.h>

#include "wwdt.h"

ZTEST(wwdt_pm, test_control_watchdog_runs_and_takes_a_feed) {
  struct wwdt_image img;

  zassert_true(wwdt_gate_is_open(),
               "%s: the bus clock of a running watchdog is gated",
               wwdt_dev->name);

  wwdt_image_read(&img);
  wwdt_report_hw("control");

  zassert_true(wwdt_image_enabled(&img),
               "%s: MOD[WDEN] is clear after setup (MOD=0x%02x)",
               wwdt_dev->name, img.mod);
  /* The premise every layer leans on: a missed feed cannot reset the board. */
  zassert_false(wwdt_image_resets(&img), "%s: MOD[WDRESET] is set (MOD=0x%02x)",
                wwdt_dev->name, img.mod);
  zassert_true(wwdt_counting(), "%s: TV is not counting down", wwdt_dev->name);
  zassert_ok(wwdt_feed_and_verify(), "%s: a feed did not reload TV",
             wwdt_dev->name);
  zassert_false(wwdt_expired(), "%s: the watchdog ran out", wwdt_dev->name);
}
```

## src/test_device.c
```c
/*
 * Copyright 2026 NXP
 * SPDX-License-Identifier: Apache-2.0
 */

/**
 * @file
 * @brief The device layer: the driver's PM callback, driven directly.
 *
 * Before the watchdog runs, an idle WWDT is all the callback can act on:
 * SUSPEND hands back its bus clock and RESUME takes it again, TURN_ON leaves
 * the clock with the RESUME that follows it, and a wdt_setup() on the suspended
 * device is refused without the clock being opened behind the PM core's back.
 *
 * A running watchdog supervises the CPU across compatible sleep states.
 * SUSPEND is refused without changing the PM state, configuration or counter.
 *
 * What this layer cannot do is hand TURN_ON a block that really came back from
 * reset: MOD[WDEN] cannot be cleared to stand in for one. That claim is the dpd
 * layer's.
 */

#include <errno.h>

#include <zephyr/drivers/watchdog.h>
#include <zephyr/pm/device.h>
#include <zephyr/ztest.h>

#include <pm_test/state.h>

#include "wwdt.h"

/* What the device looked like before the watchdog ran, recorded from the suite
 * setup. */
static struct {
  enum pm_device_state boot_state;
  bool gate_at_boot;
  int suspend_rc;
  bool gate_suspended;
  int install_rc;
  int setup_rc;
  bool gate_after_setup;
  int turn_off_rc;
  int turn_on_rc;
  bool gate_after_turn_on;
  int resume_rc;
  bool gate_resumed;
  bool enabled_resumed;
} idle;

int wwdt_layer_before_start(void) {
  struct wwdt_image img = {0};

  (void)pm_device_state_get(wwdt_dev, &idle.boot_state);
  idle.gate_at_boot = wwdt_gate_is_open();

  idle.suspend_rc = pm_device_action_run(wwdt_dev, PM_DEVICE_ACTION_SUSPEND);
  idle.gate_suspended = wwdt_gate_is_open();

  idle.install_rc = wwdt_install();
  idle.setup_rc = wdt_setup(wwdt_dev, 0);
  idle.gate_after_setup = wwdt_gate_is_open();

  idle.turn_off_rc = pm_device_action_run(wwdt_dev, PM_DEVICE_ACTION_TURN_OFF);
  idle.turn_on_rc = pm_device_action_run(wwdt_dev, PM_DEVICE_ACTION_TURN_ON);
  idle.gate_after_turn_on = wwdt_gate_is_open();

  idle.resume_rc = pm_device_action_run(wwdt_dev, PM_DEVICE_ACTION_RESUME);
  idle.gate_resumed = wwdt_gate_is_open();
  if (idle.gate_resumed) {
    wwdt_image_read(&img);
  }
  idle.enabled_resumed = wwdt_image_enabled(&img);
  return 0;
}

ZTEST(wwdt_pm, test_device_idle_watchdog_releases_its_clock) {
  zassert_equal(idle.boot_state, PM_DEVICE_STATE_ACTIVE,
                "%s: booted %s, not active", wwdt_dev->name,
                pm_device_state_str(idle.boot_state));
  zassert_true(idle.gate_at_boot,
               "%s: the bus clock is gated on an active device",
               wwdt_dev->name);

  zassert_ok(idle.suspend_rc, "%s: SUSPEND failed (%d)", wwdt_dev->name,
             idle.suspend_rc);
  zassert_false(idle.gate_suspended,
                "%s: SUSPEND left the bus clock of an idle watchdog open",
                wwdt_dev->name);

  zassert_ok(idle.install_rc,
             "%s: install_timeout on a suspended device failed (%d)",
             wwdt_dev->name, idle.install_rc);
  zassert_equal(idle.setup_rc, -EBUSY,
                "%s: wdt_setup() on a suspended device returned %d",
                wwdt_dev->name, idle.setup_rc);
  zassert_false(idle.gate_after_setup,
                "%s: the refused wdt_setup() opened the bus clock",
                wwdt_dev->name);

  zassert_ok(idle.turn_off_rc, "%s: TURN_OFF failed (%d)", wwdt_dev->name,
             idle.turn_off_rc);
  zassert_ok(idle.turn_on_rc, "%s: TURN_ON failed (%d)", wwdt_dev->name,
             idle.turn_on_rc);
  zassert_false(idle.gate_after_turn_on,
                "%s: TURN_ON left the bus clock of an idle watchdog open",
                wwdt_dev->name);

  zassert_ok(idle.resume_rc, "%s: RESUME failed (%d)", wwdt_dev->name,
             idle.resume_rc);
  zassert_true(idle.gate_resumed, "%s: RESUME did not take the bus clock back",
               wwdt_dev->name);
  zassert_false(idle.enabled_resumed,
                "%s: the watchdog runs without a wdt_setup()", wwdt_dev->name);
}

ZTEST(wwdt_pm, test_device_running_watchdog_survives_the_callback) {
  struct wwdt_image before;
  struct wwdt_image after;
  uint32_t tv_before;
  uint32_t tv_after;

  zassert_pm_state(wwdt_dev, PM_DEVICE_STATE_ACTIVE);
  k_busy_wait(5000);
  wwdt_image_read(&before);
  tv_before = wwdt_tv();

  zassert_equal(pm_device_action_run(wwdt_dev, PM_DEVICE_ACTION_SUSPEND),
                -ENOTSUP);
  zassert_equal(wdt_setup(wwdt_dev, 0), -EBUSY);
  zassert_pm_state(wwdt_dev, PM_DEVICE_STATE_ACTIVE);

  zassert_true(wwdt_gate_is_open(),
               "%s: the bus clock is gated after the round trip",
               wwdt_dev->name);
  tv_after = wwdt_tv();
  wwdt_image_read(&after);
  wwdt_report_hw("after turn-on");

  zassert_true(wwdt_image_enabled(&before),
               "%s: premise: the watchdog is not running", wwdt_dev->name);
  zassert_true(
      wwdt_image_equal(&after, &before),
      "%s: the configuration changed: MOD=0x%02x TC=0x%06x, was 0x%02x/0x%06x",
      wwdt_dev->name, after.mod, after.tc, before.mod, before.tc);
  zassert_true(tv_after <= tv_before,
               "%s: a refused operation reloaded TV (0x%06x -> "
               "0x%06x)",
               wwdt_dev->name, tv_before, tv_after);
  zassert_true(wwdt_counting(),
               "%s: the watchdog is not counting after the round trip",
               wwdt_dev->name);
  zassert_ok(wwdt_feed_and_verify(), "feed stopped reaching the watchdog");
  zassert_false(wwdt_expired(), "%s: the watchdog ran out", wwdt_dev->name);
}
```

## src/test_lowpower.c
```c
/*
 * Copyright 2026 NXP
 * SPDX-License-Identifier: Apache-2.0
 */

#include <errno.h>
#include <zephyr/pm/device.h>
#include <zephyr/pm/pm.h>
#include <zephyr/pm/policy.h>
#include <zephyr/ztest.h>

#include <pm_test/lowpower.h>
#include <pm_test/state.h>

#include "wwdt.h"

static struct wwdt_image idle_before;
static struct wwdt_image idle_after;
static bool idle_gate_after;
static volatile unsigned int sleep_entries;
static volatile unsigned int transition_entries;

static void state_entry(enum pm_state state) {
  if (state == PM_STATE_RUNTIME_IDLE) {
    sleep_entries++;
  }
  if (state == PM_TEST_TRANSITION_STATE) {
    transition_entries++;
  }
}

static struct pm_notifier notifier = {
    .state_entry = state_entry,
};

int wwdt_layer_before_start(void) {
  int ret = wwdt_install();

  if (ret != 0) {
    return ret;
  }
  ret = wwdt_seed_idle_registers();
  if (ret != 0) {
    return ret;
  }
  wwdt_image_read(&idle_before);
  pm_notifier_register(&notifier);
  pm_test_enter_transition();
  idle_gate_after = wwdt_gate_is_open();
  if (idle_gate_after) {
    wwdt_image_read(&idle_after);
  }
  pm_test_console_resume(PM_TEST_CONSOLE_REINIT_PINMUX);
  wwdt_report_hw("idle after transition");
  return 0;
}

ZTEST(wwdt_pm, test_idle_transition_before_start) {
  zassert_true(transition_entries > 0U, "requested transition was not entered");
  zassert_true(idle_gate_after,
               "bus access not restored after idle transition");
  zassert_false(wwdt_image_enabled(&idle_after),
                "idle transition started watchdog");
#if defined(CONFIG_PM_TEST_LAYER_DPD)
  zassert_not_equal(idle_before.tc, 0xFFU, "missing non-reset sentinel");
  zassert_equal(idle_after.tc, 0xFFU,
                "WWDT did not lose its register state in DPD");
#else
  zassert_true(wwdt_image_equal(&idle_before, &idle_after),
               "idle retained transition changed registers");
#endif
  /* Suite setup started the same installed timeout after the idle transition.
   */
  zassert_true(wwdt_counting());
  zassert_ok(wwdt_feed_and_verify());
}

ZTEST(wwdt_pm, test_running_watchdog_allows_only_compatible_sleep) {
  struct wwdt_image before;
  struct wwdt_image after;
  uint32_t first;
  uint32_t second;
  unsigned int entries = sleep_entries;
  const struct pm_state_info sleep = {
      .state = PM_STATE_RUNTIME_IDLE,
  };

  zassert_pm_state(wwdt_dev, PM_DEVICE_STATE_ACTIVE);
  wwdt_image_read(&before);
  first = wwdt_tv();
  zassert_true(pm_state_force(0U, &sleep));
  k_sleep(K_MSEC(20));
  second = wwdt_tv();
  wwdt_image_read(&after);
  zassert_true(sleep_entries > entries, "ordinary Sleep was not entered");
  zassert_pm_state(wwdt_dev, PM_DEVICE_STATE_ACTIVE);
  zassert_true(wwdt_image_equal(&before, &after));
  zassert_true(second < first,
               "counter stopped or reloaded across ordinary Sleep");

  pm_test_console_quiesce();
  const struct pm_state_info *next = pm_policy_next_state(0U, K_TICKS_FOREVER);

  zassert_true(next == NULL || !pm_policy_device_is_disabling_state(
                                   wwdt_dev, next->state, next->substate_id),
               "normal policy selected an incompatible state");
  zassert_ok(wwdt_feed_and_verify());
  zassert_false(wwdt_expired());
}

void wwdt_layer_after_stop(void) {
  struct wwdt_image after;
  unsigned int entries = transition_entries;
  uint32_t stopped_tv = wwdt_tv();

  pm_test_enter_transition();
  pm_test_console_resume(PM_TEST_CONSOLE_REINIT_PINMUX);
  zassert_true(transition_entries > entries, "disabled transition not entered");
  zassert_true(wwdt_gate_is_open());
  wwdt_image_read(&after);
#if defined(CONFIG_PM_TEST_LAYER_DPD)
  ARG_UNUSED(stopped_tv);
  zassert_false(wwdt_image_enabled(&after));
  zassert_equal(after.tc, 0xFFU, "disabled WWDT did not lose state in DPD");
#else
  zassert_true(wwdt_clock_is_halted());
  zassert_equal(wwdt_tv(), stopped_tv, "disabled counter advanced in sleep");
#endif
  k_busy_wait(2U * WWDT_TIMEOUT_MS * 1000U);
  zassert_false(wwdt_expired(), "disabled watchdog callback after wake");
  zassert_false(wwdt_counting(), "disabled watchdog counting after wake");
}
```

## src/test_runtime.c
```c
/*
 * Copyright 2026 NXP
 * SPDX-License-Identifier: Apache-2.0
 */

/**
 * @file
 * @brief The runtime layer: who holds the reference, and what a put() can do.
 *
 * The driver takes no runtime reference of its own -- a running watchdog has no
 * completion event to release one at -- so with
 * PM_DEVICE_RUNTIME_DEFAULT_ENABLE the device boots SUSPENDED with its bus
 * clock gated, and a wdt_setup() without a reference is refused rather than
 * starting a watchdog the PM core records as suspended. Both are observed from
 * the suite setup, before the reference the setup then takes for the rest of
 * the run.
 *
 * Once started, a final synchronous put fails and retains the reference and
 * ACTIVE state. The counter and its bus access must remain intact.
 */

#include <errno.h>

#include <zephyr/drivers/watchdog.h>
#include <zephyr/pm/device.h>
#include <zephyr/pm/device_runtime.h>
#include <zephyr/ztest.h>

#include <pm_test/state.h>

#include "wwdt.h"

static struct {
  enum pm_device_state boot_state;
  bool gate_at_boot;
  int install_rc;
  int setup_rc;
  bool gate_after_setup;
} unreferenced;

int wwdt_layer_before_start(void) {
  (void)pm_device_state_get(wwdt_dev, &unreferenced.boot_state);
  unreferenced.gate_at_boot = wwdt_gate_is_open();

  unreferenced.install_rc = wwdt_install();
  unreferenced.setup_rc = wdt_setup(wwdt_dev, 0);
  unreferenced.gate_after_setup = wwdt_gate_is_open();
  return 0;
}

ZTEST(wwdt_pm, test_runtime_boots_suspended_and_refuses_setup) {
  zassert_true(unreferenced.boot_state == PM_DEVICE_STATE_SUSPENDED ||
                   unreferenced.boot_state == PM_DEVICE_STATE_OFF,
               "%s: booted %s with no consumer", wwdt_dev->name,
               pm_device_state_str(unreferenced.boot_state));
  zassert_false(unreferenced.gate_at_boot,
                "%s: booted suspended with its bus clock open", wwdt_dev->name);

  zassert_ok(unreferenced.install_rc,
             "%s: install_timeout without a reference failed (%d)",
             wwdt_dev->name, unreferenced.install_rc);
  zassert_equal(unreferenced.setup_rc, -EBUSY,
                "%s: wdt_setup() without a reference returned %d",
                wwdt_dev->name, unreferenced.setup_rc);
  zassert_false(unreferenced.gate_after_setup,
                "%s: the refused wdt_setup() opened the bus clock",
                wwdt_dev->name);
}

ZTEST(wwdt_pm, test_runtime_put_cannot_stop_the_watchdog) {
  struct wwdt_image img = {0};
  bool gate_put;
  bool counting_put;
  int feed_put;
  int put_rc;

  zassert_pm_state(wwdt_dev, PM_DEVICE_STATE_ACTIVE);

  put_rc = pm_device_runtime_put(wwdt_dev);
  zassert_equal(put_rc, -ENOTSUP, "%s: final put returned %d", wwdt_dev->name,
                put_rc);
  zassert_pm_state(wwdt_dev, PM_DEVICE_STATE_ACTIVE);

  gate_put = wwdt_gate_is_open();
  if (gate_put) {
    wwdt_image_read(&img);
  }
  counting_put = gate_put && wwdt_counting();
  feed_put = gate_put ? wwdt_feed_and_verify() : -EIO;
  wwdt_report_hw("after put");

  zassert_true(gate_put, "%s: put() gated the bus clock of a running watchdog",
               wwdt_dev->name);
  zassert_true(wwdt_image_enabled(&img), "%s: MOD[WDEN] clear after put()",
               wwdt_dev->name);
  zassert_true(counting_put, "%s: the watchdog stopped counting after put()",
               wwdt_dev->name);
  zassert_ok(feed_put, "%s: a feed after put() did not reload TV (%d)",
             wwdt_dev->name, feed_put);
  zassert_pm_state(wwdt_dev, PM_DEVICE_STATE_ACTIVE);
  zassert_false(wwdt_expired(), "%s: the watchdog ran out", wwdt_dev->name);
}
```

## src/test_system.c
```c
/*
 * Copyright 2026 NXP
 * SPDX-License-Identifier: Apache-2.0
 */

#include <errno.h>
#include <zephyr/drivers/watchdog.h>
#include <zephyr/pm/device_runtime.h>
#include <zephyr/pm/policy.h>
#include <zephyr/ztest.h>

#include <pm_test/lowpower.h>
#include <pm_test/state.h>

#include "wwdt.h"

BUILD_ASSERT(DT_NODE_HAS_PROP(WWDT_NODE, zephyr_disabling_power_states),
             "WWDT must declare its incompatible system states");

static unsigned int locks_before;

static unsigned int locked_states(void) {
  unsigned int count = 0U;

  for (enum pm_state state = PM_STATE_ACTIVE; state < PM_STATE_COUNT; state++) {
    count += pm_policy_state_lock_is_active(state, 0U) ? 1U : 0U;
  }
  return count;
}

int wwdt_layer_before_start(void) {
  pm_test_console_quiesce();
  locks_before = locked_states();
  return 0;
}

ZTEST(wwdt_pm, test_system_constraints_follow_running_lifetime) {
  unsigned int declared = 0U;

  zassert_equal(locks_before, 0U,
                "constraints already held before watchdog start");
  zassert_true(wwdt_counting());
  pm_test_console_quiesce();
  for (enum pm_state state = PM_STATE_RUNTIME_IDLE; state < PM_STATE_COUNT;
       state++) {
    bool disabling = pm_policy_device_is_disabling_state(wwdt_dev, state, 0U);

    declared += disabling ? 1U : 0U;
    zassert_equal(pm_policy_state_lock_is_active(state, 0U), disabling,
                  "unexpected constraint for state %d", state);
  }
  zassert_true(declared > 0U, "no enabled disabling states were generated");
  zassert_equal(wdt_setup(wwdt_dev, 0), -EBUSY);
  zassert_equal(pm_device_runtime_put(wwdt_dev), -ENOTSUP);
  zassert_pm_state(wwdt_dev, PM_DEVICE_STATE_ACTIVE);
  pm_test_console_quiesce();
  zassert_equal(locked_states(), declared,
                "failed calls released or changed constraints");

  const struct pm_state_info *next = pm_policy_next_state(0U, K_TICKS_FOREVER);

  zassert_true(
      next == NULL || !pm_policy_device_is_disabling_state(
                          wwdt_dev, next->state, next->substate_id),
      "policy selected a state incompatible with the running watchdog");
  zassert_ok(wwdt_feed_and_verify());
}
```

## src/wwdt.c
```c
/*
 * Copyright 2026 NXP
 * SPDX-License-Identifier: Apache-2.0
 */

/**
 * @file
 * @brief The WWDT wiring, and the hardware truths this case asserts on.
 */

#include <errno.h>

#include <zephyr/devicetree.h>
#include <zephyr/drivers/watchdog.h>
#include <zephyr/kernel.h>
#include <zephyr/sys/util.h>
#include <zephyr/tc_util.h>

#include <fsl_clock.h>
#include <soc.h>

#include "wwdt.h"

/*
 * The gate below is read out of the MCX clock controller, so a part whose WWDT
 * takes its clock from some other controller is refused rather than read out of
 * the wrong register.
 */
BUILD_ASSERT(DT_NODE_HAS_COMPAT(DT_CLOCKS_CTLR(WWDT_NODE), nxp_lpc_syscon),
             "this case reads the WWDT clock gate out of the MCX clock "
             "controller and only "
             "fits SoCs whose WWDT clock comes from nxp,lpc-syscon");

#if defined(WWDT_MOD_LOCK_MASK)
#define WWDT_MOD_CONFIG_LOCK_MASK WWDT_MOD_LOCK_MASK
#else
#define WWDT_MOD_CONFIG_LOCK_MASK 0U
#endif

#define WWDT_MOD_CONFIG_MASK                                                   \
  (WWDT_MOD_WDEN_MASK | WWDT_MOD_WDRESET_MASK | WWDT_MOD_WDPROTECT_MASK |      \
   WWDT_MOD_CONFIG_LOCK_MASK)

const struct device *const wwdt_dev = DEVICE_DT_GET(WWDT_NODE);

int wwdt_start_rc = -EINPROGRESS;

static volatile bool wwdt_fired;
static bool wwdt_installed;

static WWDT_Type *wwdt_base(void) {
  return (WWDT_Type *)DT_REG_ADDR(WWDT_NODE);
}

/*
 * CLOCK_EnableClock()/CLOCK_DisableClock() write through the write-only SET/CLR
 * aliases, so the readable register is the one at the head of each group:
 * SYSCON->AHBCLKCTRL0..3 on MCXN, MRCC0->MRCC_GLB_CCn on MCXA.
 */
bool wwdt_gate_is_open(void) {
#if defined(CONFIG_SOC_FAMILY_MCXA)
  const clock_ip_name_t gate = kCLOCK_GateWWDT0;
  const volatile uint32_t *reg =
      (const volatile uint32_t *)((uintptr_t)&MRCC0->MRCC_GLB_CC0 +
                                  CLK_GATE_REG_OFFSET(gate));

  return (*reg & BIT(CLK_GATE_BIT_SHIFT(gate))) != 0U;
#else
  const clock_ip_name_t gate = kCLOCK_Wwdt0;
  const volatile uint32_t *reg =
      &(&SYSCON->AHBCLKCTRL0)[CLK_GATE_ABSTRACT_REG_OFFSET(gate)];

  return (*reg & BIT(CLK_GATE_ABSTRACT_BITS_SHIFT(gate))) != 0U;
#endif
}

void wwdt_image_read(struct wwdt_image *img) {
  WWDT_Type *base = wwdt_base();

  img->mod = base->MOD & WWDT_MOD_CONFIG_MASK;
  img->tc = base->TC;
  img->window = base->WINDOW;
  img->warnint = base->WARNINT;
}

bool wwdt_clock_is_halted(void) {
#if defined(CONFIG_SOC_FAMILY_MCXA)
  return CLOCK_GetClockDiv(kCLOCK_DivWWDT0) == 0U;
#else
  return CLOCK_GetClkDiv(kCLOCK_DivWdt0Clk) == 0U;
#endif
}

bool wwdt_image_equal(const struct wwdt_image *a, const struct wwdt_image *b) {
  return (a->mod == b->mod) && (a->tc == b->tc) && (a->window == b->window) &&
         (a->warnint == b->warnint);
}

bool wwdt_image_enabled(const struct wwdt_image *img) {
  return (img->mod & WWDT_MOD_WDEN_MASK) != 0U;
}

bool wwdt_image_resets(const struct wwdt_image *img) {
  return (img->mod & WWDT_MOD_WDRESET_MASK) != 0U;
}

uint32_t wwdt_tv(void) { return wwdt_base()->TV; }

bool wwdt_counting(void) {
  if (!wwdt_gate_is_open()) {
    TC_PRINT("count sample: gate=0, registers not read\n");
    return false;
  }

  k_busy_wait(2000);
  uint32_t first = wwdt_tv();
  uint32_t started = k_cycle_get_32();

  /*
   * Busy-waited rather than slept: 2 ms is hundreds of counts at any WWDT clock
   * a board here attaches, and a sleep would let the idle thread enter a power
   * state in the layers that have one.
   */
  k_busy_wait(2000);

  uint32_t second = wwdt_tv();
  uint32_t elapsed_us =
      (uint32_t)k_cyc_to_us_floor64(k_cycle_get_32() - started);

  if (second >= first) {
    TC_PRINT("count sample: TV=0x%06x -> 0x%06x elapsed=%u us gate=%u "
             "halt=%u MOD=0x%02x\n",
             first, second, elapsed_us, wwdt_gate_is_open(),
             wwdt_clock_is_halted(), wwdt_base()->MOD);
  }
  return second < first;
}

int wwdt_feed_and_verify(void) {
  uint32_t before;
  uint32_t after;
  int err;

  k_busy_wait(2000);
  before = wwdt_tv();

  err = wdt_feed(wwdt_dev, 0);
  if (err != 0) {
    return err;
  }

  for (unsigned int attempt = 0U; attempt < 200U; attempt++) {
    k_busy_wait(10);
    after = wwdt_tv();
    if (after > before) {
      return 0;
    }
  }

  TC_PRINT("feed reload: TV=0x%06x -> 0x%06x TC=0x%06x gate=%u halt=%u\n",
           before, after, wwdt_base()->TC, wwdt_gate_is_open(),
           wwdt_clock_is_halted());
  return -ESTALE;
}

bool wwdt_expired(void) { return wwdt_fired; }

static void wwdt_callback(const struct device *dev, int channel_id) {
  ARG_UNUSED(dev);
  ARG_UNUSED(channel_id);

  wwdt_fired = true;
}

int wwdt_install(void) {
  const struct wdt_timeout_cfg cfg = {
      .window = {.min = 0U, .max = WWDT_TIMEOUT_MS},
      .callback = wwdt_callback,
      /* Interrupt only: nothing this case does may reset the board. */
      .flags = WDT_FLAG_RESET_NONE,
  };
  int ret;

  if (wwdt_installed) {
    return 0;
  }

  TC_PRINT("install timeout begin: gate=%u\n", wwdt_gate_is_open());
  ret = wdt_install_timeout(wwdt_dev, &cfg);
  TC_PRINT("install timeout returned %d: gate=%u\n", ret,
           wwdt_gate_is_open());
  if (ret < 0) {
    return ret;
  }

  wwdt_installed = true;

  return 0;
}

__weak int wwdt_layer_before_start(void) { return 0; }

__weak void wwdt_layer_after_stop(void) {}

int wwdt_seed_idle_registers(void) {
  if (!wwdt_gate_is_open() || ((wwdt_base()->MOD & WWDT_MOD_WDEN_MASK) != 0U)) {
    return -EBUSY;
  }
  wwdt_base()->TC = 0x12345U;
  return wwdt_base()->TC == 0x12345U ? 0 : -EIO;
}

int wwdt_start(void) {
  int ret = wwdt_install();

  if (ret != 0) {
    return ret;
  }

  return wdt_setup(wwdt_dev, 0);
}

void wwdt_report_configuration(void) {
  TC_PRINT("%s: WWDT @ %p, clk-divider %u, timeout %u ms, reset none\n",
           wwdt_dev->name, (void *)wwdt_base(),
           (unsigned int)DT_PROP(WWDT_NODE, clk_divider), WWDT_TIMEOUT_MS);
}

void wwdt_report_hw(const char *when) {
  struct wwdt_image img;

  if (!wwdt_gate_is_open()) {
    /* No register read: an unclocked block does not answer. */
    TC_PRINT("hw(%s) gate=0, registers not read\n", when);
    return;
  }

  wwdt_image_read(&img);
  TC_PRINT("hw(%s) gate=1 MOD=0x%02x TC=0x%06x WINDOW=0x%06x WARNINT=0x%03x "
           "TV=0x%06x\n",
           when, img.mod, img.tc, img.window, img.warnint, wwdt_tv());
}
```

## src/wwdt.h
```c
/*
 * Copyright 2026 NXP
 * SPDX-License-Identifier: Apache-2.0
 */

/**
 * @file
 * @brief What every layer of the WWDT case needs from the hardware.
 *
 * The case uses one watchdog session per image, in interrupt-only mode
 * (WDT_FLAG_RESET_NONE, MOD[WDRESET] clear). Idle checks precede setup,
 * running checks share that session, and a separate terminal suite disables
 * the watchdog after the running suite completes.
 *
 * Four things are observed.
 *
 * The WWDT bus clock gate, read out of the clock controller: a WWDT register
 * only answers while the block is clocked, and whether it is clocked is the
 * question. Releasing that clock is the whole of what SUSPEND does to an idle
 * watchdog.
 *
 * The configuration image -- the enable and mode bits of MOD, TC, WINDOW and
 * WARNINT. Idle Deep Power Down clears a TC sentinel to its reset value, 0xFF,
 * without enabling the watchdog. A subsequent setup uses the retained RAM
 * request.
 *
 * TV, the counter. A watchdog that counts down is what makes "MOD[WDEN] is set"
 * mean a watchdog that runs, and a TV that jumps back up is what makes a feed a
 * feed.
 *
 * The timeout callback, which must never fire: it would mean the case let the
 * watchdog run out.
 */

#ifndef WWDT_PM_H_
#define WWDT_PM_H_

#include <stdbool.h>
#include <stdint.h>
#include <zephyr/device.h>
#include <zephyr/devicetree.h>

#define WWDT_NODE DT_NODELABEL(wwdt0)

#if !DT_NODE_HAS_STATUS_OKAY(WWDT_NODE)
#error "wwdt0 is not enabled on this board"
#endif

#if !defined(CONFIG_WDT_MCUX_WWDT)
#error "CONFIG_WDT_MCUX_WWDT is not enabled, so there is no driver to test"
#endif

/** Timeout the case installs. The WWDT divides its clock by 4 into a 24-bit
 * counter, so this fits for any WWDT clock up to 6.7 MHz, and it is far longer
 * than any gap between two feeds here.
 */
#define WWDT_TIMEOUT_MS 10000U

extern const struct device *const wwdt_dev;

/** @brief True while the WWDT bus clock gate is open. */
bool wwdt_gate_is_open(void);

/** @brief True while the functional divider is halted. */
bool wwdt_clock_is_halted(void);

/** The configuration a power-down resets. Only readable with the gate open. */
struct wwdt_image {
  /** MOD with the status flags WDTOF and WDINT masked out. */
  uint32_t mod;
  uint32_t tc;
  uint32_t window;
  uint32_t warnint;
};

/** @brief Sample @ref wwdt_image. */
void wwdt_image_read(struct wwdt_image *img);

/** @brief True when two images are the same. */
bool wwdt_image_equal(const struct wwdt_image *a, const struct wwdt_image *b);

/** @brief True when MOD[WDEN] is set in @p img. */
bool wwdt_image_enabled(const struct wwdt_image *img);

/** @brief True when MOD[WDRESET] is set in @p img. */
bool wwdt_image_resets(const struct wwdt_image *img);

/** @brief The counter, TV. Only readable with the gate open. */
uint32_t wwdt_tv(void);

/** @brief True when two reads of TV a short wait apart show it counting down.
 */
bool wwdt_counting(void);

/**
 * @brief Let the counter run down a little, feed through wdt_feed(), and check
 *        that TV went back up.
 *
 * @return 0, the wdt_feed() error, or -ESTALE when TV did not reload.
 */
int wwdt_feed_and_verify(void);

/** @brief True once the timeout callback has run. */
bool wwdt_expired(void);

/**
 * @brief wdt_install_timeout(), once per image.
 *
 * A layer that wants to call wdt_setup() before the watchdog runs installs the
 * timeout itself; the start in the suite setup then reuses it.
 *
 * @return 0, or the wdt_install_timeout() error.
 */
int wwdt_install(void);

/**
 * @brief Hook a layer implements to observe the device before the watchdog
 * runs.
 *
 * Called from suite setup before the watchdog starts. Return an error if the
 * pre-start sequence cannot complete; otherwise record observations for the
 * test.
 */
int wwdt_layer_before_start(void);

/** @brief Check the layer's transition after successful terminal disable. */
void wwdt_layer_after_stop(void);

/** @brief Result of starting the watchdog from the suite setup. */
extern int wwdt_start_rc;

/** @brief Install and wdt_setup(), from the suite setup. */
int wwdt_start(void);

/** @brief Set a non-reset TC value while WDEN is clear and the bus gate is
 * open. */
int wwdt_seed_idle_registers(void);

/** @brief Print what the devicetree asked for, once, from the suite setup. */
void wwdt_report_configuration(void);

/**
 * @brief Print the gate and, when the gate is open, the image and TV.
 *
 * Safe to call with the gate closed: it says the registers were not read rather
 * than touching an unclocked block.
 */
void wwdt_report_hw(const char *when);

#endif /* WWDT_PM_H_ */
```
