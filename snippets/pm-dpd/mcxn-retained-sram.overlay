/*
 * Copyright 2026 NXP
 * SPDX-License-Identifier: Apache-2.0
 *
 * MCXN DPD retains SRAMA through the VBAT RAM LDO. Use RAMA1-RAMA3
 * (24 KiB) and leave the boot ROM scratch area in RAMA0 untouched.
 */

&sram0 {
	reg = <0x20002000 0x6000>;
};
